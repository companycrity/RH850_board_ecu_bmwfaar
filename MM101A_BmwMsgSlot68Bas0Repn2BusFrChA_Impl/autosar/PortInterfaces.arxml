AUTOSAR XML (schema 4-0-3)
package /Nexteer/Calibrations
  parameter interface sint8_CalPortIf1
    parameter data prototype Val: sw-calibration-access=READ-WRITE, type=sint8
package /Nexteer/PortInterfaces
  client server interface SetNtcSts_PortIf1
    operation Oper: possible-error=E_NOT_OK
      4 x arg, all with direction=IN, server-argument-impl-policy=USE-ARGUMENT-TYPE:
        NtcNr_Arg: type=NtcNr1
        NtcStInfo_Arg: type=uint8
        NtcSts_Arg: type=NtcSts1
        DebStep_Arg: type=uint16
    error E_NOT_OK: error-code=1
  sender receiver interface boolean_PortIf1: invalidation-policy{data-element=Logl, handle-invalid=DONT-INVALIDATE}
    data Logl: sw-calibration-access=READ-ONLY, type=boolean
  sender receiver interface float32_PortIf1: invalidation-policy{data-element=float32_PortIf1/Val, handle-invalid=DONT-INVALIDATE}
    data Val: sw-calibration-access=READ-ONLY, type=float32
package /PortInterfaces
  5 x sender receiver interface:
    BmwEpsDeactvnCtrl_PortIf1: invalidation-policy{data-element=BmwEpsDeactvnCtrl_PortIf1/Val, handle-invalid=DONT-INVALIDATE}
      data Val: type=BmwEpsDeactvnCtrl1
    BmwOvrlCmdQlfr_PortIf1: invalidation-policy{data-element=BmwOvrlCmdQlfr_PortIf1/Val, handle-invalid=DONT-INVALIDATE}
      data Val: type=BmwOvrlCmdQlfr1
    BmwTrfcJamAssiDampgStReq_PortIf1: invalidation-policy{data-element=BmwTrfcJamAssiDampgStReq_PortIf1/Val, handle-invalid=DONT-INVALIDATE}
      data Val: type=BmwTrfcJamAssiDampgStReq1
    sigGroup_TAR_QTA_STRMOM_DV: invalidation-policy{data-element=sigGroup_TAR_QTA_STRMOM_DV, handle-invalid=DONT-INVALIDATE}
      data sigGroup_TAR_QTA_STRMOM_DV: type=sigGroup_TAR_QTA_STRMOM_DV1
    sigGroup_TAR_STMOM_DV_ACT: invalidation-policy{data-element=sigGroup_TAR_STMOM_DV_ACT, handle-invalid=DONT-INVALIDATE}
      data sigGroup_TAR_STMOM_DV_ACT: type=sigGroup_TAR_STMOM_DV_ACT1
