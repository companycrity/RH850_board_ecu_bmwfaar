AUTOSAR XML (schema 4-0-3)
standard types defined: boolean, float32, sint8, uint16, uint32, uint8, boolean_CompuMethod, boolean_DataConstr, float32_DataConstr, sint8_DataConstr, uint16_DataConstr, uint8_DataConstr
package /BMW/Boardnet/CodingDatatypes/CompuMethodsForBoardnet
  compu method ALIV_COU_4: 0=Zaehlerstand0DotDotE (ALIV_COU_4_Zaehlerstand0DotDotE) (BNE original name: Zählerstand 0..E), 15=SignalUngueltig (ALIV_COU_4_SignalUngueltig) (BNE original name: Signal ungültig)
  compu method CRC8: identical  # Standartabsicherung Apllikations-CRC.
package /BMW/Boardnet/CodingDatatypes/DataConstraints
  range CRC8: phys 0..255  # Standartabsicherung Apllikations-CRC.
package /DataTypes
  23 x impl type:
    ALIV_TAR_QTA_STMOM_DV1: category=VALUE, base-type=uint8, compu-method=ALIV_COU_4
    ALIV_TAR_STMOM_DV_ACT1: category=VALUE, base-type=uint8, compu-method=ALIV_COU_4
    BmwEpsDeactvnCtrl1: category=VALUE, base-type=uint8, sw-calibration-access=READ-ONLY, compu {0=BMWEPSDEACTVNCTRL_NODEACTVNEPSFCT, 1=BMWEPSDEACTVNCTRL_DEACTVNEPSFCTGROUP1, 2=BMWEPSDEACTVNCTRL_DEACTVNEPSFCTGROUP2, 13=BMWEPSDEACTVNCTRL_FCTIFNOTAVL, 14=BMWEPSDEACTVNCTRL_FCTRPRTERR, 15=BMWEPSDEACTVNCTRL_INVLDSIG}, type-emitter=RTE
    BmwOvrlCmdQlfr1: category=VALUE, base-type=uint8, sw-calibration-access=READ-ONLY, compu {2=BMWOVRLCMDQLFR_IMPLSP, 7=BMWOVRLCMDQLFR_SPNOTAVL, 14=BMWOVRLCMDQLFR_STBDONOTCNVSP, 15=BMWOVRLCMDQLFR_INVLDSIG}, type-emitter=RTE
    BmwTrfcJamAssiDampgStReq1: category=VALUE, base-type=uint8, sw-calibration-access=READ-ONLY, compu {1=BMWTRFCJAMASSIDAMPGSTREQ_DONOTCNVSPADDLDAMPG, 2=BMWTRFCJAMASSIDAMPGSTREQ_CNVSPADDLDAMPG, 15=BMWTRFCJAMASSIDAMPGSTREQ_INVLDSIG}, type-emitter=RTE
    CRC_TAR_QTA_STMOM_DV1: category=VALUE, base-type=uint8, compu-method=CRC8
    CRC_TAR_STMOM_DV_ACT1: category=VALUE, base-type=uint8, compu-method=CRC8
    CTR_DEAC_EPS_FNS1:
      category=VALUE
      base-type=uint8
      compu {mask 15: 0=Keine_Deaktivierung_EPS_Funktionen (CTR_DEAC_EPS_FNS_Keine_Deaktivierung_EPS_Funktionen) (Es besteht keine Anforderung zur Deaktivierung von Funktionen auf der EPS.), mask 15: 13=Funktionsschnittstelle_ist_nicht_verfuegbar (CTR_DEAC_EPS_FNS_Funktionsschnittstelle_ist_nicht_verfuegbar) (Sendefunktion in Betrieb, Werte nicht verfügbar), mask 15: 14=Funktion_meldet_Fehler (CTR_DEAC_EPS_FNS_Funktion_meldet_Fehler) (Sendefunktion in Betrieb, meldet Fehler), mask 15: 15=Signal_unbefuellt (CTR_DEAC_EPS_FNS_Signal_unbefuellt) (Wird nicht aktiv gesetzt), mask 9: 1=Deaktivierung_EPS_Funktionen_Funktionsgruppe_1 (CTR_DEAC_EPS_FNS_Deaktivierung_EPS_Funktionen_Funktionsgruppe_1) (BNE original name: Deaktivierung_EPS_Funktionen_ Funktionsgruppe_1), mask 10: 2=Deaktivierung_EPS_Funktionen_Funktionsgruppe_2 (CTR_DEAC_EPS_FNS_Deaktivierung_EPS_Funktionen_Funktionsgruppe_2) (BNE original name: Deaktivierung_EPS_Funktionen_ Funktionsgruppe_2)}
    FACT_ASS_STMOM_FTAX1: category=VALUE, base-type=uint8, compu {phys=raw/256+1 for raw -256..64768}
    FACT_CTRR_STMOM_FTAX1: category=VALUE, base-type=uint8, compu {phys=raw/256+0.0078125 for raw -2..65022}
    FACT_DMPNG_ADDON_STMOM_FTAX1:
      category=VALUE
      base-type=uint8
      compu {phys=raw/64 for raw 0..8192, 253=Reserviert (FACT_DMPNG_ADDON_STMOM_FTAX_Reserviert) (Hinweis: Reserviert für funktionale Kennung Signal-Tag.), 254=Reserviert_bne_5B8A124DE2884D68A663388C50F241EF_254 (FACT_DMPNG_ADDON_STMOM_FTAX_Reserviert_bne_5B8A124DE2884D68A663388C50F241EF_254) (BNE original name: Reserviert), 255=Signal_unbefuellt (FACT_DMPNG_ADDON_STMOM_FTAX_Signal_unbefuellt) (Sendefunktion nicht in Betrieb)}
    FACT_DMPNG_STMOM_FTAX1: category=VALUE, base-type=uint8, compu {phys=raw/256+0.0078125 for raw -2..65022}
    QU_TAR_DMPNG_ADDON_STMOM_FTAX1:
      category=VALUE
      base-type=uint8
      compu {1=SollwertZusatzdaempfungNichtUmsetzen (QU_TAR_DMPNG_ADDON_STMOM_FTAX_SollwertZusatzdaempfungNichtUmsetzen) (BNE original name: Sollwert Zusatzdämpfung nicht umsetzen), 2=SollwertZusatzdaempfungUmsetzen (QU_TAR_DMPNG_ADDON_STMOM_FTAX_SollwertZusatzdaempfungUmsetzen) (BNE original name: Sollwert Zusatzdämpfung umsetzen), 15=SignalUnbefuellt (QU_TAR_DMPNG_ADDON_STMOM_FTAX_SignalUnbefuellt) (BNE original name: Signal unbefüllt)}
    QU_TAR_FACT_STMOM_FTAX1:
      category=VALUE
      base-type=uint8
      compu {2=SollwerteUmsetzen (QU_TAR_FACT_STMOM_FTAX_SollwerteUmsetzen) (BNE original name: Sollwerte umsetzen), 7=SollwerteNichtVorhanden (QU_TAR_FACT_STMOM_FTAX_SollwerteNichtVorhanden) (BNE original name: Sollwerte nicht vorhanden), 14=StandbyColonSollwerteNichtUmsetzen (QU_TAR_FACT_STMOM_FTAX_StandbyColonSollwerteNichtUmsetzen) (BNE original name: Standby: Sollwerte nicht umsetzen), 15=SignalUngueltig (QU_TAR_FACT_STMOM_FTAX_SignalUngueltig) (BNE original name: Signal ungültig)}
    QU_TAR_QTA_STMOM_DV1:
      category=VALUE
      base-type=uint8
      compu {2=SollwerteUmsetzen (QU_TAR_QTA_STMOM_DV_SollwerteUmsetzen) (BNE original name: Sollwerte umsetzen), 7=SollwerteNichtVorhanden (QU_TAR_QTA_STMOM_DV_SollwerteNichtVorhanden) (BNE original name: Sollwerte nicht vorhanden), 14=SollwerteNichtUmsetzen_Standby (QU_TAR_QTA_STMOM_DV_SollwerteNichtUmsetzen_Standby) (BNE original name: Sollwerte nicht umsetzen - Standby), 15=SignalUngueltig (QU_TAR_QTA_STMOM_DV_SignalUngueltig) (BNE original name: Signal ungültig)}
    QU_TAR_STMOM_DV_ACT1:
      category=VALUE
      base-type=uint8
      compu {2=SollwerteUmsetzen (QU_TAR_STMOM_DV_ACT_SollwerteUmsetzen) (BNE original name: Sollwerte umsetzen), 7=SollwerteNichtVorhanden (QU_TAR_STMOM_DV_ACT_SollwerteNichtVorhanden) (BNE original name: Sollwerte nicht vorhanden), 14=StandbyColonSollwerteNichtUmsetzen (QU_TAR_STMOM_DV_ACT_StandbyColonSollwerteNichtUmsetzen) (BNE original name: Standby: Sollwerte nicht umsetzen), 15=SignalUngueltig (QU_TAR_STMOM_DV_ACT_SignalUngueltig) (BNE original name: Signal ungültig)}
    sigGroup_TAR_QTA_STRMOM_DV1: category=STRUCTURE
      10 x element, all with category=TYPE_REFERENCE:
        FACT_DMPNG_STMOM_FTAX: range phys 0..254, implementation-data-type=FACT_DMPNG_STMOM_FTAX1
        QU_TAR_QTA_STMOM_DV: range raw 0..15, implementation-data-type=QU_TAR_QTA_STMOM_DV1
        ALIV_TAR_QTA_STMOM_DV: range raw 0..15, implementation-data-type=ALIV_TAR_QTA_STMOM_DV1
        QU_TAR_FACT_STMOM_FTAX: range raw 0..15, implementation-data-type=QU_TAR_FACT_STMOM_FTAX1
        CTR_DEAC_EPS_FNS: range raw 0..15, implementation-data-type=CTR_DEAC_EPS_FNS1
        FACT_CTRR_STMOM_FTAX: range phys 0..254, implementation-data-type=FACT_CTRR_STMOM_FTAX1
        TAR_QTA_STRMOM_DV_dummy_12_15: range phys 0..15, implementation-data-type=TAR_QTA_STRMOM_DV_dummy_12_151
        FACT_ASS_STMOM_FTAX: range phys 0..254, implementation-data-type=FACT_ASS_STMOM_FTAX1
        TAR_QTA_STMOM_DV: range phys 0..4000, implementation-data-type=TAR_QTA_STMOM_DV1
        CRC_TAR_QTA_STMOM_DV: data-constr=CRC8, implementation-data-type=CRC_TAR_QTA_STMOM_DV1
    sigGroup_TAR_STMOM_DV_ACT1: category=STRUCTURE
      8 x element, all with category=TYPE_REFERENCE:
        TAR_STMOM_DV_ACT_dummy_12_15: range phys 0..15, implementation-data-type=TAR_STMOM_DV_ACT_dummy_12_151
        TAR_STMOM_DV_ACT_dummy_32_51: range phys 0..1048575, implementation-data-type=TAR_STMOM_DV_ACT_dummy_32_511
        QU_TAR_DMPNG_ADDON_STMOM_FTAX: range raw 0..15, implementation-data-type=QU_TAR_DMPNG_ADDON_STMOM_FTAX1
        FACT_DMPNG_ADDON_STMOM_FTAX: range phys 0..128, implementation-data-type=FACT_DMPNG_ADDON_STMOM_FTAX1
        TAR_STMOM_DV_ACT: range phys 0..4000, implementation-data-type=TAR_STMOM_DV_ACT1
        CRC_TAR_STMOM_DV_ACT: data-constr=CRC8, implementation-data-type=CRC_TAR_STMOM_DV_ACT1
        QU_TAR_STMOM_DV_ACT: range raw 0..15, implementation-data-type=QU_TAR_STMOM_DV_ACT1
        ALIV_TAR_STMOM_DV_ACT: range raw 0..15, implementation-data-type=ALIV_TAR_STMOM_DV_ACT1
    TAR_QTA_STMOM_DV1: category=VALUE, base-type=uint16, compu {phys=raw*0.005-10 for raw 2000..802000}
    TAR_QTA_STRMOM_DV_dummy_12_151: category=VALUE, base-type=uint8, compu {identical}
    TAR_STMOM_DV_ACT_dummy_12_151: category=VALUE, base-type=uint8, compu {identical}
    TAR_STMOM_DV_ACT_dummy_32_511: category=VALUE, base-type=uint32, compu {identical}
    TAR_STMOM_DV_ACT1: category=VALUE, base-type=uint16, compu {phys=raw*0.006-12 for raw 2000..668666.6666666666}
package /Nexteer/DataTypes
  impl type NtcNr1: compu {1..511=NTCNR_0X001..NTCNR_0X1FF}, implementation-data-type=uint16, type-emitter=RTE
  impl type NtcSts1: compu {0=NTCSTS_PASSD, 1=NTCSTS_FAILD, 2=NTCSTS_PREPASSD, 3=NTCSTS_PREFAILD}, implementation-data-type=uint8, type-emitter=RTE
