AUTOSAR XML (schema 4-0-3)
standard types defined: boolean, float32, uint16, uint32, uint8, boolean_CompuMethod, boolean_DataConstr, float32_DataConstr, uint16_DataConstr, uint32_DataConstr, uint8_DataConstr
package /Nexteer/DataTypes
  7 x impl type, all with category=TYPE_REFERENCE, type-emitter=RTE:
    BmwEpsFctSts1: compu {49=BMWEPSFCTSTS_FCTINFALLBACK, 51=BMWEPSFCTSTS_FCTINFALLBACKEMGYFCNENVTLINFLSACTV, 96=BMWEPSFCTSTS_NOTAVIERR, 128=BMWEPSFCTSTS_ININ, 160=BMWEPSFCTSTS_FCTAVIACTV12VEPS, 162=BMWEPSFCTSTS_FCTAVIACTVEMGYFCNENVTLINFLSACTV, 164=BMWEPSFCTSTS_FCTAVIACTV12VEAS, 168=BMWEPSFCTSTS_FCTAVIACTV24VEAS, 176=BMWEPSFCTSTS_FCTTMPINFALLBACK, 178=BMWEPSFCTSTS_FCTTMPINFALLBACKEMGYFCNENVTLINFLSACT, 224=BMWEPSFCTSTS_NOTAVISWDOFF, 255=BMWEPSFCTSTS_INVLD}, implementation-data-type=uint8
    BmwVehCdn1: compu {1=BMWVEHCDN_PRKGNBNOK, 2=BMWVEHCDN_PRKGBNOK, 3=BMWVEHCDN_FCTCUSTNOTINFZG, 5=BMWVEHCDN_LVNG, 7=BMWVEHCDN_CHKDIAGCANLS, 8=BMWVEHCDN_DRVRPREPGFOROPER, 10=BMWVEHCDN_DRVG, 12=BMWVEHCDN_DRVRPREPGFOREXITOPER, 15=BMWVEHCDN_INVLD}, implementation-data-type=uint8
    BmwVehSpdSts1: compu {1=BMWVEHSPDSTS_VLD, 4=BMWVEHSPDSTS_SUBVALSETINUSFLSIGVEHSTANDG, 12=BMWVEHSPDSTS_SUBVALSETINUSFLSIGVEHRUNNG, 14=BMWVEHSPDSTS_SUBVALSETINUSRSIGNOINFO, 15=BMWVEHSPDSTS_INVLD}, implementation-data-type=uint8
    StsDrvrActvy1: compu {0=STSDRVRACTVY_NODRVRACTVY, 1=STSDRVRACTVY_DRVRACTVY}, implementation-data-type=uint8
    StsSteerAssi1: compu {0=STSSTEERASSI_OFF, 1=STSSTEERASSI_ON}, implementation-data-type=uint8
    SysSt1: compu {0=SYSST_DI, 1=SYSST_OFF, 2=SYSST_ENA, 3=SYSST_WRMININ}, implementation-data-type=uint8
    u16p0: implementation-data-type=uint16
