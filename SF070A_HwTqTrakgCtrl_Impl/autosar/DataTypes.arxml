AUTOSAR XML (schema 4-0-3)
standard types defined: float32, sint16, uint16, float32_DataConstr, sint16_DataConstr, uint16_DataConstr
package /Nexteer/DataTypes
  11 x impl type, all with type-emitter=RTE:
    Ary1D_s14p1_4: category=ARRAY, sw-calibration-access=READ-ONLY
      element Element: array-size=4, array-size-semantics=FIXED-SIZE, implementation-data-type=s14p1
    Ary1D_s3p12_4: category=ARRAY, sw-calibration-access=READ-ONLY
      element Element: array-size=4, array-size-semantics=FIXED-SIZE, implementation-data-type=s3p12
    Ary1D_s7p8_4: category=ARRAY, sw-calibration-access=READ-ONLY
      element Element: array-size=4, array-size-semantics=FIXED-SIZE, implementation-data-type=s7p8
    Ary1D_s8p7_4: category=ARRAY, sw-calibration-access=READ-ONLY
      element Element: array-size=4, array-size-semantics=FIXED-SIZE, implementation-data-type=s8p7
    Ary1D_u9p7_4: category=ARRAY, sw-calibration-access=READ-ONLY
      element Element: array-size=4, array-size-semantics=FIXED-SIZE, implementation-data-type=u9p7
    s14p1: implementation-data-type=sint16
    s3p12: implementation-data-type=sint16
    s7p8: implementation-data-type=sint16
    s8p7: implementation-data-type=sint16
    TorsBarStEstimdRec1: category=STRUCTURE, sw-calibration-access=READ-ONLY
      5 x element, all with category=TYPE_REFERENCE, implementation-data-type=float32:
        MotVelEstimd
        TorsBarTqEstimd
        TorsBarRotatmEstimd
        DrvrTqEstimd
        RackTqEstimd
    u9p7: implementation-data-type=uint16
