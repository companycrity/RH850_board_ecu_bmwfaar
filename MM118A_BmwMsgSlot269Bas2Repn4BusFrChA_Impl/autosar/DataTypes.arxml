AUTOSAR XML (schema 4-0-3)
standard types defined: boolean, uint16, uint8, boolean_CompuMethod, boolean_DataConstr, uint16_DataConstr, uint8_DataConstr
package /DataTypes
  impl type CTR_WARN_DIR_VIB_EPS1:
    category=VALUE
    base-type=uint8
    compu {0=Keine_Richtung (CTR_WARN_DIR_VIB_EPS_Keine_Richtung) (Ungerichteter Impuls Diese Codierung wird auch versendet, wenn keine haptische Warnung erfolgt.), 1=Richtung_links (CTR_WARN_DIR_VIB_EPS_Richtung_links) (Impuls Richtung links), 2=Richtung_rechts (CTR_WARN_DIR_VIB_EPS_Richtung_rechts) (Impuls Richtung rechts), 3=Signal_unbefuellt (CTR_WARN_DIR_VIB_EPS_Signal_unbefuellt) (Sendefunktion nicht in Betrieb)}
    range raw 0..3
    invalid-value=3
  impl type CTR_WARN_ILVL_VIB_EPS1:
    category=VALUE
    base-type=uint8
    compu {0=Intensitaetsstufe_0 (CTR_WARN_ILVL_VIB_EPS_Intensitaetsstufe_0) (Diese Codierung wird auch verwendet, wenn keine haptische Warnung erfolgt.), 1=Intensitaetsstufe_1 (CTR_WARN_ILVL_VIB_EPS_Intensitaetsstufe_1), 2=Intensitaetsstufe_2 (CTR_WARN_ILVL_VIB_EPS_Intensitaetsstufe_2), 3=Intensitaetsstufe_3 (CTR_WARN_ILVL_VIB_EPS_Intensitaetsstufe_3), 4=Intensitaetsstufe_4 (CTR_WARN_ILVL_VIB_EPS_Intensitaetsstufe_4), 5=Intensitaetsstufe_5 (CTR_WARN_ILVL_VIB_EPS_Intensitaetsstufe_5), 6=Intensitaetsstufe_6 (CTR_WARN_ILVL_VIB_EPS_Intensitaetsstufe_6), 7=Intensitaetsstufe_7 (CTR_WARN_ILVL_VIB_EPS_Intensitaetsstufe_7), 8=Intensitaetsstufe_8 (CTR_WARN_ILVL_VIB_EPS_Intensitaetsstufe_8), 9=Intensitaetsstufe_9 (CTR_WARN_ILVL_VIB_EPS_Intensitaetsstufe_9), 10=Intensitaetsstufe_10 (CTR_WARN_ILVL_VIB_EPS_Intensitaetsstufe_10), 11=Intensitaetsstufe_11 (CTR_WARN_ILVL_VIB_EPS_Intensitaetsstufe_11), 12=Intensitaetsstufe_12 (CTR_WARN_ILVL_VIB_EPS_Intensitaetsstufe_12), 13=Reserviert (CTR_WARN_ILVL_VIB_EPS_Reserviert) (Hinweis: Reserviert für funktionale Kennung Signal-Tag.), 14=Reserviert_bne_F5E488CE22EB4069AA18D5B18C674FB7_14 (CTR_WARN_ILVL_VIB_EPS_Reserviert_bne_F5E488CE22EB4069AA18D5B18C674FB7_14) (BNE original name: Reserviert), 15=Signal_unbefuellt (CTR_WARN_ILVL_VIB_EPS_Signal_unbefuellt) (Sendefunktion nicht in Betrieb)}
    range raw 0..15
    invalid-value=15
  impl type CTR_WARN_PTRN_VIB_EPS1:
    category=VALUE
    base-type=uint8
    compu {0=Keine_haptische_Warnung (CTR_WARN_PTRN_VIB_EPS_Keine_haptische_Warnung), 1=Muster_1 (CTR_WARN_PTRN_VIB_EPS_Muster_1), 2=Muster_2 (CTR_WARN_PTRN_VIB_EPS_Muster_2), 3=Muster_3 (CTR_WARN_PTRN_VIB_EPS_Muster_3), 4=Muster_4 (CTR_WARN_PTRN_VIB_EPS_Muster_4), 5=Muster_5 (CTR_WARN_PTRN_VIB_EPS_Muster_5), 6=Muster_6 (CTR_WARN_PTRN_VIB_EPS_Muster_6), 7=Muster_7 (CTR_WARN_PTRN_VIB_EPS_Muster_7), 8=Muster_8 (CTR_WARN_PTRN_VIB_EPS_Muster_8), 9=Muster_9 (CTR_WARN_PTRN_VIB_EPS_Muster_9), 10=Muster_10 (CTR_WARN_PTRN_VIB_EPS_Muster_10), 13=Funktionsschnittstelle_ist_nicht_verfuegbar (CTR_WARN_PTRN_VIB_EPS_Funktionsschnittstelle_ist_nicht_verfuegbar) (Sendefunktion in Betrieb, Werte nicht verfügbar), 14=Funktion_meldet_Fehler (CTR_WARN_PTRN_VIB_EPS_Funktion_meldet_Fehler) (Sendefunktion in Betrieb, meldet Fehler), 15=Signal_unbefuellt (CTR_WARN_PTRN_VIB_EPS_Signal_unbefuellt) (Sendefunktion nicht in Betrieb)}
    range raw 0..15
    invalid-value=15
package /Nexteer/DataTypes
  5 x impl type, all with category=TYPE_REFERENCE, type-emitter=RTE:
    BmwHaptcFbDirNr1: compu {0=BMWHAPTCFBDIRNR_NODIR, 1=BMWHAPTCFBDIRNR_DIRLE, 2=BMWHAPTCFBDIRNR_DIRRI, 3=BMWHAPTCFBDIRNR_INVLDSIG}, implementation-data-type=uint8
    BmwHaptcFbIntenNr1: compu {0..12=BMWHAPTCFBINTENNR_INTEN0..BMWHAPTCFBINTENNR_INTEN12, 13=BMWHAPTCFBINTENNR_RESD1, 14=BMWHAPTCFBINTENNR_RESD2, 15=BMWHAPTCFBINTENNR_INVLDSIG}, implementation-data-type=uint8
    BmwHaptcFbPatNr1: compu {0=BMWHAPTCFBPATNR_NOHAPTCWARN, 1..10=BMWHAPTCFBPATNR_PAT1..BMWHAPTCFBPATNR_PAT10, 13=BMWHAPTCFBPATNR_FCTIFNOTAVL, 14=BMWHAPTCFBPATNR_FCTRPRTERR, 15=BMWHAPTCFBPATNR_INVLDSIG}, implementation-data-type=uint8
    NtcNr1: compu {1..511=NTCNR_0X001..NTCNR_0X1FF}, implementation-data-type=uint16
    NtcSts1: compu {0=NTCSTS_PASSD, 1=NTCSTS_FAILD, 2=NTCSTS_PREPASSD, 3=NTCSTS_PREFAILD}, implementation-data-type=uint8
