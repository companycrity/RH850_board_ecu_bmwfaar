AUTOSAR XML (schema 4-0-3)
package /Nexteer/PortInterfaces
  client server interface SetNtcSts_PortIf1
    operation Oper: possible-error=E_NOT_OK
      4 x arg, all with direction=IN, server-argument-impl-policy=USE-ARGUMENT-TYPE:
        NtcNr_Arg: type=NtcNr1
        NtcStInfo_Arg: type=uint8
        NtcSts_Arg: type=NtcSts1
        DebStep_Arg: type=uint16
    error E_NOT_OK: error-code=1
  4 x sender receiver interface:
    BmwHaptcFbDirNr1_PortIf1: invalidation-policy{data-element=BmwHaptcFbDirNr1_PortIf1/Val, handle-invalid=DONT-INVALIDATE}
      data Val: sw-calibration-access=READ-ONLY, type=BmwHaptcFbDirNr1
    BmwHaptcFbIntenNr1_PortIf1: invalidation-policy{data-element=BmwHaptcFbIntenNr1_PortIf1/Val, handle-invalid=DONT-INVALIDATE}
      data Val: sw-calibration-access=READ-ONLY, type=BmwHaptcFbIntenNr1
    BmwHaptcFbPatNr1_PortIf1: invalidation-policy{data-element=BmwHaptcFbPatNr1_PortIf1/Val, handle-invalid=DONT-INVALIDATE}
      data Val: sw-calibration-access=READ-ONLY, type=BmwHaptcFbPatNr1
    boolean_PortIf1: invalidation-policy{data-element=Logl, handle-invalid=DONT-INVALIDATE}
      data Logl: sw-calibration-access=READ-ONLY, type=boolean
package /PortInterfaces
  sender receiver interface CTR_WARN_DIR_VIB_EPS: invalidation-policy{data-element=CTR_WARN_DIR_VIB_EPS, handle-invalid=DONT-INVALIDATE}
    data CTR_WARN_DIR_VIB_EPS: type=CTR_WARN_DIR_VIB_EPS1
  sender receiver interface CTR_WARN_ILVL_VIB_EPS: invalidation-policy{data-element=CTR_WARN_ILVL_VIB_EPS, handle-invalid=DONT-INVALIDATE}
    data CTR_WARN_ILVL_VIB_EPS: type=CTR_WARN_ILVL_VIB_EPS1
  sender receiver interface CTR_WARN_PTRN_VIB_EPS: invalidation-policy{data-element=CTR_WARN_PTRN_VIB_EPS, handle-invalid=DONT-INVALIDATE}
    data CTR_WARN_PTRN_VIB_EPS: type=CTR_WARN_PTRN_VIB_EPS1
