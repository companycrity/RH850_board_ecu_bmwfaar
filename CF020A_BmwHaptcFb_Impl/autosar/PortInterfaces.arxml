AUTOSAR XML (schema 4-0-3)
package /Nexteer/Calibrations
  11 x parameter interface:
    Ary1D_f32_11_CalPortIf1
      parameter data prototype Ary1D: sw-calibration-access=READ-WRITE, type=Ary1D_f32_11
    Ary1D_u16_13_CalPortIf1
      parameter data prototype Ary1D: sw-calibration-access=READ-WRITE, type=Ary1D_u16_13
    Ary1D_u4p12_12_CalPortIf1
      parameter data prototype Ary1D: sw-calibration-access=READ-WRITE, type=Ary1D_u4p12_12
    Ary1D_u4p12_13_CalPortIf1
      parameter data prototype Ary1D: sw-calibration-access=READ-WRITE, type=Ary1D_u4p12_13
    Ary1D_u6p10_13_CalPortIf1
      parameter data prototype Ary1D: sw-calibration-access=READ-WRITE, type=Ary1D_u6p10_13
    Ary1D_u9p7_12_CalPortIf1
      parameter data prototype Ary1D: sw-calibration-access=READ-WRITE, type=Ary1D_u9p7_12
    Ary2D_u4p12_12_12_CalPortIf1
      parameter data prototype Ary2D: sw-calibration-access=READ-WRITE, type=Ary2D_u4p12_12_12
    Ary2D_u4p12_13_13_CalPortIf1
      parameter data prototype Ary2D: sw-calibration-access=READ-WRITE, type=Ary2D_u4p12_13_13
    Ary2D_u6p10_12_12_CalPortIf1
      parameter data prototype Ary2D: sw-calibration-access=READ-WRITE, type=Ary2D_u6p10_12_12
    Ary2D_u6p10_13_13_CalPortIf1
      parameter data prototype Ary2D: sw-calibration-access=READ-WRITE, type=Ary2D_u6p10_13_13
    float32_CalPortIf1
      parameter data prototype Val: sw-calibration-access=READ-WRITE, type=float32
package /Nexteer/PortInterfaces
  client server interface GetRefTmr100MicroSec32bit_PortIf1
    operation Oper
      arg RefTmr_Arg: type=uint32, direction=OUT, server-argument-impl-policy=USE-ARGUMENT-TYPE
  client server interface GetTiSpan100MicroSec32bit_PortIf1
    operation Oper
      arg RefTmr_Arg: type=uint32, direction=IN, server-argument-impl-policy=USE-ARGUMENT-TYPE
      arg TiSpan_Arg: type=uint32, direction=OUT, server-argument-impl-policy=USE-ARGUMENT-TYPE
  6 x sender receiver interface:
    BmwHaptcFbIntenNr1_PortIf1: invalidation-policy{data-element=BmwHaptcFbIntenNr1_PortIf1/Val, handle-invalid=DONT-INVALIDATE}
      data Val: sw-calibration-access=READ-ONLY, type=BmwHaptcFbIntenNr1
    BmwHaptcFbPatNr1_PortIf1: invalidation-policy{data-element=BmwHaptcFbPatNr1_PortIf1/Val, handle-invalid=DONT-INVALIDATE}
      data Val: sw-calibration-access=READ-ONLY, type=BmwHaptcFbPatNr1
    boolean_PortIf1: invalidation-policy{data-element=Logl, handle-invalid=DONT-INVALIDATE}
      data Logl: sw-calibration-access=READ-ONLY, type=boolean
    float32_PortIf1: invalidation-policy{data-element=float32_PortIf1/Val, handle-invalid=DONT-INVALIDATE}
      data Val: sw-calibration-access=READ-ONLY, type=float32
    HaptcFbSt1_PortIf1: invalidation-policy{data-element=HaptcFbSt1_PortIf1/Val, handle-invalid=DONT-INVALIDATE}
      data Val: sw-calibration-access=READ-ONLY, type=HaptcFbSt1
    StsSteerAssi1_PortIf1: invalidation-policy{data-element=StsSteerAssi1_PortIf1/Val, handle-invalid=DONT-INVALIDATE}
      data Val: sw-calibration-access=READ-ONLY, type=StsSteerAssi1
