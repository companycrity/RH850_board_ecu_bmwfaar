AUTOSAR XML (schema 4-0-3)
standard types defined: boolean, float32, uint16, uint32, uint8, boolean_CompuMethod, boolean_DataConstr, float32_DataConstr, uint16_DataConstr, uint32_DataConstr, uint8_DataConstr
package /Nexteer/DataTypes
  18 x impl type, all with type-emitter=RTE:
    Ary1D_f32_11: category=ARRAY, sw-calibration-access=READ-ONLY
      element Element: array-size=11, array-size-semantics=FIXED-SIZE, implementation-data-type=float32
    Ary1D_u16_13: category=ARRAY, sw-calibration-access=READ-ONLY
      element Element: array-size=13, array-size-semantics=FIXED-SIZE, implementation-data-type=uint16
    Ary1D_u4p12_12: category=ARRAY, sw-calibration-access=READ-ONLY
      element Element: array-size=12, array-size-semantics=FIXED-SIZE, implementation-data-type=u4p12
    Ary1D_u4p12_13: category=ARRAY, sw-calibration-access=READ-ONLY
      element Element: array-size=13, array-size-semantics=FIXED-SIZE, implementation-data-type=u4p12
    Ary1D_u6p10_12: category=ARRAY, sw-calibration-access=READ-ONLY
      element Element: array-size=12, array-size-semantics=FIXED-SIZE, implementation-data-type=u6p10
    Ary1D_u6p10_13: category=ARRAY, sw-calibration-access=READ-ONLY
      element Element: array-size=13, array-size-semantics=FIXED-SIZE, implementation-data-type=u6p10
    Ary1D_u9p7_12: category=ARRAY, sw-calibration-access=READ-ONLY
      element Element: array-size=12, array-size-semantics=FIXED-SIZE, implementation-data-type=u9p7
    Ary2D_u4p12_12_12: category=ARRAY, sw-calibration-access=READ-ONLY
      element Element: array-size=12, array-size-semantics=FIXED-SIZE, implementation-data-type=Ary1D_u4p12_12
    Ary2D_u4p12_13_13: category=ARRAY, sw-calibration-access=READ-ONLY
      element Element: array-size=13, array-size-semantics=FIXED-SIZE, implementation-data-type=Ary1D_u4p12_13
    Ary2D_u6p10_12_12: category=ARRAY, sw-calibration-access=READ-ONLY
      element Element: array-size=12, array-size-semantics=FIXED-SIZE, implementation-data-type=Ary1D_u6p10_12
    Ary2D_u6p10_13_13: category=ARRAY, sw-calibration-access=READ-ONLY
      element Element: array-size=13, array-size-semantics=FIXED-SIZE, implementation-data-type=Ary1D_u6p10_13
    BmwHaptcFbIntenNr1: compu {0..12=BMWHAPTCFBINTENNR_INTEN0..BMWHAPTCFBINTENNR_INTEN12, 13=BMWHAPTCFBINTENNR_RESD1, 14=BMWHAPTCFBINTENNR_RESD2, 15=BMWHAPTCFBINTENNR_INVLDSIG}, implementation-data-type=uint8
    BmwHaptcFbPatNr1: compu {0=BMWHAPTCFBPATNR_NOHAPTCWARN, 1..10=BMWHAPTCFBPATNR_PAT1..BMWHAPTCFBPATNR_PAT10, 13=BMWHAPTCFBPATNR_FCTIFNOTAVL, 14=BMWHAPTCFBPATNR_FCTRPRTERR, 15=BMWHAPTCFBPATNR_INVLDSIG}, implementation-data-type=uint8
    HaptcFbSt1: compu {1=HAPTCFBST_FCTAVLNOTACTV, 6=HAPTCFBST_ERR, 9=HAPTCFBST_FCTAVLACTV, 14=HAPTCFBST_FCTNOTAVL, 15=HAPTCFBST_INVLDSIG}, implementation-data-type=uint8
    StsSteerAssi1: compu {0=STSSTEERASSI_OFF, 1=STSSTEERASSI_ON}, implementation-data-type=uint8
    u4p12: implementation-data-type=uint16
    u6p10: implementation-data-type=uint16
    u9p7: implementation-data-type=uint16
