AUTOSAR XML (schema 4-0-3)
standard types defined: boolean, float32, uint16, uint32, uint8, boolean_CompuMethod, boolean_DataConstr, float32_DataConstr, uint16_DataConstr, uint32_DataConstr, uint8_DataConstr
package /Nexteer/DataTypes
  5 x impl type, all with category=TYPE_REFERENCE, type-emitter=RTE:
    BmwCogVehSpdQlfr1: compu {1=BMWCOGVEHSPDQLFR_SIGVALVLDANDPLAUS, 8=BMWCOGVEHSPDQLFR_INIT, 10=BMWCOGVEHSPDQLFR_SIGVALTMPVLD, 11=BMWCOGVEHSPDQLFR_SIGQLYMONTMPRSTRCTD, 14=BMWCOGVEHSPDQLFR_SIGVALTMPINVLD, 15=BMWCOGVEHSPDQLFR_INVLD}, implementation-data-type=uint8
    BmwNearStillVehSpdSts1: compu {12=BMWNEARSTILLVEHSPDSTS_VEHREST, 13=BMWNEARSTILLVEHSPDSTS_VEHNOTREST, 15=BMWNEARSTILLVEHSPDSTS_INVLD}, implementation-data-type=uint8
    BmwPinionAgQlfr1: compu {1=BMWPINIONAGQLFR_SIGVALVLDANDPLAUS, 2=BMWPINIONAGQLFR_SIGVALVLD, 4=BMWPINIONAGQLFR_SUBVALSETINUSRSIG, 8=BMWPINIONAGQLFR_INIT, 9=BMWPINIONAGQLFR_SIGVALVLDANDTMPOFAVRGQLY, 10=BMWPINIONAGQLFR_SIGVALVLDANDTMPOFLOQLY, 12=BMWPINIONAGQLFR_ADJMTVALSETINUSRSIG, 14=BMWPINIONAGQLFR_SIGVALINVLDBUTSTTMP, 15=BMWPINIONAGQLFR_INVLDSIG}, implementation-data-type=uint8
    BmwSecurVehSpdSts1: compu {1=BMWSECURVEHSPDSTS_SIGVALVLD, 4=BMWSECURVEHSPDSTS_VEHSTANDG, 12=BMWSECURVEHSPDSTS_VEHRUNNG, 14=BMWSECURVEHSPDSTS_NOINFO, 15=BMWSECURVEHSPDSTS_INVLD}, implementation-data-type=uint8
    u16p0: implementation-data-type=uint16
