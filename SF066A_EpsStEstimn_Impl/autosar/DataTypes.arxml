AUTOSAR XML (schema 4-0-3)
standard types defined: float32, float32_DataConstr
package /Nexteer/DataTypes
  5 x impl type, all with sw-calibration-access=READ-ONLY, type-emitter=RTE:
    Ary1D_f32_3: category=ARRAY
      element Element: array-size=3, array-size-semantics=FIXED-SIZE, implementation-data-type=float32
    Ary1D_f32_5: category=ARRAY
      element Element: array-size=5, array-size-semantics=FIXED-SIZE, implementation-data-type=float32
    Ary2D_f32_5_3: category=ARRAY
      element Element: array-size=5, array-size-semantics=FIXED-SIZE, implementation-data-type=Ary1D_f32_3
    Ary2D_f32_5_5: category=ARRAY
      element Element: array-size=5, array-size-semantics=FIXED-SIZE, implementation-data-type=Ary1D_f32_5
    TorsBarStEstimdRec1: category=STRUCTURE
      5 x element, all with category=TYPE_REFERENCE, implementation-data-type=float32:
        MotVelEstimd
        TorsBarTqEstimd
        TorsBarRotatmEstimd
        DrvrTqEstimd
        RackTqEstimd
      symbol props TorsBarStEstimdRec1
