AUTOSAR XML (schema 4-0-3)
package /Nexteer/Calibrations
  parameter interface Ary2D_f32_5_3_CalPortIf1
    parameter data prototype Ary2D: sw-calibration-access=READ-WRITE, type=Ary2D_f32_5_3
  parameter interface Ary2D_f32_5_5_CalPortIf1
    parameter data prototype Ary2D: sw-calibration-access=READ-WRITE, type=Ary2D_f32_5_5
package /Nexteer/PortInterfaces
  sender receiver interface float32_PortIf1: invalidation-policy{data-element=Val, handle-invalid=DONT-INVALIDATE}
    data Val: sw-calibration-access=READ-ONLY, type=float32
  sender receiver interface TorsBarStEstimdRec1_PortIf1: invalidation-policy{data-element=Rec, handle-invalid=DONT-INVALIDATE}
    data Rec: sw-calibration-access=READ-ONLY, type=TorsBarStEstimdRec1
