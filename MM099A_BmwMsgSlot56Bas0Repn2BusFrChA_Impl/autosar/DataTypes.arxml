AUTOSAR XML (schema 4-0-3)
standard types defined: boolean, dtRef_const_VOID, dtRef_VOID, float32, float64, sint16, sint16_least, sint32, sint32_least, sint64, sint8, sint8_least, uint16, uint16_least, uint32, uint32_least, uint64, uint8, uint8_least, boolean_CompuMethod, boolean_DataConstr, float32_DataConstr, float64_DataConstr, sint16_DataConstr, sint16_least_DataConstr, sint32_DataConstr, sint32_least_DataConstr, sint64_DataConstr, sint8_DataConstr, sint8_least_DataConstr, uint16_DataConstr, uint16_least_DataConstr, uint32_DataConstr, uint32_least_DataConstr, uint64_DataConstr, uint8_DataConstr, uint8_least_DataConstr
package /BMW/SystemDescription/Units
  unit degree_per_second: display-name=°/s, factor-si-to-unit=1, offset-si-to-unit=0
package /DataTypes
  8 x impl type:
    ALIV_VYAW_VEH1: category=VALUE, base-type=uint8, compu {0=Zaehlerstand0DotDotE (ALIV_COU_4_Zaehlerstand0DotDotE) (BNE original name: Zählerstand 0..E), 15=SignalUngueltig (ALIV_COU_4_SignalUngueltig) (BNE original name: Signal ungültig)}
    BmwVehYawQlfr1:
      category=VALUE
      base-type=uint8
      sw-calibration-access=READ-ONLY
      compu {1=BMWVEHYAWQLFR_SIGVALVLDANDPLAUS, 2=BMWVEHYAWQLFR_SIGVALVLD, 3=BMWVEHYAWQLFR_SIGQLTMONRSTRCTD, 4=BMWVEHYAWQLFR_RESD1, 6=BMWVEHYAWQLFR_SIGVALINVLD, 7=BMWVEHYAWQLFR_RESD2, 8=BMWVEHYAWQLFR_ININ, 9=BMWVEHYAWQLFR_SIGVALTMPVLDANDSECUR, 10=BMWVEHYAWQLFR_SIGVALTMPVLD, 11=BMWVEHYAWQLFR_SIGQLTMONTMPRSTRCTD, 12=2 (BMWVEHYAWQLFR_SIGSUBVALTMP), 14=BMWVEHYAWQLFR_SIGVALTMPINVLD, 15=BMWVEHYAWQLFR_INVLDSIG}
      type-emitter=RTE
    CRC_VYAW_VEH1: category=VALUE, base-type=uint8, compu {identical} "Standartabsicherung Apllikations-CRC."
    QU_VYAW_VEH1:
      category=VALUE
      base-type=uint8
      compu {8=Initialisierung (QU_VYAW_VEH_Initialisierung) (Tritt während der Initialisierungsphase auf bis Ist-Wert verfügbar (Vorbefüllung). Nutzsignal wird permanent mit Nutzwert 0 befüllt.), 1=SignalwertIstGueltigUndAbgesichertUndPlausibilisiert (QU_VYAW_VEH_SignalwertIstGueltigUndAbgesichertUndPlausibilisiert) (BNE original name: Signalwert ist gültig und abgesichert und plausibilisiert), 9=SignalwertIstGueltigUndAbgesichertZustandSlashStatusTemporaer (QU_VYAW_VEH_SignalwertIstGueltigUndAbgesichertZustandSlashStatusTemporaer) (BNE original name: Signalwert ist gültig und abgesichert, Zustand/Status temporär), 2=SignalwertIstGueltig (QU_VYAW_VEH_SignalwertIstGueltig) (BNE original name: Signalwert ist gültig), 10=SignalwertIstGueltigZustandSlashStatusTemporaer (QU_VYAW_VEH_SignalwertIstGueltigZustandSlashStatusTemporaer) (BNE original name: Signalwert ist gültig, Zustand/Status temporär), 3=SignalqualitaetBzwDotUeberwachungEingeschraenkt (QU_VYAW_VEH_SignalqualitaetBzwDotUeberwachungEingeschraenkt) (BNE original name: Signalqualität bzw. Überwachung eingeschränkt), 11=SignalqualitaetBzwDotUeberwachungEingeschraenktZustandSlashStatusTemporaer (QU_VYAW_VEH_SignalqualitaetBzwDotUeberwachungEingeschraenktZustandSlashStatusTemporaer) (BNE original name: Signalqualität bzw. Überwachung eingeschränkt, Zustand/Status temporär), 4=Reserved (QU_VYAW_VEH_Reserved), 12=ErsatzwertColonAbgleichwertIstImNutzsignalGesetztZustandSlashStatusTemporaer (QU_VYAW_VEH_ErsatzwertColonAbgleichwertIstImNutzsignalGesetztZustandSlashStatusTemporaer) (BNE original name: Ersatzwert: Abgleichwert ist im Nutzsignal gesetzt, Zustand/Status temporär), 6=SignalwertIstUngueltig (QU_VYAW_VEH_SignalwertIstUngueltig) (BNE original name: Signalwert ist ungültig), 14=SignalwertIstUngueltigZustandSlashStatusTemporaer (QU_VYAW_VEH_SignalwertIstUngueltigZustandSlashStatusTemporaer) (BNE original name: Signalwert ist ungültig, Zustand/Status temporär), 7=Reserved_bne_7C322122A3AD4C1BBA9012320D4729F1_7 (QU_VYAW_VEH_Reserved_bne_7C322122A3AD4C1BBA9012320D4729F1_7) (BNE original name: Reserved), 15=SignalUngueltig (QU_VYAW_VEH_SignalUngueltig) (BNE original name: Signal ungültig)}
    sigGroup_VYAW_VEH1: category=STRUCTURE
      6 x element, all with category=TYPE_REFERENCE:
        QU_VYAW_VEH: range raw 0..15, implementation-data-type=QU_VYAW_VEH1
        VYAW_VEH_ERR_AMP: range phys 0..4000 "Quantisierung ist temporär", implementation-data-type=VYAW_VEH_ERR_AMP1
        VYAW_VEH: range phys 0..65534 "Transp.MOST-GW-Migration, 01.09.2006: Zusammenführung der Signalklasse Giergeschwindigkeit_Fahrzeug [1] mit den Parametern YawVelocityVehicle [1].", implementation-data-type=VYAW_VEH1
        VYAW_VEH_dummy_12_15: range phys 0..15, implementation-data-type=VYAW_VEH_dummy_12_151
        CRC_VYAW_VEH: range phys 0..255 "Standartabsicherung Apllikations-CRC.", implementation-data-type=CRC_VYAW_VEH1
        ALIV_VYAW_VEH: range raw 0..15, implementation-data-type=ALIV_VYAW_VEH1
    VYAW_VEH_dummy_12_151: category=VALUE, base-type=uint8, compu {identical}
    VYAW_VEH_ERR_AMP1: category=VALUE, base-type=uint16, compu {phys=raw*0.0125 for raw 0..320000; unit °/s} "Quantisierung ist temporär"
    VYAW_VEH1: category=VALUE, base-type=uint16, compu {phys=raw*0.005-163.84 for raw 32768..13139568; unit °/s} "Transp.MOST-GW-Migration, 01.09.2006: Zusammenführung der Signalklasse Giergeschwindigkeit_Fahrzeug [1] mit den Parametern YawVelocityVehicle [1]."
package /Nexteer/DataTypes
  impl type NtcNr1: compu {1..511=NTCNR_0X001..NTCNR_0X1FF}, implementation-data-type=uint16, type-emitter=RTE
  impl type NtcSts1: compu {0=NTCSTS_PASSD, 1=NTCSTS_FAILD, 2=NTCSTS_PREPASSD, 3=NTCSTS_PREFAILD}, implementation-data-type=uint8, type-emitter=RTE
