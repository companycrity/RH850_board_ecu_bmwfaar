AUTOSAR XML (schema 4-0-3)
package /Nexteer/PortInterfaces
  client server interface SetNtcSts_PortIf1
    operation Oper: possible-error=E_NOT_OK
      4 x arg, all with direction=IN, server-argument-impl-policy=USE-ARGUMENT-TYPE:
        NtcNr_Arg: type=NtcNr1
        NtcStInfo_Arg: type=uint8
        NtcSts_Arg: type=NtcSts1
        DebStep_Arg: type=uint16
    error E_NOT_OK: error-code=1
  sender receiver interface boolean_PortIf1: invalidation-policy{data-element=Logl, handle-invalid=DONT-INVALIDATE}
    data Logl: sw-calibration-access=READ-ONLY, type=boolean
  sender receiver interface float32_PortIf1: invalidation-policy{data-element=float32_PortIf1/Val, handle-invalid=DONT-INVALIDATE}
    data Val: sw-calibration-access=READ-ONLY, type=float32
package /PortInterfaces
  sender receiver interface BmwVehYawQlfr_PortIf1: invalidation-policy{data-element=BmwVehYawQlfr_PortIf1/Val, handle-invalid=DONT-INVALIDATE}
    data Val: type=BmwVehYawQlfr1
  sender receiver interface sigGroup_VYAW_VEH: invalidation-policy{data-element=sigGroup_VYAW_VEH, handle-invalid=DONT-INVALIDATE}
    data sigGroup_VYAW_VEH: type=sigGroup_VYAW_VEH1
