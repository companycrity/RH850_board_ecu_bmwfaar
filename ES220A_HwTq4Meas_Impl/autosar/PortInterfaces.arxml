AUTOSAR XML (schema 4-0-3)
package /Nexteer/Calibrations
  parameter interface boolean_CalPortIf1
    parameter data prototype Logl: sw-calibration-access=READ-WRITE, type=boolean
  parameter interface float32_CalPortIf1
    parameter data prototype Val: sw-calibration-access=READ-WRITE, type=float32
  parameter interface uint16_CalPortIf1
    parameter data prototype Val: sw-calibration-access=READ-WRITE, type=uint16
package /Nexteer/NvMProxy_swc/Interfaces
  client server interface NvMService_AC3_SRBS: is-service=true
    6 x operation, all with possible-error=NvMService_AC3_SRBS/E_NOT_OK:
      EraseBlock
      GetErrorStatus
        arg ErrorStatus: type=NvM_RequestResultType, direction=OUT, server-argument-impl-policy=USE-ARGUMENT-TYPE
      InvalidateNvBlock
      ReadBlock
        arg DstPtr: type=dtRef_VOID, direction=IN, server-argument-impl-policy=USE-ARGUMENT-TYPE
      SetRamBlockStatus
        arg RamBlockStatus: type=Boolean, direction=IN, server-argument-impl-policy=USE-ARGUMENT-TYPE
      WriteBlock
        arg SrcPtr: type=dtRef_const_VOID, direction=IN, server-argument-impl-policy=USE-ARGUMENT-TYPE
    error E_NOT_OK: error-code=1
package /Nexteer/PortInterfaces
  11 x client server interface:
    GetNtcQlfrSts_PortIf1
      operation Oper: possible-error=GetNtcQlfrSts_PortIf1/E_NOT_OK
        arg NtcNr_Arg: type=NtcNr1, direction=IN, server-argument-impl-policy=USE-ARGUMENT-TYPE
        arg NtcQlfr_Arg: type=SigQlfr1, direction=OUT, server-argument-impl-policy=USE-ARGUMENT-TYPE
      error E_NOT_OK: error-code=1
    HwTqClrSnsrSca_PortIf1
      operation Oper
    HwTqMeasHwTqAutTrim_PortIf1
      operation Oper
    HwTqMeasHwTqClrTrim_PortIf1
      operation Oper
    HwTqMeasHwTqReadTrim_PortIf1
      operation Oper
        arg HwTqReadTrimData_Arg: type=float32, direction=OUT, server-argument-impl-policy=USE-ARGUMENT-TYPE
    HwTqMeasHwTqTrimPrfmdSts_PortIf1
      operation Oper
        arg HwTqOffsTrimPrfmdStsData_Arg: type=boolean, direction=OUT, server-argument-impl-policy=USE-ARGUMENT-TYPE
    HwTqMeasHwTqWrTrim_PortIf1
      operation Oper
        arg HwTqWrOffsTrimData_Arg: type=float32, direction=IN, server-argument-impl-policy=USE-ARGUMENT-TYPE
    HwTqReadSnsrSca_PortIf2
      operation Oper
        arg HwTqReadScaData_Arg: type=float32, direction=OUT, server-argument-impl-policy=USE-ARGUMENT-TYPE
    HwTqSnsrScaPrfmdSts_PortIf1
      operation Oper
        arg HwTqScaPrfmdStsData_Arg: type=boolean, direction=OUT, server-argument-impl-policy=USE-ARGUMENT-TYPE
    HwTqWrSnsrSca_PortIf1
      operation Oper
        arg HwTqScaVal_Arg: type=float32, direction=IN, server-argument-impl-policy=USE-ARGUMENT-TYPE
    SetNtcSts_PortIf1
      operation Oper: possible-error=SetNtcSts_PortIf1/E_NOT_OK
        4 x arg, all with direction=IN, server-argument-impl-policy=USE-ARGUMENT-TYPE:
          NtcNr_Arg: type=NtcNr1
          NtcStInfo_Arg: type=uint8
          NtcSts_Arg: type=NtcSts1
          DebStep_Arg: type=uint16
      error E_NOT_OK: error-code=1
  6 x sender receiver interface:
    Ary1D_f32_8_PortIf1: invalidation-policy{data-element=Ary1D, handle-invalid=DONT-INVALIDATE}
      data Ary1D: sw-calibration-access=READ-ONLY, type=Ary1D_f32_8
    boolean_PortIf1: invalidation-policy{data-element=Logl, handle-invalid=DONT-INVALIDATE}
      data Logl: sw-calibration-access=READ-ONLY, type=boolean
    float32_PortIf1: invalidation-policy{data-element=float32_PortIf1/Val, handle-invalid=DONT-INVALIDATE}
      data Val: sw-calibration-access=READ-ONLY, type=float32
    SigQlfr1: invalidation-policy{data-element=SigQlfr1/Val, handle-invalid=DONT-INVALIDATE}
      data Val: sw-calibration-access=READ-ONLY, type=SigQlfr1
    sint8_PortIf1: invalidation-policy{data-element=sint8_PortIf1/Val, handle-invalid=DONT-INVALIDATE}
      data Val: sw-calibration-access=READ-ONLY, type=sint8
    uint8_PortIf1: invalidation-policy{data-element=uint8_PortIf1/Val, handle-invalid=DONT-INVALIDATE}
      data Val: sw-calibration-access=READ-ONLY, type=uint8
