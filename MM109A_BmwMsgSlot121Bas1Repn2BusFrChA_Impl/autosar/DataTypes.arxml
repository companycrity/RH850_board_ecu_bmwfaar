AUTOSAR XML (schema 4-0-3)
standard types defined: boolean, float32, uint16, uint32, uint8, boolean_CompuMethod, boolean_DataConstr, float32_DataConstr, uint16_DataConstr, uint8_DataConstr
package /DataTypes
  10 x impl type:
    ALIV_CON_VEH1: category=VALUE, base-type=uint8
    CON_VEH_dummy_56_631: category=VALUE, base-type=uint8
    CRC_CON_VEH1: category=VALUE, base-type=uint8
    CTR_BS_PRTNT1:
      category=VALUE
      base-type=uint8
      compu {0=KeineKommunikation (CTR_BS_PRTNT_KeineKommunikation) (BNE original name: Keine Kommunikation), 1=Kom_Parken_BN_niO (CTR_BS_PRTNT_Kom_Parken_BN_niO), 2=Kom_Parken_BN_iO (CTR_BS_PRTNT_Kom_Parken_BN_iO), 3=Kom_Standfunktionen_Kunde_nicht_im_FZG (CTR_BS_PRTNT_Kom_Standfunktionen_Kunde_nicht_im_FZG), 4=reserviert (CTR_BS_PRTNT_reserviert), 5=Kom_Wohnen (CTR_BS_PRTNT_Kom_Wohnen), 6=reserviert_bne_95F305A59796464C872A83A9688DA49E_6 (CTR_BS_PRTNT_reserviert_bne_95F305A59796464C872A83A9688DA49E_6) (BNE original name: reserviert), 7=Kom_Pruefen_Analyse_Diagnose (CTR_BS_PRTNT_Kom_Pruefen_Analyse_Diagnose), 8=Kom_Fahrbereitschaft_herstellen (CTR_BS_PRTNT_Kom_Fahrbereitschaft_herstellen), 9=reserviert_bne_95F305A59796464C872A83A9688DA49E_9 (CTR_BS_PRTNT_reserviert_bne_95F305A59796464C872A83A9688DA49E_9) (BNE original name: reserviert), 10=Kom_Fahren (CTR_BS_PRTNT_Kom_Fahren), 11=reserviert_bne_95F305A59796464C872A83A9688DA49E_11 (CTR_BS_PRTNT_reserviert_bne_95F305A59796464C872A83A9688DA49E_11) (BNE original name: reserviert), 12=Kom_Fahrbereitschaft_beenden (CTR_BS_PRTNT_Kom_Fahrbereitschaft_beenden), 13=reserviert_bne_95F305A59796464C872A83A9688DA49E_13 (CTR_BS_PRTNT_reserviert_bne_95F305A59796464C872A83A9688DA49E_13) (BNE original name: reserviert), 14=reserviert_bne_95F305A59796464C872A83A9688DA49E_14 (CTR_BS_PRTNT_reserviert_bne_95F305A59796464C872A83A9688DA49E_14) (BNE original name: reserviert), 15=Signal_unbefuellt (CTR_BS_PRTNT_Signal_unbefuellt)}
    CTR_FKTN_PRTNT1: category=VALUE, base-type=uint32
    QU_ST_CON_VEH1:
      category=VALUE
      base-type=uint8
      compu {2=SignalwertGueltig (QU_ST_CON_VEH_SignalwertGueltig) (BNE original name: Signalwert gültig), 3=SignalwertEingeschraenktGueltig (QU_ST_CON_VEH_SignalwertEingeschraenktGueltig) (BNE original name: Signalwert eingeschränkt gültig), 6=ReserviertFuerDieNichtUmgesetzteKennung_Fehler_ (QU_ST_CON_VEH_ReserviertFuerDieNichtUmgesetzteKennung_Fehler_) (BNE original name: Reserviert für die nicht umgesetzte Kennung "Fehler"), 14=Wert_nicht_verfuegbar (QU_ST_CON_VEH_Wert_nicht_verfuegbar) (Siehe Signalbeschreibung), 15=SignalUnbefuellt (QU_ST_CON_VEH_SignalUnbefuellt) (BNE original name: Signal unbefüllt)}
    QU_V_VEH_COG1:
      category=VALUE
      base-type=uint8
      compu {8=Initialisierung (QU_V_VEH_COG_Initialisierung) (Tritt während der Initialisierungsphase auf bis Ist-Wert verfügbar (Vorbefüllung). Nutzsignal wird permanent mit Nutzwert 0 befüllt.), 1=SignalwertIstGueltigUndAbgesichertUndPlausibilisiert (QU_V_VEH_COG_SignalwertIstGueltigUndAbgesichertUndPlausibilisiert) (BNE original name: Signalwert ist gültig und abgesichert und plausibilisiert), 9=Reserved (QU_V_VEH_COG_Reserved), 2=Reserved_bne_C9CB853E97D84E34ADF2107B01966081_2 (QU_V_VEH_COG_Reserved_bne_C9CB853E97D84E34ADF2107B01966081_2) (BNE original name: Reserved), 10=SignalwertIstGueltigZustandSlashStatusTemporaer (QU_V_VEH_COG_SignalwertIstGueltigZustandSlashStatusTemporaer) (BNE original name: Signalwert ist gültig, Zustand/Status temporär), 3=Reserved_bne_C9CB853E97D84E34ADF2107B01966081_3 (QU_V_VEH_COG_Reserved_bne_C9CB853E97D84E34ADF2107B01966081_3) (BNE original name: Reserved), 11=SignalqualitaetBzwDotUeberwachungEingeschraenktZustandSlashStatusTemporaer (QU_V_VEH_COG_SignalqualitaetBzwDotUeberwachungEingeschraenktZustandSlashStatusTemporaer) (BNE original name: Signalqualität bzw. Überwachung eingeschränkt, Zustand/Status temporär), 4=Reserved_bne_C9CB853E97D84E34ADF2107B01966081_4 (QU_V_VEH_COG_Reserved_bne_C9CB853E97D84E34ADF2107B01966081_4) (BNE original name: Reserved), 12=Reserved_bne_C9CB853E97D84E34ADF2107B01966081_12 (QU_V_VEH_COG_Reserved_bne_C9CB853E97D84E34ADF2107B01966081_12) (BNE original name: Reserved), 6=Reserved_bne_C9CB853E97D84E34ADF2107B01966081_6 (QU_V_VEH_COG_Reserved_bne_C9CB853E97D84E34ADF2107B01966081_6) (BNE original name: Reserved), 14=SignalwertIstUngueltigZustandSlashStatusTemporaer (QU_V_VEH_COG_SignalwertIstUngueltigZustandSlashStatusTemporaer) (BNE original name: Signalwert ist ungültig, Zustand/Status temporär), 7=Reserved_bne_C9CB853E97D84E34ADF2107B01966081_7 (QU_V_VEH_COG_Reserved_bne_C9CB853E97D84E34ADF2107B01966081_7) (BNE original name: Reserved), 15=SignalUngueltig (QU_V_VEH_COG_SignalUngueltig) (BNE original name: Signal ungültig)}
    sigGroup_CON_VEH1: category=STRUCTURE
      7 x element, all with category=TYPE_REFERENCE:
        CTR_FKTN_PRTNT: implementation-data-type=CTR_FKTN_PRTNT1
        QU_ST_CON_VEH: range raw 0..15, implementation-data-type=QU_ST_CON_VEH1
        CRC_CON_VEH: range phys 0..255 "Standartabsicherung Apllikations-CRC.", implementation-data-type=CRC_CON_VEH1
        ST_CON_VEH: range raw 0..15, implementation-data-type=ST_CON_VEH1
        CTR_BS_PRTNT: range raw 0..15, implementation-data-type=CTR_BS_PRTNT1
        ALIV_CON_VEH: range phys 0..14, implementation-data-type=ALIV_CON_VEH1
        CON_VEH_dummy_56_63: range phys 0..255, implementation-data-type=CON_VEH_dummy_56_631
    ST_CON_VEH1:
      category=VALUE
      base-type=uint8
      compu {0=reserviert (ST_CON_VEH_reserviert), 1=Parken_BN_niO (ST_CON_VEH_Parken_BN_niO), 2=Parken_BN_iO (ST_CON_VEH_Parken_BN_iO), 3=Standfunktionen_Kunde_nicht_im_FZG (ST_CON_VEH_Standfunktionen_Kunde_nicht_im_FZG), 5=Wohnen (ST_CON_VEH_Wohnen), 7=Pruefen_Analyse_Diagnose (ST_CON_VEH_Pruefen_Analyse_Diagnose), 8=Fahrbereitschaft_herstellen (ST_CON_VEH_Fahrbereitschaft_herstellen), 10=Fahren (ST_CON_VEH_Fahren), 12=Fahrbereitschaft_beenden (ST_CON_VEH_Fahrbereitschaft_beenden), 13=reserviert_bne_E673DEE4F91F432391662F6004C0175A_13 (ST_CON_VEH_reserviert_bne_E673DEE4F91F432391662F6004C0175A_13) (BNE original name: reserviert), 14=reserviert_bne_E673DEE4F91F432391662F6004C0175A_14 (ST_CON_VEH_reserviert_bne_E673DEE4F91F432391662F6004C0175A_14) (BNE original name: reserviert), 15=Signal_unbefuellt (ST_CON_VEH_Signal_unbefuellt)}
    ST_V_VEH_NSS1:
      category=VALUE
      base-type=uint8
      compu {12=FahrzeugImStillstandsnahenBereich (ST_V_VEH_NSS_FahrzeugImStillstandsnahenBereich) (BNE original name: Fahrzeug im stillstandsnahen Bereich), 13=FahrzeugNichtImStillstandsnahenBereich (ST_V_VEH_NSS_FahrzeugNichtImStillstandsnahenBereich) (BNE original name: Fahrzeug nicht im stillstandsnahen Bereich), 15=SignalUngueltig (ST_V_VEH_NSS_SignalUngueltig) (BNE original name: Signal ungültig)}
package /Nexteer/DataTypes
  7 x impl type, all with category=TYPE_REFERENCE, type-emitter=RTE:
    BmwBasPtlNetCtrl1: compu {0=NoCommunication, 1=ParkingNotOk, 2=ParkingOk, 3=StandingFunctions, 5=Living, 7=CheckDiagnosticAnalysis, 8=DriverPreparingforOperation, 10=Driving, 12=DriverPreparingToExitOperation, 15=Invalid}, implementation-data-type=ImplementationDataTypes/uint8
    BmwCogVehSpdQlfr1: compu {1=SigValVldAndPlaus, 8=Init, 10=SigValTmpVld, 11=SigQlyMonTmpRstrctd, 14=SigValTmpInvld, 15=Invld}, implementation-data-type=ImplementationDataTypes/uint8
    BmwNearStillVehSpdSts1: compu {12=VehRest, 13=VehNotRest, 15=Invld}, implementation-data-type=ImplementationDataTypes/uint8
    BmwVehCdn1: compu {1=ParkingNotOk, 2=ParkingOk, 3=StandingFunctions, 5=Living, 7=CheckDiagnosticAnalysis, 8=DriverPreparingforOperation, 10=Driving, 12=DriverPreparingToExitOperation, 15=Invalid}, implementation-data-type=ImplementationDataTypes/uint8
    BmwVehCdnQlfr1: compu {2=SignalValueIsValid, 3=SignalValueIsValidButRestricted, 14=ValueNotAvaliable, 15=UnfulfilledSignal}, implementation-data-type=ImplementationDataTypes/uint8
    NtcNr1: compu {1..511=NTCNR_0X001..NTCNR_0X1FF}, implementation-data-type=PlatformTypes/uint16
    NtcSts1: compu {0=NTCSTS_PASSD, 1=NTCSTS_FAILD, 2=NTCSTS_PREPASSD, 3=NTCSTS_PREFAILD}, implementation-data-type=PlatformTypes/uint8
package /Nexteer/Units
  unit Uls: display-name=Uls, factor-si-to-unit=1, offset-si-to-unit=0
