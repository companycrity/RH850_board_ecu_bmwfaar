AUTOSAR XML (schema 4-0-3)
package /Nexteer/PortInterfaces
  client server interface CON_VEH_Missing_PortIf1
    operation Oper
  client server interface CON_VEH_Received_PortIf1
    operation Oper
  client server interface SetNtcSts_PortIf1
    operation Oper: possible-error=E_NOT_OK
      4 x arg, all with direction=IN, server-argument-impl-policy=USE-ARGUMENT-TYPE:
        NtcNr_Arg: type=NtcNr1
        NtcStInfo_Arg: type=uint8
        NtcSts_Arg: type=NtcSts1
        DebStep_Arg: type=uint16
    error E_NOT_OK: error-code=1
  sender receiver interface boolean_PortIf1: invalidation-policy{data-element=Logl, handle-invalid=DONT-INVALIDATE}
    data Logl: sw-calibration-access=READ-ONLY, type=boolean
package /PortInterfaces
  4 x sender receiver interface:
    BmwBasPtlNetCtrl_PortIf1: invalidation-policy{data-element=BmwBasPtlNetCtrl_PortIf1/Val, handle-invalid=DONT-INVALIDATE}
      data Val: type=BmwBasPtlNetCtrl1
    BmwVehCdn_PortIf1: invalidation-policy{data-element=BmwVehCdn_PortIf1/Val, handle-invalid=DONT-INVALIDATE}
      data Val: type=BmwVehCdn1
    BmwVehCdnQlfr_PortIf1: invalidation-policy{data-element=BmwVehCdnQlfr_PortIf1/Val, handle-invalid=DONT-INVALIDATE}
      data Val: type=BmwVehCdnQlfr1
    sigGroup_CON_VEH: invalidation-policy{data-element=sigGroup_CON_VEH, handle-invalid=DONT-INVALIDATE}
      data sigGroup_CON_VEH: type=sigGroup_CON_VEH1
