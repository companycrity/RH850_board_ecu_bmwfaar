AUTOSAR XML (schema 4-0-3)
package /Nexteer/PortInterfaces
  client server interface CtrlErrOut_PortIf1
    operation Oper
      arg PinSt_Arg: type=boolean, direction=IN
      arg TrigReg_Arg: type=TrigReg1, direction=IN
