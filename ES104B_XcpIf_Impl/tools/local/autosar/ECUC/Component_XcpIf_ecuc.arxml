AUTOSAR XML (schema 4-0-3)
package /ActiveEcuC
  module config XcpIf: implementation-config-variant=VARIANT-PRE-COMPILE
    XcpDriverAbstratction: XcpOsApplicationRef=Appl10
      Constants
        CommandErrorCodes:
          XCPIF_ERRCMDSYNC_CNT_U08 = XCP_ERR_CMD_SYNCH
          XCPIF_ERRCMDBUSY_CNT_U08 = XCP_ERR_CMD_BUSY
          XCPIF_ERRDAQACTV_CNT_U08 = XCP_ERR_DAQ_ACTIVE
          XCPIF_ERRPRMACTV_CNT_U08 = XCP_ERR_PRM_ACTIVE
          XCPIF_ERRCMDUKWN_CNT_U08 = XCP_ERR_CMD_UNKNOWN
          XCPIF_ERRCMDSYNTAX_CNT_U08 = XCP_ERR_CMD_SYNTAX
          XCPIF_ERROUTOFRNG_CNT_U08 = XCP_ERR_OUT_OF_RANGE
          XCPIF_ERRWRPROTD_CNT_U08 = XCP_ERR_WRITE_PROTECTED
          XCPIF_ERRACSDENIED_CNT_U08 = XCP_ERR_ACCESS_DENIED
          XCPIF_ERRACSLOCKD_CNT_U08 = XCP_ERR_ACCESS_LOCKED
          XCPIF_ERRPAGENOTVLD_CNT_U08 = XCP_ERR_PAGE_NOT_VALID
          XCPIF_ERRPAGEMODNOTVLD_CNT_U08 = XCP_ERR_PAGE_MODE_NOT_VALID
          XCPIF_ERRSEGNOTVLD_CNT_U08 = XCP_ERR_SEGMENT_NOT_VALID
          XCPIF_ERRSEQ_CNT_U08 = XCP_ERR_SEQUENCE
          XCPIF_ERRDATAACQNCFG_CNT_U08 = XCP_ERR_DAQ_CONFIG
          XCPIF_ERRMEMOVF_CNT_U08 = XCP_ERR_MEMORY_OVERFLOW
          XCPIF_ERRGEN_CNT_U08 = XCP_ERR_GENERIC
          XCPIF_ERRVRFY_CNT_U08 = XCP_ERR_VERIFY
          XCPIF_ERRRSRCTMPNOTAVL_CNT_U08 = XCP_ERR_RESOURCE_TEMP_NOT_ACCESSIBLE
        CommandReturnCodes:
          XCPIF_RTNCMDSYNC_CNT_U08 = XCP_CRC_CMD_SYNCH
          XCPIF_RTNCMDBUSY_CNT_U08 = XCP_CRC_CMD_BUSY
          XCPIF_RTNDAQACTV_CNT_U08 = XCP_CRC_DAQ_ACTIVE
          XCPIF_RTNPRMACTV_CNT_U08 = XCP_CRC_PRM_ACTIVE
          XCPIF_RTNCMDUKWN_CNT_U08 = XCP_CRC_CMD_UNKNOWN
          XCPIF_RTNCMDSYNTAX_CNT_U08 = XCP_CRC_CMD_SYNTAX
          XCPIF_RTNOUTOFRNG_CNT_U08 = XCP_CRC_OUT_OF_RANGE
          XCPIF_RTNWRPROTD_CNT_U08 = XCP_CRC_WRITE_PROTECTED
          XCPIF_RTNACSDENIED_CNT_U08 = XCP_CRC_ACCESS_DENIED
          XCPIF_RTNACSLOCKD_CNT_U08 = XCP_CRC_ACCESS_LOCKED
          XCPIF_RTNPAGENOTVLD_CNT_U08 = XCP_CRC_PAGE_NOT_VALID
          XCPIF_RTNPAGEMODNOTVLD_CNT_U08 = XCP_CRC_PAGE_MODE_NOT_VALID
          XCPIF_RTNSEGNOTVLD_CNT_U08 = XCP_CRC_SEGMENT_NOT_VALID
          XCPIF_RTNSEQ_CNT_U08 = XCP_CRC_SEQUENCE
          XCPIF_RTNDATAACQNCFG_CNT_U08 = XCP_CRC_DAQ_CONFIG
          XCPIF_RTNMEMOVF_CNT_U08 = XCP_CRC_MEMORY_OVERFLOW
          XCPIF_RTNGEN_CNT_U08 = XCP_CRC_GENERIC
          XCPIF_RTNVRFY_CNT_U08 = XCP_CRC_VERIFY
          XCPIF_RTNRSRCTMPNOTAVL_CNT_U08 = XCP_CRC_RESOURCE_TEMP_NOT_ACCESSIBLE
        ReturnValues:
          XCPIF_CMDOK_CNT_U08 = XCP_CMD_OK
          XCPIF_CMDPND_CNT_U08 = XCP_CMD_PENDING
          XCPIF_CMDBUSY_CNT_U08 = XCP_CMD_BUSY
          XCPIF_CMDUKWN_CNT_U08 = XCP_CMD_UNKNOWN
          XCPIF_CMDSYNTAX_CNT_U08 = XCP_CMD_SYNTAX
          XCPIF_CMDOUTOFRNG_CNT_U08 = XCP_CMD_OUT_OF_RANGE
          XCPIF_CMDPROTD_CNT_U08 = XCP_CMD_PROTECTED
          XCPIF_CMDDENIED_CNT_U08 = XCP_CMD_DENIED
          XCPIF_CMDERR_CNT_U08 = XCP_CMD_ERROR
      Configurations
        DataAcquisition: XcpEventFunctionName=Xcp_Event
        XcpUserFunction: ResponseBuffer=Xcp_ChannelInfo[XCP_CHANNEL_IDX].ResponseFrame.b, ResponseBufferLength=Xcp_ChannelInfo[XCP_CHANNEL_IDX].ResponseFrameLength
        OnlineCalibration: XCPIF_FLSPAGE_CNT_U08=0, XCPIF_RAMPAGE_CNT_U08=1, XCPIF_MAXCALSEG_CNT_U08=XCP_MAX_SEGMENT, XCPIF_MAXCALPAGE_CNT_U08=XCP_MAX_PAGES
          XcpAccessModes: XCPIF_ONLINECALNOACS_CNT_U08=0, XCPIF_ONLINECALECUACS_CNT_U08=1, XCPIF_ONLINECALXCPACS_CNT_U08=2, XCPIF_ONLINECALXCPANDECUACS_CNT_U08=3
        XcpFlashAccess: XCPIF_MAXFLSADR_CNT_U32=0x1FFFF
        XcpControl:
          XCPIF_XCPCTRLDI_CNT_U08 = kXcp_Control_Disable
          XCPIF_XCPCTRLENA_CNT_U08 = kXcp_Control_Enable
          XcpDisableMacro = XCP_DEACTIVATE
          XcpEnableMacro = XCP_ACTIVATE
