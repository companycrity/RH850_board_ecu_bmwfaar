AUTOSAR XML (schema 4-0-3)
package /Nexteer/EcucDefs_XcpIf
  ecuc definition collection NexteerParameterDefinition_XcpIf: module=XcpIf
  module definition XcpIf [0..1]: category=VENDOR_SPECIFIC_MODULE_DEFINITION, refined-module-def=XcpIf, variants pre-compile  # Settings for the XCP Interface component
    container XcpDriverAbstratction  # Container that maps XCP driver errors to the XcpIf component. Default values match that of the 1.0.0 version of the XCP driver for AR4.0.3.
      string XcpIfIncludes [0..65535]: origin=Nexteer  # List of header files to be included.
      symbolic name reference XcpOsApplicationRef: destination=OsApplication  # Xcp Os Application | This defines the application in which the Vector Xcp driver is integrated.
      container Constants  # Abstraction for XCP driver constants.
        container CommandErrorCodes  # Mapping for XCP command error codes.
          string XCPIF_ERRCMDSYNC_CNT_U08: origin=NEXTEER, default-value=XCP_ERR_CMD_SYNCH
          string XCPIF_ERRCMDBUSY_CNT_U08: origin=NEXTEER, default-value=XCP_ERR_CMD_BUSY
          string XCPIF_ERRDAQACTV_CNT_U08: origin=NEXTEER, default-value=XCP_ERR_DAQ_ACTIVE
          string XCPIF_ERRPRMACTV_CNT_U08: origin=NEXTEER, default-value=XCP_ERR_PRM_ACTIVE
          string XCPIF_ERRCMDUKWN_CNT_U08: origin=NEXTEER, default-value=XCP_ERR_CMD_UNKNOWN
          string XCPIF_ERRCMDSYNTAX_CNT_U08: origin=NEXTEER, default-value=XCP_ERR_CMD_SYNTAX
          string XCPIF_ERROUTOFRNG_CNT_U08: origin=NEXTEER, default-value=XCP_ERR_OUT_OF_RANGE
          string XCPIF_ERRWRPROTD_CNT_U08: origin=NEXTEER, default-value=XCP_ERR_WRITE_PROTECTED
          string XCPIF_ERRACSDENIED_CNT_U08: origin=NEXTEER, default-value=XCP_ERR_ACCESS_DENIED
          string XCPIF_ERRACSLOCKD_CNT_U08: origin=NEXTEER, default-value=XCP_ERR_ACCESS_LOCKED
          string XCPIF_ERRPAGENOTVLD_CNT_U08: origin=NEXTEER, default-value=XCP_ERR_PAGE_NOT_VALID
          string XCPIF_ERRPAGEMODNOTVLD_CNT_U08: origin=NEXTEER, default-value=XCP_ERR_PAGE_MODE_NOT_VALID
          string XCPIF_ERRSEGNOTVLD_CNT_U08: origin=NEXTEER, default-value=XCP_ERR_SEGMENT_NOT_VALID
          string XCPIF_ERRSEQ_CNT_U08: origin=NEXTEER, default-value=XCP_ERR_SEQUENCE
          string XCPIF_ERRDATAACQNCFG_CNT_U08: origin=NEXTEER, default-value=XCP_ERR_DAQ_CONFIG
          string XCPIF_ERRMEMOVF_CNT_U08: origin=NEXTEER, default-value=XCP_ERR_MEMORY_OVERFLOW
          string XCPIF_ERRGEN_CNT_U08: origin=NEXTEER, default-value=XCP_ERR_GENERIC
          string XCPIF_ERRVRFY_CNT_U08: origin=NEXTEER, default-value=XCP_ERR_VERIFY
          string XCPIF_ERRRSRCTMPNOTAVL_CNT_U08: origin=NEXTEER, default-value=XCP_ERR_RESOURCE_TEMP_NOT_ACCESSIBLE
        container CommandReturnCodes  # Mapping for XCP command return codes.
          string XCPIF_RTNCMDSYNC_CNT_U08: origin=NEXTEER, default-value=XCP_CRC_CMD_SYNCH
          string XCPIF_RTNCMDBUSY_CNT_U08: origin=NEXTEER, default-value=XCP_CRC_CMD_BUSY
          string XCPIF_RTNDAQACTV_CNT_U08: origin=NEXTEER, default-value=XCP_CRC_DAQ_ACTIVE
          string XCPIF_RTNPRMACTV_CNT_U08: origin=NEXTEER, default-value=XCP_CRC_PRM_ACTIVE
          string XCPIF_RTNCMDUKWN_CNT_U08: origin=NEXTEER, default-value=XCP_CRC_CMD_UNKNOWN
          string XCPIF_RTNCMDSYNTAX_CNT_U08: origin=NEXTEER, default-value=XCP_CRC_CMD_SYNTAX
          string XCPIF_RTNOUTOFRNG_CNT_U08: origin=NEXTEER, default-value=XCP_CRC_OUT_OF_RANGE
          string XCPIF_RTNWRPROTD_CNT_U08: origin=NEXTEER, default-value=XCP_CRC_WRITE_PROTECTED
          string XCPIF_RTNACSDENIED_CNT_U08: origin=NEXTEER, default-value=XCP_CRC_ACCESS_DENIED
          string XCPIF_RTNACSLOCKD_CNT_U08: origin=NEXTEER, default-value=XCP_CRC_ACCESS_LOCKED
          string XCPIF_RTNPAGENOTVLD_CNT_U08: origin=NEXTEER, default-value=XCP_CRC_PAGE_NOT_VALID
          string XCPIF_RTNPAGEMODNOTVLD_CNT_U08: origin=NEXTEER, default-value=XCP_CRC_PAGE_MODE_NOT_VALID
          string XCPIF_RTNSEGNOTVLD_CNT_U08: origin=NEXTEER, default-value=XCP_CRC_SEGMENT_NOT_VALID
          string XCPIF_RTNSEQ_CNT_U08: origin=NEXTEER, default-value=XCP_CRC_SEQUENCE
          string XCPIF_RTNDATAACQNCFG_CNT_U08: origin=NEXTEER, default-value=XCP_CRC_DAQ_CONFIG
          string XCPIF_RTNMEMOVF_CNT_U08: origin=NEXTEER, default-value=XCP_CRC_MEMORY_OVERFLOW
          string XCPIF_RTNGEN_CNT_U08: origin=NEXTEER, default-value=XCP_CRC_GENERIC
          string XCPIF_RTNVRFY_CNT_U08: origin=NEXTEER, default-value=XCP_CRC_VERIFY
          string XCPIF_RTNRSRCTMPNOTAVL_CNT_U08: origin=NEXTEER, default-value=XCP_CRC_RESOURCE_TEMP_NOT_ACCESSIBLE
        container ReturnValues  # Mapping for XCP return values.
          string XCPIF_CMDOK_CNT_U08: origin=NEXTEER, default-value=XCP_CMD_OK
          string XCPIF_CMDPND_CNT_U08: origin=NEXTEER, default-value=XCP_CMD_PENDING
          string XCPIF_CMDBUSY_CNT_U08: origin=NEXTEER, default-value=XCP_CMD_BUSY
          string XCPIF_CMDUKWN_CNT_U08: origin=NEXTEER, default-value=XCP_CMD_UNKNOWN
          string XCPIF_CMDSYNTAX_CNT_U08: origin=NEXTEER, default-value=XCP_CMD_SYNTAX
          string XCPIF_CMDOUTOFRNG_CNT_U08: origin=NEXTEER, default-value=XCP_CMD_OUT_OF_RANGE
          string XCPIF_CMDPROTD_CNT_U08: origin=NEXTEER, default-value=XCP_CMD_PROTECTED
          string XCPIF_CMDDENIED_CNT_U08: origin=NEXTEER, default-value=XCP_CMD_DENIED
          string XCPIF_CMDERR_CNT_U08: origin=NEXTEER, default-value=XCP_CMD_ERROR
      container Configurations  # Abstraction for XCP driver configuration values.
        container DataAcquisition  # Configuration settings for data acquisition.
          string XcpEventFunctionName: origin=NEXTEER, default-value=Xcp_Event  # Creates a macro definition of XCPIF_XCPEVE(x) [XcpEventFunctionName](x)
        container XcpUserFunction  # Configuration settings for XCP user functions.
          string ResponseBuffer: origin=NEXTEER, default-value=Xcp_ChannelInfo[0].ResponseFrame.b  # Creates a macro definition for XCPIF_RESPBUF_CNT_U08.
          string ResponseBufferLength: origin=NEXTEER, default-value=Xcp_ChannelInfo[0].ResponseFrameLength  # Creates a macro definition for XCPIF_RESPBUFLEN_CNT_U08.
        container OnlineCalibration  # Configuration settings for XCP online calibration functions.
          string XCPIF_MAXCALSEG_CNT_U08: origin=NEXTEER, default-value=XCP_MAX_SEGMENT
          string XCPIF_MAXCALPAGE_CNT_U08: origin=NEXTEER, default-value=XCP_MAX_PAGES
          integer XCPIF_FLSPAGE_CNT_U08: 0..1, origin=NEXTEER, default-value=0  # This index is for the flash page. Typically this is a value of 0.
          integer XCPIF_RAMPAGE_CNT_U08: 0..1, origin=NEXTEER, default-value=1  # This index is for the RAM page. Typically this is a value of 1.
          container XcpAccessModes  # Mapping for XCP and ECU access modes.
            integer XCPIF_ONLINECALNOACS_CNT_U08: 0..0, origin=NEXTEER, default-value=0  # Removes XCP and ECU access from the page.
            integer XCPIF_ONLINECALECUACS_CNT_U08: 1..1, origin=NEXTEER, default-value=1  # Grants ECU access to the page.
            integer XCPIF_ONLINECALXCPACS_CNT_U08: 2..2, origin=NEXTEER, default-value=2  # Grants XCP access to the page.
            integer XCPIF_ONLINECALXCPANDECUACS_CNT_U08: 3..3, origin=NEXTEER, default-value=3  # Grants XCP access to the page.
        container XcpFlashAccess  # Configuration settings for XCP flash access.
          string XCPIF_MAXFLSADR_CNT_U32: origin=NEXTEER, default-value=#error Define XCPIF_MAXFLSADR_CNT_U32  # Symbol or value for the max flash address size. If using a value, place the appropiate suffix at the end such "UL" or "U".
        container XcpControl  # Configuration settings for XCP control.
          string XCPIF_XCPCTRLDI_CNT_U08: origin=NEXTEER, default-value=kXcp_Control_Disable  # Symbol for XCP disable value.
          string XCPIF_XCPCTRLENA_CNT_U08: origin=NEXTEER, default-value=kXcp_Control_Enable  # Symbol for XCP enable value.
          string XcpDisableMacro: origin=NEXTEER, default-value=XCP_DEACTIVATE  # XCP Control disable macro. Defines XCPIF_XCPCNTRLDI() [XcpDisableMacro]() .
          string XcpEnableMacro: origin=NEXTEER, default-value=XCP_ACTIVATE  # XCP Control disable macro. Defines XCPIF_XCPCNTRLENA() [XcpDisableMacro]() .
  bsw implementation XcpIf_Impl: programming-language=C, ar-release-version=4.0.3
