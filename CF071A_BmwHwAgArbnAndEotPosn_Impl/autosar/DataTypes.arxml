AUTOSAR XML (schema 4-0-3)
standard types defined: boolean, float32, sint32, sint8, uint16, uint32, uint8, boolean_CompuMethod, boolean_DataConstr, float32_DataConstr, sint32_DataConstr, sint8_DataConstr, uint16_DataConstr, uint32_DataConstr, uint8_DataConstr, Boolean, dtRef_const_VOID, dtRef_VOID
package /Nexteer/DataTypes
  13 x impl type:
    BmwMotAgSelnSt1: compu {2=BMWMOTAGSELNST_OFFSCMPD, 4=BMWMOTAGSELNST_SUBVAL, 8=BMWMOTAGSELNST_INI, 10=BMWMOTAGSELNST_TMPCMPD, 12=BMWMOTAGSELNST_OFFSCORRN, 14=BMWMOTAGSELNST_SIGINVLD, 15=BMWMOTAGSELNST_INVLD}, implementation-data-type=uint8, type-emitter=RTE
    BmwPinionAgOffsSts1: compu {1=BMWPINIONAGOFFSSTS_VLD, 2=BMWPINIONAGOFFSSTS_FCTIFNOTAVL, 3=BMWPINIONAGOFFSSTS_FCTRPRTERR, 4=BMWPINIONAGOFFSSTS_INVLD}, implementation-data-type=uint8, type-emitter=RTE
    BmwPinionAgQlfr1: compu {1=BMWPINIONAGQLFR_SIGVALVLDANDPLAUS, 2=BMWPINIONAGQLFR_SIGVALVLD, 4=BMWPINIONAGQLFR_SUBVALSETINUSRSIG, 8=BMWPINIONAGQLFR_INIT, 9=BMWPINIONAGQLFR_SIGVALVLDANDTMPOFAVRGQLY, 10=BMWPINIONAGQLFR_SIGVALVLDANDTMPOFLOQLY, 12=BMWPINIONAGQLFR_ADJMTVALSETINUSRSIG, 14=BMWPINIONAGQLFR_SIGVALINVLDBUTSTTMP, 15=BMWPINIONAGQLFR_INVLDSIG}, implementation-data-type=uint8, type-emitter=RTE
    BmwQuadOffsSts1:
      compu {0=BMWQUADOFFSSTS_ALGSLEEP, 1=BMWQUADOFFSSTS_OFFSKWN, 2=BMWQUADOFFSSTS_OFFSBYIDX, 3=BMWQUADOFFSSTS_OFFSBYMDLCOMP, 4=BMWQUADOFFSSTS_OFFSPOSNGBYSTRTSTOP, 5=BMWQUADOFFSSTS_OFFSPOSNGBYSUMCTRLAG, 6=BMWQUADOFFSSTS_OFFSINTEST, 7=BMWQUADOFFSSTS_CORROFFS, 8=BMWQUADOFFSSTS_ININ, 9=BMWQUADOFFSSTS_RSTOFFSKWN, 11=BMWQUADOFFSSTS_OFFSBYMDL, 15=BMWQUADOFFSSTS_INVLD}
      implementation-data-type=uint8
      type-emitter=RTE
    BmwRackToVehCentrOffsSts1: compu {0=BMWRACKTOVEHCENTROFFSSTS_RACKTOVEHCENTRINVLD, 1=BMWRACKTOVEHCENTROFFSSTS_RACKTOVEHCENTRLRND, 2=BMWRACKTOVEHCENTROFFSSTS_RACKTOVEHCENTRUNLRND}, implementation-data-type=uint8, type-emitter=RTE
    BmwSetVehCentrOffsSts1: compu {0=BMWVEHCENTROFFSSTS_OFFSPRFMD, 1=BMWVEHCENTROFFSSTS_OFFSFAILD, 2=BMWVEHCENTROFFSSTS_OFFSFAILDVALOUTOFRNG}, implementation-data-type=uint8, type-emitter=RTE
    BmwVehCentrOffsRec1: category=STRUCTURE, sw-calibration-access=READ-ONLY, type-emitter=RTE
      10 x element, all with category=TYPE_REFERENCE:
        BmwRackCentrToVehCentrOffs: implementation-data-type=float32
        VehCentrOffs: implementation-data-type=float32
        BmwPinionAgOffs: implementation-data-type=float32
        BmwQuadRotorOffs: implementation-data-type=sint8
        TurnCntrCorrlnSts: implementation-data-type=uint8
        Ntc8CSts: implementation-data-type=uint8
        Ntc8ESts: implementation-data-type=uint8
        BmwMotAgSelnSt: implementation-data-type=uint8
        LongTermVehCentrCmpl: implementation-data-type=boolean
        RackCentrToVehCentrOffsVld: implementation-data-type=boolean
    BmwVehSpdSts1: compu {1=BMWVEHSPDSTS_VLD, 4=BMWVEHSPDSTS_SUBVALSETINUSFLSIGVEHSTANDG, 12=BMWVEHSPDSTS_SUBVALSETINUSFLSIGVEHRUNNG, 14=BMWVEHSPDSTS_SUBVALSETINUSRSIGNOINFO, 15=BMWVEHSPDSTS_INVLD}, implementation-data-type=uint8, type-emitter=RTE
    FilLpRec1: category=STRUCTURE, sw-calibration-access=READ-ONLY, type-emitter=NxtrFil
      element FilSt: implementation-data-type=float32
      element FilGain: implementation-data-type=float32
      symbol props FilLpRec1
    NtcNr1: compu {1..511=NTCNR_0X001..NTCNR_0X1FF}, implementation-data-type=uint16, type-emitter=RTE
    NtcSts1: compu {0=NTCSTS_PASSD, 1=NTCSTS_FAILD, 2=NTCSTS_PREPASSD, 3=NTCSTS_PREFAILD}, implementation-data-type=uint8, type-emitter=RTE
    s18p13: implementation-data-type=sint32, type-emitter=RTE
    SigQlfr1: compu {0=SIGQLFR_NORES, 1=SIGQLFR_PASSD, 2=SIGQLFR_FAILD}, implementation-data-type=uint8, type-emitter=RTE
package /Nexteer/NvMProxy_swc/DataTypes
  impl type NvM_RequestResultType: category=VALUE, base-type=NvM_RequestResultType, compu {0=NVM_REQ_OK, 1=NVM_REQ_NOT_OK, 2=NVM_REQ_PENDING, 3=NVM_REQ_INTEGRITY_FAILED, 4=NVM_REQ_BLOCK_SKIPPED, 5=NVM_REQ_NV_INVALIDATED, 6=NVM_REQ_CANCELED, 7=NVM_REQ_REDUNDANCY_FAILED, 8=NVM_REQ_RESTORED_FROM_ROM}
package /Nexteer/NvMProxy_swc/DataTypes/BaseTypes
  base type NvM_RequestResultType: category=FIXED_LENGTH, base-type-size=8, base-type-encoding=NONE, native-declaration=uint8
