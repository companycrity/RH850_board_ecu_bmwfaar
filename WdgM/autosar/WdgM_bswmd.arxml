AUTOSAR XML (schema 4-0-3)
package /MICROSAR
  bsw implementation WdgM_Impl: programming-language=C, sw-version=5.2.1, used-code-generator=DaVinci Configurator, vendor-id=30, ar-release-version=4.00.01, behavior=WdgMBehavior, preconfigured-configuration=WdgM_Pre, recommended-configuration=WdgM_Rec, vendor-specific-module-def=WdgM
  module definition WdgM [0..1]: category=VENDOR_SPECIFIC_MODULE_DEFINITION, refined-module-def=WdgM, variants pre-compile  # Configuration of the WdgM (Watchdog Manager) module.
    container WdgMConfigSet: multiple-configuration-container=true  # This container describes one of multiple configuration sets of WdgM. This is a MultipleConfigurationContainer, i.e. this container and its sub-containers exist once per configuration set.
      symbolic name reference WdgMInitialMode: set at pre-compile, destination=WdgMMode  # The mode that the Watchdog Manager is in after it has been initialized.
      container WdgMDemEventParameterRefs [0..1]  # Container for the references to DemEventParameter elements which shall be invoked using the API Dem_ReportErrorStatus API in case the corresponding error occurs. The EventId is taken from the referenced DemEventParameter's DemEventId value. The standardized errors are provided in the container and can be extended by vendor specific error references.
        symbolic name reference WDGM_E_IMPROPER_CALLER [0..1]: set at pre-compile, destination=DemEventParameter  # Reference to the DemEventParameter which shall be issued when the defensive behavior checks have detected an improper caller.
        symbolic name reference WDGM_E_MONITORING [0..1]: set at pre-compile, destination=DemEventParameter  # Reference to the DemEventParameter which shall be issued when the error "Monitoring has failed and a watchdog reset will occur" has occured.
        symbolic name reference WDGM_E_SET_MODE [0..1]: set at pre-compile, destination=DemEventParameter  # Parameter not used. Reference to the DemEventParameter which shall be issued when the error "Watchdog drivers' mode switch has failed" has occured.
      container WdgMMode  # The container describes one of several modes of the Watchdog Manager.
        integer WdgMExpiredSupervisionCycleTol: 0..65535, set at pre-compile  # This parameter shall be used to define a value that fixes the amount of expired supervision cycles for how long the blocking of watchdog triggering shall be postponed.
        integer WdgMModeId: 0..255, set at pre-compile, symbolic-name-value=true, default-value=0  # This parameter represents the WdgM mode.
        float WdgMSupervisionCycle: set at pre-compile  # This parameter defines the period with which the main function (WdgM_MainFunction) is called. Unit: [s]
        integer WdgMInitialTriggerModeId: 0..255, set at pre-compile, origin=Vector Informatik, symbolic-name-value=true, default-value=0  # Denotes the ID of the Trigger Mode which shall be used at system start.
        integer WdgMModeCoreAssignment: 0..3, set at pre-compile, origin=Vector Informatik, symbolic-name-value=true, default-value=0  # Assigns this configuration mode to a processor core ID.
        function name WdgMGlobalStateChangeCbk [0..1]: set at pre-compile, origin=Vector Informatik  # Callback function for notifying Watchdog Manager global status change. Note: If WdgMUseRte is configured as true and thus the receiver of the callback is an application above the RTE, the the user has to configure this parameter with the name of a C function which shall be called by WdgM. Within a separate file where this function is defined the user has to include the corresponding Rte application header file and call the Rte function. The Rte function is named according the following convention: Rte_Call_WdgM_<OsApplicationName>_globalStateChangeCbk_Core<CoreAssignment>_GlobalStatusCallback where OsApplicationName is entry in WdgMGlobalMemoryAppTaskRef and CoreAssignment is the entry in WdgMModeCoreAssignment. If WdgMGlobalMemoryAppTaskRef is not configured, the following pattern has to be applied: Rte_Call_WdgM_globalStateChangeCbk_Core<CoreAssignment>_GlobalStatusCallback where CoreAssignment is the entry in WdgMModeCoreAssignment. Only if this naming convention is followed, the API of the RTE can be used within the callback.
        integer WdgMTicksPerSecond: set at pre-compile, origin=Vector Informatik  # This parameter defines the number of Watchdog Manager ticks per second.
        choice reference WdgMGlobalMemoryAppTaskRef [0..1]: set at pre-compile, origin=Vector Informatik, destination=OsApplication  # Reference to an OS Application where the WdgM is running. In case of OS SC3 (with memory protection) the global variables of the Watchdog Manager module should be placed in the same memory segment as the application in the context of which the Watchdog Manager is running.
        reference WdgMOsCounterRef [0..1]: set at pre-compile, origin=Vector Informatik, destination=OsCounter  # Reference to the counter which shall be used for deadline monitoring.
        container WdgMAliveSupervision [0..65535]  # This container collects all configuration parameters of Alive-Supervision.
          integer WdgMExpectedAliveIndications: 0..65535, set at pre-compile  # This parameter contains the amount of expected alive indications within the referenced amount of defined supervision cycles according to corresponding SE.
          integer WdgMMaxMargin: 0..65535, set at pre-compile  # This parameter contains the amount of alive indications that are acceptable to be additional on the expected alive indications within the corresponding supervision reference cycle.
          integer WdgMMinMargin: 0..65535, set at pre-compile  # This parameter contains the amount of alive indications that are acceptable to be missed from the expected alive indications within the corresponding supervision reference cycle.
          integer WdgMSupervisionReferenceCycle: 1..65535, set at pre-compile  # This parameter contains the amount of supervision cycles to be used as reference by the alive-supervision mechanism to perform the checkup with counted alive indications according to corresponding SE.
          symbolic name reference WdgMAliveSupervisionCheckpointRef: set at pre-compile, destination=WdgMCheckpoint  # Reference to the Checkpoint for which this alive counter is configured.
        container WdgMDeadlineSupervision [0..65535]  # This container collects all configuration parameters for Deadline Monitoring for a Supervised Entity.
          float WdgMDeadlineMax: 0.0.., set at pre-compile  # This parameter contains the longest time span after which the deadline is considered to be met. Unit: [s]
          float WdgMDeadlineMin: 0.0.., set at pre-compile  # This parameter contains the shortest time span after which the deadline is considered to be met. Unit: [s]
          symbolic name reference WdgMDeadlineStartRef: set at pre-compile, destination=WdgMCheckpoint  # This is the reference to the start Checkpoint for Deadline Monitoring.
          symbolic name reference WdgMDeadlineStopRef: set at pre-compile, destination=WdgMCheckpoint  # This is the reference to the stop Checkpoint for Deadline Monitoring. Note that the deadline's start and stop references must match an existing local or a global transition.
        container WdgMExternalLogicalSupervision [0..1]  # This container collects all configuration parameters for Logical Supervision for one external graph.
          symbolic name reference WdgMExternalCheckpointFinalRef [0..65535]: set at pre-compile, destination=WdgMCheckpoint  # A reference to the final global Checkpoint. Note that there might be several final global checkpoints.
          symbolic name reference WdgMExternalCheckpointInitialRef: set at pre-compile, destination=WdgMCheckpoint  # A reference to the global initial Checkpoint.
          container WdgMExternalTransition [0..65535]  # This container collects the Checkpoints for a Global Transition across Supervised Entities.
            symbolic name reference WdgMExternalTransitionDestRef: set at pre-compile, destination=WdgMCheckpoint  # This is the reference to the destination Checkpoint of an External Transition.
            symbolic name reference WdgMExternalTransitionSourceRef: set at pre-compile, destination=WdgMCheckpoint  # This is the reference to the source Checkpoint of an External Transition.
        container WdgMTrigger [0..255]  # This container collects all configuration parameters for the triggering of hardware watchdogs.
          enumeration WdgMWatchdogMode: {WDGIF_FAST_MODE, WDGIF_OFF_MODE, WDGIF_SLOW_MODE}, set at pre-compile  # This parameter contains the watchdog mode that shall be used for the referenced watchdog in this Watchdog Manager mode. Implementation Type: WdgIf_ModeType
          integer WdgMTriggerConditionValue: 1..65535, set at pre-compile  # This parameter defines the maximum possible window time where the watchdog trigger is accepted (window end). The consumer of this parameter is the WdgIf_UpdateTriggerCondition for this watchdog. Unit: [ms]
          integer WdgMTriggerWindowStart: 0..65535, set at pre-compile, origin=Vector Informatik, default-value=0  # Parameter not used. This parameter defines the minimum window time after which a watchdog triggering is allowed (window start). The consumer of this parameter is the WdgIf_UpdateTriggerCondition for this watchdog. Unit: [ms]
          integer WdgMTriggerModeId: 0..254, set at pre-compile, origin=Vector Informatik, default-value=0  # This parameter contains a unique identifier of the trigger mode.
          symbolic name reference WdgMTriggerWatchdogRef: set at pre-compile, destination=WdgMWatchdog  # This parameter is a reference to the configured watchdog.
        container WdgMLocalStatusParams [0..65535]  # This container collects all configuration parameters for the Local Status of a Supervised Entity.
          integer WdgMFailedAliveSupervisionRefCycleTol: 0..65534, set at pre-compile  # This parameter contains the acceptable amount of failed alive supervisions for this Supervised Entity
          enumeration WdgMSupervisedEntityInitialMode: {WDGM_LOCAL_STATUS_DEACTIVATED, WDGM_LOCAL_STATUS_OK}, set at pre-compile, origin=Vector Informatik, default-value=WDGM_LOCAL_STATUS_OK  # Initial local monitoring status of the supervised entity.
          integer WdgMFailedDeadlineRefCycleTol: 0..65534, set at pre-compile, origin=Vector Informatik, default-value=0  # This parameter contains the acceptable amount of violated deadlines for this Supervised Entity. Note: The AUTOSAR implementation can be simulated for deadline violations with: WdgMDeadlineReferenceCycle = WdgMFailedDeadlineRefCycleTol = 0
          integer WdgMDeadlineReferenceCycle: 0..65535, set at pre-compile, origin=Vector Informatik, default-value=0  # This parameter contains the amount of supervision cycles to be used as reference by the deadline supervisions of this SE. Note: The AUTOSAR implementation can be simulated for deadline violations with: WdgMDeadlineReferenceCycle = WdgMFailedDeadlineRefCycleTol = 0
          integer WdgMFailedProgramFlowRefCycleTol: 0..65534, set at pre-compile, origin=Vector Informatik, default-value=0  # This parameter contains the acceptable amount of program flow violations for this Supervised Entity. Note: The AUTOSAR implementation can be simulated for program flow violations with: WdgMProgramFlowReferenceCycle = WdgMFailedProgramFlowRefCycleTol = 0
          integer WdgMProgramFlowReferenceCycle: 0..65535, set at pre-compile, origin=Vector Informatik, default-value=0  # This parameter contains the amount of supervision cycles to be used as reference by the program flow supervisions of this SE. Note: The AUTOSAR implementation can be simulated for program flow violations with: WdgMProgramFlowReferenceCycle = WdgMFailedProgramFlowRefCycleTol = 0
          symbolic name reference WdgMLocalStatusSupervisedEntityRef: set at pre-compile, destination=WdgMSupervisedEntity  # Reference to the Supervised Entity for which the parameters of this container are set.
    container WdgMGeneral  # Container structures all general configuration parameters of the Watchdog Manager.
      boolean WdgMDevErrorDetect: set at pre-compile, default-value=true  # Preprocessor switch to enable/disable development error detection and reporting. Shall be used to remove unneeded code segments regarding DET features True: Development error detection is enabled False: Development error detection is disabled
      boolean WdgMDemReport: set at pre-compile, origin=Vector Informatik, default-value=true  # Preprocessor switch to enable / disable calls to DEM in case of production error detection. True: DEM calls enabled in case of production errors False: DEM calls disabled in case of production errors
      boolean WdgMImmediateReset: set at pre-compile, default-value=true  # This preprocessor switch enables/disablse the immediate reset feature in case of alive, deadline or program flow failure. True: Immediate reset is enabled False: Immediate reset is disabled
      boolean WdgMOffModeEnabled: set at pre-compile, default-value=false  # This preprocessor switch enables/disables the selection of the "OffMode" of the watchdog driver. True: "OffMode" selection is allowed False: "OffMode" selection is disallowed
      boolean WdgMVersionInfoApi: set at pre-compile, default-value=false  # Preprocessor switch to enable/disable the existence of the API WdgM_GetVersionInfo. Shall be used to remove unneeded code segments. True: API is enabled False: API is disabled
      boolean WdgMDefensiveBehavior: set at pre-compile, default-value=false  # Preprocessor switch to enable/disable the defensive behavior of the Watchdog Manager module.
      boolean WdgMUseRte: set at pre-compile, origin=Vector Informatik, default-value=true  # This preprocessor switch instructs the Watchdog Manager to use the by Rte generated defines and typedefs. True: the WdgM uses the by Rte generated defines and typedefs False: the WdgM uses own defines and typedefs
      boolean WdgMDemSupervisionReport: set at pre-compile, origin=Vector Informatik, default-value=true  # Preprocessor switch to enable / disable call to DEM in case the Safe Watchdog Manager has the WDGM_GLOBAL_STATE_STOPPED reached. True: The DEM call is enabled False: The DEM call is disabled
      boolean WdgMFirstCycleAliveCounterReset: set at pre-compile, origin=Vector Informatik, default-value=false  # When this preprocessor switch is enabled, then the Alive counters in the first Supervision cycle are not evaluated
      boolean WdgMAutosarDebugging: set at pre-compile, origin=Vector Informatik, default-value=false  # Preprocessor switch to enable/disable the compilation of AUTOSAR debugging features, such as WdgM_GetFirstExpiredSEViolation. True: AUTOSAR debugging is enabled False: AUTOSAR debugging is disabled
      boolean WdgMUseOsSuspendInterrupt: set at pre-compile, origin=Vector Informatik, default-value=true  # This preprocessor switch enables/disables the usage of OS suspend and resume interrupt services within WdgM. Note: Suspending and Resuming interrupts is done by SchM. Therefore, if this option is enabled, SchM_WdgM.h is included and not Os.h. Normally SchM_WdgM.h is generated by Rte. If so, also enable the parameter / option WdgMUseRte.
      enumeration WdgMTimebaseSource: {WDGM_INTERNAL_SOFTWARE_TICK, WDGM_OS_COUNTER_TICK, WDGM_EXTERNAL_TICK}, set at pre-compile, origin=Vector Informatik, default-value=WDGM_INTERNAL_SOFTWARE_TICK  # This parameter selects the Tick counter source for Deadline monitoring. WDGM_INTERNAL_SOFTWARE_TICK: The counter is incremented each time `WdgM_MainFunction` is called. WDGM_OS_COUNTER_TICK: The timebase is based on the Os hardware counter. WDGM_EXTERNAL_TICK: The counter is incremented each time `WdgM_UpdateTickCount` is called.
      boolean WdgMSecondResetPath: set at pre-compile, origin=Vector Informatik, default-value=true  # This preprocessor switch generally enables the access to the external Mcu_ImmediateReset() function. This function is used as second reset path a specially when the primary reset path signals failure.
      boolean WdgMTickOverrunCorrection: set at pre-compile, origin=Vector Informatik, default-value=true  # This preprocessor switch enables/disables 32 bit timebase counter overflow detection and correction in case of WdgMTimebaseSource is selected to be WDGM_EXTERNAL_TICK.
      boolean WdgMEntityDeactivationEnabled: set at pre-compile, origin=Vector Informatik, default-value=false  # This preprocessor switch enables generally entity deactivation. Please see additional important safety information regarding this functionality in the WdgM Safety Manual
      boolean WdgMUseOsCoreIdentification [0..1]: set at pre-compile, origin=Vector Informatik, default-value=true  # This preprocessor switch enables/disables the usage of the OS GetCoreID() service.
      boolean WdgMGenerateCPIdAsPortDefinedArgument: set at pre-compile, origin=Vector Informatik, default-value=false  # This preprocessor switch enables/disables the generation of a port per checkpoint where the checkpoint id is added as port-defined argument. True: A port is generated in the software component (swc) for each checkpoint of a supervised entity with both supervised entity id and checkpoint id as port-defined arguments False: A port is generated in the software component (swc) only for each supervised entity with the supervised entity id as port-defined argument. The checkpoint id has to be added in the function call manually. Note: To obtain AUTOSAR behavior this parameter has to be set to false.
      enumeration WdgMStatusReportingMechanism: {WDGM_USE_MODE_SWITCH_PORTS, WDGM_USE_NOTIFICATIONS, WDGM_USE_NO_STATUS_REPORTING}, set at pre-compile, origin=Vector Informatik  # This parameter selects which mechansim should be applied for status reporting. WDGM_USE_MODE_SWITCH_PORTS: ModeSwitchPorts are used to report a status change. This can currently only be selected if WdgM is used as single core component. WDGM_USE_NOTIFICATIONS: Notifications are used to report a status change. WDGM_USE_NO_STATUS_REPORTING: No reporting mechanism of a status change is used.
      container WdgMSupervisedEntity [0..65535]  # This container collects all common (mode-independent) parameters of a Supervised Entity to be supervised by the Watchdog Manager.
        integer WdgMSupervisedEntityId: 0..65535, set at pre-compile, symbolic-name-value=true, default-value=65535  # This parameter shall contain the unique identifier of the supervised entity. All supervised entity ids must form a zero-based list of integers.
        boolean WdgMEnableEntityDeactivation: set at pre-compile, origin=Vector Informatik, default-value=false  # Enables deactivation of this supervised enitiy.
        function name WdgMLocalStateChangeCbk [0..1]: set at pre-compile, origin=Vector Informatik  # Callback function for notifying the supervised entity's status change. Note: If WdgMUseRte is configured as true and thus the receiver of the callback is an application above the RTE, the the user has to configure this parameter with the name of a C function which shall be called by WdgM. Within a separate file where this function is defined the user has to include the corresponding Rte application header file and call the Rte function. The Rte function is named according the following convention: Rte_Call_WdgM_<OsApplicationName>_localStateChangeCbk_<SupervisedEntityName>_LocalStatusCallback where OsApplicationName is entry in WdgMGlobalMemoryAppTaskRef of the relating WdgMMode and SupervisedEntityName is the entry in WdgMSupervisedEntity. If WdgMAppTaskRef is not configured, the following pattern has to be applied: Rte_Call_WdgM_localStateChangeCbk_<SupervisedEntityName>_LocalStatusCallback where SupervisedEntityName is the entry in WdgMSupervisedEntity. Only if this naming convention is followed, the API of the RTE can be used within the callback.
        symbolic name reference WdgMInternallCheckpointFinalRef [0..65535]: set at pre-compile, destination=WdgMCheckpoint  # A reference to the final local Checkpoint of this supervised entity. Note that there might be several final local checkpoints.
        symbolic name reference WdgMInternalCheckpointInitialRef: set at pre-compile, destination=WdgMCheckpoint  # A reference to the initial local Checkpoint of this supervised entity.
        choice reference WdgMAppTaskRef [0..1]: set at pre-compile, origin=Vector Informatik, destination=OsApplication  # Reference to an OS Application. In case of OS SC3 the local data of the supervised entity should be placed in the same memory segment as the application this supervised entity is part of.
        container WdgMCheckpoint [1..65535]  # This container collects all Checkpoints of this Supervised Entity.
          integer WdgMCheckpointId: 0..65535, set at pre-compile, symbolic-name-value=true, default-value=65535  # This parameter shall contain the unique identifier of checkpoint within a supervised entity. All checkpoint ids must form a zero-based list of integers.
        container WdgMInternalTransition [0..65535]  # This container defines the graph of Internal Transitions within this Supervised Entity.
          symbolic name reference WdgMInternalTransitionDestRef: set at pre-compile, destination=WdgMCheckpoint  # This is the reference to the destination Checkpoint of an Internal Transition within this Supervised Entity.
          symbolic name reference WdgMInternalTransitionSourceRef: set at pre-compile, destination=WdgMCheckpoint  # This is the reference to the source Checkpoint of an Internal Transition within this Supervised Entity.
      container WdgMWatchdog [0..255]  # This container collects all common (mode-independent) parameters of a Watchdog to be triggered by the Watchdog Manager.
        string WdgMWatchdogName: set at pre-compile, symbolic-name-value=true  # This parameter is a symbolic name of the Watchdog. Is used as comment only.
        symbolic name reference WdgMWatchdogDeviceRef: set at pre-compile, destination=WdgIfDevice  # Reference to one device container of Watchdog Interface. In the referenced container WdgIfDevice, the parameter WdgIfDeviceIndex contains the Index parameter that WdgM has to use for WdgIf_SetTriggerCondition calls for that watchdog instance.
      container WdgMCallerIds  # Contains the definition of valid CallerIds for the callers who have permission to call the function WdgM_SetMode
        integer WdgMCallerId [1..255]: 0..65535, set at pre-compile, symbolic-name-value=true, default-value=0  # This parameter defines one valid CallerId for the callers who have permission to call the function WdgM_SetMode.
  module config WdgM_Pre: definition=WdgM
  module config WdgM_Rec: definition=WdgM
