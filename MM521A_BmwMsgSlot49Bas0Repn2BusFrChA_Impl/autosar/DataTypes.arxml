AUTOSAR XML (schema 4-0-3)
standard types defined: float32, sint8, uint16, uint8, float32_DataConstr, sint8_DataConstr, uint8_DataConstr
package /BMW/Boardnet/CodingDatatypes/CompuMethodsForBoardnet
  compu method ALIV_COU_4: 0=Zaehlerstand0DotDotE (ALIV_COU_4_Zaehlerstand0DotDotE) (BNE original name: Zählerstand 0..E), 15=SignalUngueltig (ALIV_COU_4_SignalUngueltig) (BNE original name: Signal ungültig)
  compu method CRC8: identical  # Standartabsicherung Apllikations-CRC.
package /BMW/Boardnet/CodingDatatypes/DataConstraints
  range CRC8: phys 0..255  # Standartabsicherung Apllikations-CRC.
package /BMW/SystemDescription/Units
  13 x unit, all with factor-si-to-unit=1, offset-si-to-unit=0:
    ampere: display-name=A
    degree_celsius: display-name=°C
    degree_per_second: display-name=°/s
    kilometer: display-name=km
    kilometer_per_hour: display-name=km/h
    kilonewton: display-name=kN
    kilowatt: display-name=kW
    meter_per_second_squared: display-name=m/s²
    newton_meter: display-name=Nm
    no_unit
    percent: display-name=%
    radian_per_second: display-name=rad/s
    second: display-name=s
package /DataTypes
  13 x impl type:
    ALIV_AVL_FORC_GRD1: category=VALUE, base-type=uint8, compu-method=ALIV_COU_4
    ALIV_AVL_STMOM_DV_ACT1: category=VALUE, base-type=uint8, compu-method=ALIV_COU_4
    AVL_FORC_GRD_dummy_12_151: category=VALUE, base-type=uint8, compu {identical}
    AVL_FORC_GRD1: category=VALUE, base-type=uint16, compu {phys=raw*0.0084-17 for raw 2023.8095238095239..483883.2199546486; unit kN}
    AVL_PWR_EL_EPS_COOD1: category=VALUE, base-type=uint8, compu {phys=raw*0.1-12 for raw 120..2520; unit kW}
    AVL_STMOM_DV_ACT_dummy_12_151: category=VALUE, base-type=uint8, compu {identical}
    AVL_STMOM_DV_ACT1: category=VALUE, base-type=uint16, compu {phys=raw*0.005-10 for raw 2000..802000}
    CRC_AVL_FORC_GRD1: category=VALUE, base-type=uint8, compu-method=CRC8
    CRC_AVL_STMOM_DV_ACT1: category=VALUE, base-type=uint8, compu-method=CRC8
    QU_AVL_FORC_GRD1:
      category=VALUE
      base-type=uint8
      compu {8=Initialisierung (QU_AVL_FORC_GRD_Initialisierung) (At the startup of the TSU driver. Nutzsignal wird permanent mit 0,0016 befüllt.), 2=SignalwertIstGueltig (QU_AVL_FORC_GRD_SignalwertIstGueltig) (BNE original name: Signalwert ist gültig), 14=SignalwertIstUngueltigZustandSlashStatusTemporaer (QU_AVL_FORC_GRD_SignalwertIstUngueltigZustandSlashStatusTemporaer) (BNE original name: Signalwert ist ungültig, Zustand/Status temporär), 15=SignalUngueltig (QU_AVL_FORC_GRD_SignalUngueltig) (BNE original name: Signal ungültig)}
    QU_AVL_STMOM_DV_ACT1:
      category=VALUE
      base-type=uint8
      compu {8=Initialisierung (QU_AVL_STMOM_DV_ACT_Initialisierung) (Tritt während der Initialisierungsphase auf (Vorbefüllung). Nutzsignal wird permanent mit Nutzwert 0 befüllt.), 1=SignalwertIstGueltigUndAbgesichertUndPlausibilisiert (QU_AVL_STMOM_DV_ACT_SignalwertIstGueltigUndAbgesichertUndPlausibilisiert) (BNE original name: Signalwert ist gültig und abgesichert und plausibilisiert), 14=SignalwertIstUngueltigZustandSlashStatusTemporaer (QU_AVL_STMOM_DV_ACT_SignalwertIstUngueltigZustandSlashStatusTemporaer) (BNE original name: Signalwert ist ungültig, Zustand/Status temporär), 6=SignalwertIstUngueltig (QU_AVL_STMOM_DV_ACT_SignalwertIstUngueltig) (BNE original name: Signalwert ist ungültig), 15=SignalUngueltig (QU_AVL_STMOM_DV_ACT_SignalUngueltig) (BNE original name: Signal ungültig)}
    sigGroup_AVL_FORC_GRD1: category=STRUCTURE
      6 x element, all with category=TYPE_REFERENCE:
        AVL_FORC_GRD: range phys 0..4047.619, implementation-data-type=AVL_FORC_GRD1
        AVL_PWR_EL_EPS_COOD: range phys 0..240, implementation-data-type=AVL_PWR_EL_EPS_COOD1
        ALIV_AVL_FORC_GRD: range raw 0..15, implementation-data-type=ALIV_AVL_FORC_GRD1
        CRC_AVL_FORC_GRD: data-constr=CRC8, implementation-data-type=CRC_AVL_FORC_GRD1
        QU_AVL_FORC_GRD: range raw 0..15, implementation-data-type=QU_AVL_FORC_GRD1
        AVL_FORC_GRD_dummy_12_15: range phys 0..15, implementation-data-type=AVL_FORC_GRD_dummy_12_151
    sigGroup_AVL_STMOM_DV_ACT1: category=STRUCTURE
      5 x element, all with category=TYPE_REFERENCE:
        AVL_STMOM_DV_ACT: range phys 0..4000, implementation-data-type=AVL_STMOM_DV_ACT1
        ALIV_AVL_STMOM_DV_ACT: range raw 0..15, implementation-data-type=ALIV_AVL_STMOM_DV_ACT1
        QU_AVL_STMOM_DV_ACT: range raw 0..15, implementation-data-type=QU_AVL_STMOM_DV_ACT1
        CRC_AVL_STMOM_DV_ACT: data-constr=CRC8, implementation-data-type=CRC_AVL_STMOM_DV_ACT1
        AVL_STMOM_DV_ACT_dummy_12_15: range phys 0..15, implementation-data-type=AVL_STMOM_DV_ACT_dummy_12_151
package /Nexteer/DataTypes
  impl type SigQlfr1: compu {0=SIGQLFR_NORES, 1=SIGQLFR_PASSD, 2=SIGQLFR_FAILD}, implementation-data-type=PlatformTypes/uint8, type-emitter=RTE
package /Nexteer/Units
  4 x unit, all with factor-si-to-unit=1, offset-si-to-unit=0:
    DegCgrd: display-name=degC
    FixdPt
    MtrPerSecSqd: display-name=m/s^2
    Sec: display-name=sec
