AUTOSAR XML (schema 4-0-3)
package /Nexteer/Calibrations
  parameter interface float32_CalPortIf1
    parameter data prototype Val: sw-calibration-access=READ-WRITE, type=float32
  parameter interface sint8_CalPortIf1
    parameter data prototype Val: sw-calibration-access=READ-WRITE, type=sint8
package /Nexteer/PortInterfaces
  sender receiver interface float32_PortIf1: invalidation-policy{data-element=float32_PortIf1/Val, handle-invalid=DONT-INVALIDATE}
    data Val: sw-calibration-access=READ-ONLY, type=float32
  sender receiver interface SigQlfr1_PortIf1: invalidation-policy{data-element=SigQlfr1_PortIf1/Val, handle-invalid=DONT-INVALIDATE}
    data Val: sw-calibration-access=READ-ONLY, type=SigQlfr1
package /PortInterfaces
  sender receiver interface sigGroup_AVL_FORC_GRD: invalidation-policy{data-element=sigGroup_AVL_FORC_GRD, handle-invalid=DONT-INVALIDATE}
    data sigGroup_AVL_FORC_GRD: type=sigGroup_AVL_FORC_GRD1
  sender receiver interface sigGroup_AVL_STMOM_DV_ACT: invalidation-policy{data-element=sigGroup_AVL_STMOM_DV_ACT, handle-invalid=DONT-INVALIDATE}
    data sigGroup_AVL_STMOM_DV_ACT: type=sigGroup_AVL_STMOM_DV_ACT1
