AUTOSAR XML (schema 4-0-3)
package /ActiveEcuC
  module config BmwTunSetHndlr: implementation-config-variant=VARIANT-PRE-COMPILE
    BmwTunSetHndlrGeneral: DESININIDXNOTPRSNT=NTCNR_0X1E5, DESININOPTSETAISXNOTPRSNT=NTCNR_0X1E6
