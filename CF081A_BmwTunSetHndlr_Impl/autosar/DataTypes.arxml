AUTOSAR XML (schema 4-0-3)
standard types defined: boolean, uint16, uint32, uint8, boolean_CompuMethod, boolean_DataConstr, uint16_DataConstr, uint32_DataConstr, uint8_DataConstr, Boolean, dtRef_const_VOID, dtRef_VOID
package /Nexteer/DataTypes
  5 x impl type, all with type-emitter=RTE:
    BmwDesIninIdxRec1: category=STRUCTURE, sw-calibration-access=READ-ONLY
      element BmwDesIninIdx: implementation-data-type=ImplementationDataTypes/uint8
      element BmwDesIninIdxWrSts: implementation-data-type=boolean
    BmwDesIninOptSetAIdxRec1: category=STRUCTURE, sw-calibration-access=READ-ONLY
      element BmwDesIninOptSetAIdx: implementation-data-type=ImplementationDataTypes/uint8
      element BmwDesIninOptSetAIdxWrSts: implementation-data-type=boolean
    BmwRtIdx1: compu {1=BMWRTIDX_ULTRAHARD, 2=BMWRTIDX_SPTBAL, 3=BMWRTIDX_BAL, 4=BMWRTIDX_SOFT, 13=BMWRTIDX_FCTLIFNOTAVL, 14=BMWRTIDX_FCTRPTERR, 15=BMWRTIDX_INVLD}, implementation-data-type=ImplementationDataTypes/uint8
    NtcNr1: compu {1..511=NTCNR_0X001..NTCNR_0X1FF}, implementation-data-type=uint16
    NtcSts1: compu {0=NTCSTS_PASSD, 1=NTCSTS_FAILD, 2=NTCSTS_PREPASSD, 3=NTCSTS_PREFAILD}, implementation-data-type=ImplementationDataTypes/uint8
package /Nexteer/NvMProxy_swc/DataTypes
  impl type NvM_RequestResultType: category=VALUE, base-type=NvM_RequestResultType, compu {0=NVM_REQ_OK, 1=NVM_REQ_NOT_OK, 2=NVM_REQ_PENDING, 3=NVM_REQ_INTEGRITY_FAILED, 4=NVM_REQ_BLOCK_SKIPPED, 5=NVM_REQ_NV_INVALIDATED, 6=NVM_REQ_CANCELED, 7=NVM_REQ_REDUNDANCY_FAILED, 8=NVM_REQ_RESTORED_FROM_ROM}
package /Nexteer/NvMProxy_swc/DataTypes/BaseTypes
  base type NvM_RequestResultType: category=FIXED_LENGTH, base-type-size=8, base-type-encoding=NONE, native-declaration=uint8
