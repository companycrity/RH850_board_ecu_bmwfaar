AUTOSAR XML (schema 4-0-3)
package /Nexteer
  module definition BmwTunSetHndlr [0..1]: variants pre-compile  # Configuration of the BmwTunSetHndlr.
    container BmwTunSetHndlrGeneral  # This container contains the configuration (parameters) of the BmwTunSetHndlr.
      enumeration DESININIDXNOTPRSNT: {NTCNR_0X1E0, NTCNR_0X1E1, NTCNR_0X1E2, NTCNR_0X1E3, NTCNR_0X1E4, NTCNR_0X1E5, NTCNR_0X1E6, NTCNR_0X1E7, NTCNR_0X1E8, NTCNR_0X1E9, NTCNR_0X1EA, NTCNR_0X1EB, NTCNR_0X1EC, NTCNR_0X1ED, NTCNR_0X1EE, NTCNR_0X1EF, NTCNR_0X1F0, NTCNR_0X1F1, NTCNR_0X1F2, NTCNR_0X1F3, NTCNR_0X1F4, NTCNR_0X1F5, NTCNR_0X1F6, NTCNR_0X1F7, NTCNR_0X1F8, NTCNR_0X1F9, NTCNR_0X1FA, NTCNR_0X1FB, NTCNR_0X1FC, NTCNR_0X1FD, NTCNR_0X1FE, NTCNR_0X1FF}, set at pre-compile, origin=Nexteer, default-value=NTCNR_0X1E5  # This constant is used as NTC number. NTC DesIninIdxNotPrsnt is set in CF081A and determines if NVM containing the Desired Initialization Index has been written during manufacturing process. The NTC may be set only during Initialization of the component. However it may be cleared in triggered service that is a part of the CF081A (server runnable).
      enumeration DESININOPTSETAISXNOTPRSNT: {NTCNR_0X1E0, NTCNR_0X1E1, NTCNR_0X1E2, NTCNR_0X1E3, NTCNR_0X1E4, NTCNR_0X1E5, NTCNR_0X1E6, NTCNR_0X1E7, NTCNR_0X1E8, NTCNR_0X1E9, NTCNR_0X1EA, NTCNR_0X1EB, NTCNR_0X1EC, NTCNR_0X1ED, NTCNR_0X1EE, NTCNR_0X1EF, NTCNR_0X1F0, NTCNR_0X1F1, NTCNR_0X1F2, NTCNR_0X1F3, NTCNR_0X1F4, NTCNR_0X1F5, NTCNR_0X1F6, NTCNR_0X1F7, NTCNR_0X1F8, NTCNR_0X1F9, NTCNR_0X1FA, NTCNR_0X1FB, NTCNR_0X1FC, NTCNR_0X1FD, NTCNR_0X1FE, NTCNR_0X1FF}, set at pre-compile, origin=Nexteer, default-value=NTCNR_0X1E6  # This constant is used as NTC number. NTC DesIninOptSetAIdxNotPrsnt is set in CF081A and determines if NVM containing the Desired Initialization Index has been written during manufacturing process. The NTC may be set only during Initialization of the component. However it may be cleared in triggered service that is a part of the CF081A (server runnable).
