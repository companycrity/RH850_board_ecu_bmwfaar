AUTOSAR XML (schema 4-0-3)
standard types defined: uint16, uint8, uint16_DataConstr, uint8_DataConstr
package /Nexteer/DataTypes
  impl type BmwFltLampReqSts1: compu {0=BMWFLTLAMPREQSTS_FLTLAMPRSTREQD, 1=BMWFLTLAMPREQSTS_FLTLAMPSETREQD, 3=BMWFLTLAMPREQSTS_INVLD}, implementation-data-type=uint8, type-emitter=RTE
  impl type BmwFltLampReqTyp2: compu {0=BMWFLTLAMPREQTYP_NOLAMP, 1=BMWFLTLAMPREQTYP_EPTI_INSPNRLVLAMP, 2=BMWFLTLAMPREQTYP_NORMWARNLAMP, 3=BMWFLTLAMPREQTYP_THERMWARNLAMP}, implementation-data-type=uint16, type-emitter=RTE
