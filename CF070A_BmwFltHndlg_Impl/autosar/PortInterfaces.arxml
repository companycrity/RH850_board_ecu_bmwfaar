AUTOSAR XML (schema 4-0-3)
package /Nexteer/PortInterfaces
  sender receiver interface BmwFltLampReqSts1_PortIf1: invalidation-policy{data-element=BmwFltLampReqSts1_PortIf1/Val, handle-invalid=DONT-INVALIDATE}
    data Val: sw-calibration-access=READ-ONLY, type=BmwFltLampReqSts1
package /PortInterfaces
  sender receiver interface BmwFltLampReqTyp2_PortIf1: invalidation-policy{data-element=BmwFltLampReqTyp2_PortIf1/Val, handle-invalid=DONT-INVALIDATE}
    data Val: type=BmwFltLampReqTyp2
