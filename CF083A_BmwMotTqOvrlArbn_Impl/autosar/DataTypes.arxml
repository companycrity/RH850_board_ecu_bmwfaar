AUTOSAR XML (schema 4-0-3)
standard types defined: boolean, float32, uint16, uint32, uint8, boolean_CompuMethod, boolean_DataConstr, float32_DataConstr, uint16_DataConstr, uint32_DataConstr, uint8_DataConstr
package /Nexteer/DataTypes
  impl type BmwNearStillVehSpdSts1: compu {12=BMWNEARSTILLVEHSPDSTS_VEHREST, 13=BMWNEARSTILLVEHSPDSTS_VEHNOTREST, 15=BMWNEARSTILLVEHSPDSTS_INVLD}, implementation-data-type=uint8, type-emitter=RTE
  impl type BmwTrfcJamAssiSt1: compu {1=BMWTRFCJAMASSIST_INACTV, 2=BMWTRFCJAMASSIST_ACTV, 15=BMWTRFCJAMASSIST_INVLD}, implementation-data-type=uint8, type-emitter=RTE
