AUTOSAR XML (schema 4-0-3)
standard types defined: boolean, dtRef_const_VOID, dtRef_VOID, float32, float64, sint16, sint16_least, sint32, sint32_least, sint64, sint8, sint8_least, uint16, uint16_least, uint32, uint32_least, uint64, uint8, uint8_least, boolean_CompuMethod, boolean_DataConstr, float32_DataConstr, float64_DataConstr, sint16_DataConstr, sint16_least_DataConstr, sint32_DataConstr, sint32_least_DataConstr, sint64_DataConstr, sint8_DataConstr, sint8_least_DataConstr, uint16_DataConstr, uint16_least_DataConstr, uint32_DataConstr, uint32_least_DataConstr, uint64_DataConstr, uint8_DataConstr, uint8_least_DataConstr
package /BMW/SystemDescription/Units
  13 x unit, all with factor-si-to-unit=1, offset-si-to-unit=0:
    ampere: display-name=A
    degree_celsius: display-name=°C
    degree_per_second: display-name=°/s
    kilometer: display-name=km
    kilometer_per_hour: display-name=km/h
    kilonewton: display-name=kN
    kilowatt: display-name=kW
    meter_per_second_squared: display-name=m/s²
    newton_meter: display-name=Nm
    no_unit
    percent: display-name=%
    radian_per_second: display-name=rad/s
    second: display-name=s
package /DataTypes
  impl type MILE_KM1:
    category=VALUE
    base-type=uint32
    compu {identical} "Automatisch generiert (Migration 2004-10-30) Transp.MOST-GW-Migration, 01.09.2006: Zusammenführung der Signalklasse Wegstrecke_Kilometer [1] mit den Parametern MileageKM [2]."
    range phys 0..16777214 "Automatisch generiert (Migration 2004-10-30) Transp.MOST-GW-Migration, 01.09.2006: Zusammenführung der Signalklasse Wegstrecke_Kilometer [1] mit den Parametern MileageKM [2]."
    invalid-value=16777215
package /Nexteer/DataTypes
  impl type NtcNr1: compu {1..511=NTCNR_0X001..NTCNR_0X1FF}, implementation-data-type=PlatformTypes/uint16, type-emitter=RTE
  impl type NtcSts1: compu {0=NTCSTS_PASSD, 1=NTCSTS_FAILD, 2=NTCSTS_PREPASSD, 3=NTCSTS_PREFAILD}, implementation-data-type=PlatformTypes/uint8, type-emitter=RTE
package /Nexteer/Units
  4 x unit, all with factor-si-to-unit=1, offset-si-to-unit=0:
    DegCgrd: display-name=degC
    FixdPt
    MtrPerSecSqd: display-name=m/s^2
    Sec: display-name=sec
