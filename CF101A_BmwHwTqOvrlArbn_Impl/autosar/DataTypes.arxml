AUTOSAR XML (schema 4-0-3)
standard types defined: boolean, float32, uint16, uint32, uint8, boolean_CompuMethod, boolean_DataConstr, float32_DataConstr, uint16_DataConstr, uint32_DataConstr, uint8_DataConstr
package /Nexteer/DataTypes
  6 x impl type, all with type-emitter=RTE:
    Ary1D_u4p12_6: category=ARRAY, sw-calibration-access=READ-ONLY
      element Element: array-size=6, array-size-semantics=FIXED-SIZE, implementation-data-type=u4p12
    Ary1D_u9p7_6: category=ARRAY, sw-calibration-access=READ-ONLY
      element Element: array-size=6, array-size-semantics=FIXED-SIZE, implementation-data-type=u9p7
    BmwOvrlCmdQlfr1: compu {2=BMWOVRLCMDQLFR_IMPLSP, 7=BMWOVRLCMDQLFR_SPNOTAVL, 14=BMWOVRLCMDQLFR_STBDONOTCNVSP, 15=BMWOVRLCMDQLFR_INVLDSIG}, implementation-data-type=uint8
    DrvgDynIfSt1: compu {32=DRVGDYNIFST_IFAVLRDYFOROPERWOADDLDAMPG, 33=DRVGDYNIFST_IFACTVADDLDAMPGNOTAVL, 34=DRVGDYNIFST_IFAVLRDYFOROPERADDLDAMPG, 35=DRVGDYNIFST_IFACTVADDLDAMPGAVL, 96=DRVGDYNIFST_SRVNOTAVLERR, 128=DRVGDYNIFST_IFINID, 224=DRVGDYNIFST_SRVNOTAVLSTBPMA, 225=DRVGDYNIFST_SRVNOTAVLSTBEPSSTS, 255=DRVGDYNIFST_INVLDSIG}, implementation-data-type=uint8
    u4p12: implementation-data-type=uint16
    u9p7: implementation-data-type=uint16
