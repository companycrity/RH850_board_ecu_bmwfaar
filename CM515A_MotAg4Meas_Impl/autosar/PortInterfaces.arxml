AUTOSAR XML (schema 4-0-3)
package /Nexteer/PortInterfaces
  client server interface GetMotAgMecl_PortIf1
    operation Oper
      arg MotAgMecl_Arg: type=u0p16, direction=OUT
  sender receiver interface sint8_PortIf1: invalidation-policy{data-element=Val, handle-invalid=DONT-INVALIDATE}
    data Val: sw-calibration-access=READ-ONLY, type=sint8
