AUTOSAR XML (schema 4-0-3)
package /PortInterfaces
  client server interface CmnMfgSrvCmnMfgSrvMaiFct
    operation Oper
      7 x arg, all with server-argument-impl-policy=USE-ARGUMENT-TYPE:
        CmnMfgSrvCmnMfgSrvSrvId: type=uint8, direction=IN
        CmnMfgSrvCmnMfgSrvSubFct: type=uint8, direction=IN
        CmnMfgSrvCmnMfgSrvPrmId: type=uint16, direction=IN
        CmnMfgSrvCmnMfgSrvDataBufferPtr: type=uint8, direction=INOUT
        CmnMfgSrvCmnMfgSrvReqLen: type=uint16, direction=IN
        CmnMfgSrvCmnMfgSrvRespLen: type=uint16, direction=OUT
        CmnMfgSrvCmnMfgSrvRespCod: type=uint8, direction=OUT
