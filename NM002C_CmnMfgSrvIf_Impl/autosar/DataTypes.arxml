AUTOSAR XML (schema 4-0-3)
standard types defined: uint16_DataConstr, uint32_DataConstr, uint8_DataConstr, uint16, uint32, uint8
