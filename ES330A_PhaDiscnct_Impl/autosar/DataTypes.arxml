AUTOSAR XML (schema 4-0-3)
standard types defined: boolean, dtRef_const_VOID, dtRef_VOID, float32, float64, sint16, sint16_least, sint32, sint32_least, sint64, sint8, sint8_least, uint16, uint16_least, uint32, uint32_least, uint64, uint8, uint8_least, boolean_CompuMethod, boolean_DataConstr, float32_DataConstr, float64_DataConstr, sint16_DataConstr, sint16_least_DataConstr, sint32_DataConstr, sint32_least_DataConstr, sint64_DataConstr, sint8_DataConstr, sint8_least_DataConstr, uint16_DataConstr, uint16_least_DataConstr, uint32_DataConstr, uint32_least_DataConstr, uint64_DataConstr, uint8_DataConstr, uint8_least_DataConstr
package /Nexteer/DataTypes
  7 x impl type, all with category=TYPE_REFERENCE, type-emitter=RTE:
    IvtrFetFltPha1: compu {0=IVTRFETFLTPHA_NOPHASNGFETFLT, 1=IVTRFETFLTPHA_PHAASNGFETFLT, 2=IVTRFETFLTPHA_PHABSNGFETFLT, 4=IVTRFETFLTPHA_PHACSNGFETFLT}, implementation-data-type=uint8
    IvtrFetFltTyp1: compu {0=IVTRFETFLTTYP_NOFETFLT, 1=IVTRFETFLTTYP_LOWRFETFLT, 2=IVTRFETFLTTYP_UPPRFETFLT, 4=IVTRFETFLTTYP_MPLFETFLT}, implementation-data-type=uint8
    NtcNr1: compu {1..511=NTCNR_0X001..NTCNR_0X1FF}, implementation-data-type=uint16
    NtcSts1: compu {0=NTCSTS_PASSD, 1=NTCSTS_FAILD, 2=NTCSTS_PREPASSD, 3=NTCSTS_PREFAILD}, implementation-data-type=uint8
    PhaDiscnctPwmVect1: compu {0=PHADISCNCTPWMVECT_NOCMD, 1=PHADISCNCTPWMVECT_PHAACMD, 2=PHADISCNCTPWMVECT_PHABCMD, 4=PHADISCNCTPWMVECT_PHACCMD}, implementation-data-type=uint8
    SigQlfr1: compu {0=SIGQLFR_NORES, 1=SIGQLFR_PASSD, 2=SIGQLFR_FAILD}, implementation-data-type=uint8
    SysSt1: compu {0=SYSST_DI, 1=SYSST_OFF, 2=SYSST_ENA, 3=SYSST_WRMININ}, implementation-data-type=uint8
