AUTOSAR XML (schema 4-0-3)
standard types defined: float32, sint16, sint32, uint16, float32_DataConstr, sint16_DataConstr, sint32_DataConstr, uint16_DataConstr
package /Nexteer/DataTypes
  13 x impl type, all with type-emitter=RTE:
    Ary1D_s15p0_21: category=ARRAY, sw-calibration-access=READ-ONLY
      element Element: array-size=21, array-size-semantics=FIXED-SIZE, implementation-data-type=s15p0
    Ary1D_s2p13_21: category=ARRAY, sw-calibration-access=READ-ONLY
      element Element: array-size=21, array-size-semantics=FIXED-SIZE, implementation-data-type=s2p13
    Ary1D_s8p7_21: category=ARRAY, sw-calibration-access=READ-ONLY
      element Element: array-size=21, array-size-semantics=FIXED-SIZE, implementation-data-type=s8p7
    Ary1D_u1p15_21: category=ARRAY, sw-calibration-access=READ-ONLY
      element Element: array-size=21, array-size-semantics=FIXED-SIZE, implementation-data-type=u1p15
    Ary1D_u4p12_21: category=ARRAY, sw-calibration-access=READ-ONLY
      element Element: array-size=21, array-size-semantics=FIXED-SIZE, implementation-data-type=u4p12
    Ary1D_u5p11_21: category=ARRAY, sw-calibration-access=READ-ONLY
      element Element: array-size=21, array-size-semantics=FIXED-SIZE, implementation-data-type=u5p11
    s15p0: implementation-data-type=sint16
    s18p13: implementation-data-type=sint32
    s2p13: implementation-data-type=sint16
    s8p7: implementation-data-type=sint16
    u1p15: implementation-data-type=uint16
    u4p12: implementation-data-type=uint16
    u5p11: implementation-data-type=uint16
