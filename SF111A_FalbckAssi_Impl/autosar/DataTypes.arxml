AUTOSAR XML (schema 4-0-3)
standard types defined: float32, uint16, float32_DataConstr, uint16_DataConstr
package /Nexteer/DataTypes
  9 x impl type, all with type-emitter=RTE:
    Ary1D_u4p12_20: category=ARRAY, sw-calibration-access=READ-ONLY
      element Element: array-size=20, array-size-semantics=FIXED-SIZE, implementation-data-type=u4p12
    Ary1D_u6p10_20: category=ARRAY, sw-calibration-access=READ-ONLY
      element Element: array-size=20, array-size-semantics=FIXED-SIZE, implementation-data-type=u6p10
    Ary1D_u9p7_12: category=ARRAY, sw-calibration-access=READ-ONLY
      element Element: array-size=12, array-size-semantics=FIXED-SIZE, implementation-data-type=u9p7
    Ary2D_u4p12_12_20: category=ARRAY, sw-calibration-access=READ-ONLY
      element Element: array-size=12, array-size-semantics=FIXED-SIZE, implementation-data-type=Ary1D_u4p12_20
    Ary2D_u6p10_12_20: category=ARRAY, sw-calibration-access=READ-ONLY
      element Element: array-size=12, array-size-semantics=FIXED-SIZE, implementation-data-type=Ary1D_u6p10_20
    FilNotchGainRec1: category=STRUCTURE, sw-calibration-access=READ-ONLY
      5 x element, all with category=TYPE_REFERENCE, implementation-data-type=float32:
        FilGainB{0..2}
        FilGainA1
        FilGainA2
    u4p12: implementation-data-type=uint16
    u6p10: implementation-data-type=uint16
    u9p7: implementation-data-type=uint16
