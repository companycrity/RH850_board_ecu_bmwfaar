AUTOSAR XML (schema 4-0-3)
package /Nexteer
  module definition BattRtnCurr [0..1]: variants pre-compile  # Configuration of the BattRtnCurr.
    container BattRtnCurrGeneral  # This container contains the configuration (parameters) of the BattRtnCurr.
      float CURRESTIMDIFTHD: 0..20, set at pre-compile, origin=NEXTEER, default-value=10  # Maximum allowed difference between estimated current (obtained from D and Q currents calculation) and measured battery return current
      integer FAILSTEP: 0..65535, set at pre-compile, origin=NEXTEER, default-value=3276  # Increments the error accumulator. Time to fail assert.
      integer PASSSTEP: 0..65535, set at pre-compile, origin=NEXTEER, default-value=1638  # Decrements the error accumulator. Time to pass assert.
      boolean FASTLOOPPROC: set at pre-compile, origin=NEXTEER, default-value=true  # Controls the conditional code compilation according to the chosen execution case- inside motor ISR or inside 2ms periodic
      float FILCUTFREQ: 0..100, set at pre-compile, origin=NEXTEER, default-value=10  # Filter cutoff frequency when filtering the difference between measured current and provided estimation
      float GAIN: 0..1000, set at pre-compile, origin=NEXTEER, default-value=100  # Used during input conversion
      float LOWRTHD: -5000..5000, set at pre-compile, origin=NEXTEER, default-value=-200  # Used after sample conversion to amps for range check
      float OFFSET: 0..5, set at pre-compile, origin=NEXTEER, default-value=2.5  # Used during input conversion
      float OUTPMAX: 0..300, set at pre-compile, origin=NEXTEER, default-value=200  # Used for output signal saturation
      float OUTPMIN: -300..0, set at pre-compile, origin=NEXTEER, default-value=-200  # Used for output signal saturation
      float UPPRTHD: -5000..5000, set at pre-compile, origin=NEXTEER, default-value=200  # Used after sample conversion to amps for range check
