AUTOSAR XML (schema 4-0-3)
standard types defined: uint32, uint32_DataConstr
