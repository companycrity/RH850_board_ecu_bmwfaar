AUTOSAR XML (schema 4-0-3)
standard types defined: boolean, float32, uint16, boolean_CompuMethod, boolean_DataConstr, float32_DataConstr, uint16_DataConstr
package /Nexteer/DataTypes
  11 x impl type, all with type-emitter=RTE:
    Ary1D_u12p4_9: category=ARRAY, sw-calibration-access=READ-ONLY
      element Element: array-size=9, array-size-semantics=FIXED-SIZE, implementation-data-type=u12p4
    Ary1D_u1p15_11: category=ARRAY, sw-calibration-access=READ-ONLY
      element Element: array-size=11, array-size-semantics=FIXED-SIZE, implementation-data-type=u1p15
    Ary1D_u5p11_9: category=ARRAY, sw-calibration-access=READ-ONLY
      element Element: array-size=9, array-size-semantics=FIXED-SIZE, implementation-data-type=u5p11
    Ary1D_u6p10_9: category=ARRAY, sw-calibration-access=READ-ONLY
      element Element: array-size=9, array-size-semantics=FIXED-SIZE, implementation-data-type=u6p10
    Ary1D_u9p7_11: category=ARRAY, sw-calibration-access=READ-ONLY
      element Element: array-size=11, array-size-semantics=FIXED-SIZE, implementation-data-type=u9p7
    Ary2D_u5p11_9_9: category=ARRAY, sw-calibration-access=READ-ONLY
      element Element: array-size=9, array-size-semantics=FIXED-SIZE, implementation-data-type=Ary1D_u5p11_9
    u12p4: implementation-data-type=uint16
    u1p15: implementation-data-type=uint16
    u5p11: implementation-data-type=uint16
    u6p10: implementation-data-type=uint16
    u9p7: implementation-data-type=uint16
