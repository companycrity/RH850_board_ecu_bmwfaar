AUTOSAR XML (schema 4-0-3)
standard types defined: boolean, dtRef_const_VOID, dtRef_VOID, float32, float64, sint16, sint16_least, sint32, sint32_least, sint64, sint8, sint8_least, uint16, uint16_least, uint32, uint32_least, uint64, uint8, uint8_least, boolean_CompuMethod, boolean_DataConstr, float32_DataConstr, float64_DataConstr, sint16_DataConstr, sint16_least_DataConstr, sint32_DataConstr, sint32_least_DataConstr, sint64_DataConstr, sint8_DataConstr, sint8_least_DataConstr, uint16_DataConstr, uint16_least_DataConstr, uint32_DataConstr, uint32_least_DataConstr, uint64_DataConstr, uint8_DataConstr, uint8_least_DataConstr
package /BMW/SystemDescription/Units
  13 x unit, all with factor-si-to-unit=1, offset-si-to-unit=0:
    ampere: display-name=A
    degree_celsius: display-name=°C
    degree_per_second: display-name=°/s
    kilometer: display-name=km
    kilometer_per_hour: display-name=km/h
    kilonewton: display-name=kN
    kilowatt: display-name=kW
    meter_per_second_squared: display-name=m/s²
    newton_meter: display-name=Nm
    no_unit
    percent: display-name=%
    radian_per_second: display-name=rad/s
    second: display-name=s
package /DataTypes
  8 x impl type:
    ACLNY_COG_ERR_AMP1: category=VALUE, base-type=uint16, compu {phys=raw*0.005 for raw 0..800000; unit m/s^2}
    ACLNY_COG1: category=VALUE, base-type=uint16, compu {phys=raw*0.002-65 for raw 32500..32532500; unit m/s^2} "Codierung zu überarbeiten. Transp.MOST-GW-Migration, 01.09.2006: Zusammenführung der Signalklasse Querbeschleunigung_Schwerpunkt [1] mit den Parametern LateralAccelerationMassCenter [1]."
    ACLNY_MASSCNTR_dummy_12_151: category=VALUE, base-type=uint8, compu {identical}
    ALIV_ACLNY_COG1: category=VALUE, base-type=uint8, compu {0=Zaehlerstand0DotDotE (ALIV_COU_4_Zaehlerstand0DotDotE) (BNE original name: Zählerstand 0..E), 15=SignalUngueltig (ALIV_COU_4_SignalUngueltig) (BNE original name: Signal ungültig)}
    BmwVehLatAQlfr1:
      category=VALUE
      base-type=uint8
      sw-calibration-access=READ-ONLY
      compu {1=BMWVEHLATAQLFR_SIGVALVLDANDPLAUS, 2=BMWVEHLATAQLFR_SIGVALVLD, 3=BMWVEHLATAQLFR_SIGQLTMONRSTRCTD, 4=BMWVEHLATAQLFR_RESD1, 6=BMWVEHLATAQLFR_SIGVALINVLD, 7=BMWVEHLATAQLFR_RESD2, 8=BMWVEHLATAQLFR_ININ, 9=BMWVEHLATAQLFR_SIGVALTMPVLDANDSECUR, 10=BMWVEHLATAQLFR_SIGVALTMPVLD, 11=BMWVEHLATAQLFR_SIGQLTMONTMPRSTRCTD, 12=BMWVEHLATAQLFR_SIGSUBVALVLDTMP, 14=BMWVEHLATAQLFR_SIGVALTMPINVLD, 15=BMWVEHLATAQLFR_INVLDSIG}
      type-emitter=RTE
    CRC_ACLNY_COG1: category=VALUE, base-type=uint8, compu {identical} "Standartabsicherung Apllikations-CRC."
    QU_ACLNY_COG1:
      category=VALUE
      base-type=uint8
      compu {8=Initialisierung (QU_ACLNY_COG_Initialisierung) (Tritt während der Initialisierungsphase auf bis Ist-Wert verfügbar (Vorbefüllung). Nutzsignal wird permanent mit Nutzwert 0 befüllt.), 1=SignalwertIstGueltigUndAbgesichertUndPlausibilisiert (QU_ACLNY_COG_SignalwertIstGueltigUndAbgesichertUndPlausibilisiert) (BNE original name: Signalwert ist gültig und abgesichert und plausibilisiert), 9=SignalwertIstGueltigUndAbgesichertZustandSlashStatusTemporaer (QU_ACLNY_COG_SignalwertIstGueltigUndAbgesichertZustandSlashStatusTemporaer) (BNE original name: Signalwert ist gültig und abgesichert, Zustand/Status temporär), 2=SignalwertIstGueltig (QU_ACLNY_COG_SignalwertIstGueltig) (BNE original name: Signalwert ist gültig), 10=SignalwertIstGueltigZustandSlashStatusTemporaer (QU_ACLNY_COG_SignalwertIstGueltigZustandSlashStatusTemporaer) (BNE original name: Signalwert ist gültig, Zustand/Status temporär), 3=SignalqualitaetBzwDotUeberwachungEingeschraenkt (QU_ACLNY_COG_SignalqualitaetBzwDotUeberwachungEingeschraenkt) (BNE original name: Signalqualität bzw. Überwachung eingeschränkt), 11=SignalqualitaetBzwDotUeberwachungEingeschraenktZustandSlashStatusTemporaer (QU_ACLNY_COG_SignalqualitaetBzwDotUeberwachungEingeschraenktZustandSlashStatusTemporaer) (BNE original name: Signalqualität bzw. Überwachung eingeschränkt, Zustand/Status temporär), 4=Reserved (QU_ACLNY_COG_Reserved), 12=ErsatzwertIstImNutzsignalGesetztZustandSlashStatusTemporaer (QU_ACLNY_COG_ErsatzwertIstImNutzsignalGesetztZustandSlashStatusTemporaer) (BNE original name: Ersatzwert ist im Nutzsignal gesetzt, Zustand/Status temporär), 6=SignalwertIstUngueltig (QU_ACLNY_COG_SignalwertIstUngueltig) (BNE original name: Signalwert ist ungültig), 14=SignalwertIstUngueltigZustandSlashStatusTemporaer (QU_ACLNY_COG_SignalwertIstUngueltigZustandSlashStatusTemporaer) (BNE original name: Signalwert ist ungültig, Zustand/Status temporär), 7=Reserved_bne_18ACE6A1DACA4F44BAB0F4D6BBE8870D_7 (QU_ACLNY_COG_Reserved_bne_18ACE6A1DACA4F44BAB0F4D6BBE8870D_7) (BNE original name: Reserved), 15=SignalUngueltig (QU_ACLNY_COG_SignalUngueltig) (BNE original name: Signal ungültig)}
    sigGroup_ACLNY_MASSCNTR1: category=STRUCTURE
      6 x element, all with category=TYPE_REFERENCE:
        ACLNY_MASSCNTR_dummy_12_15: range phys 0..15, implementation-data-type=ACLNY_MASSCNTR_dummy_12_151
        ACLNY_COG: range phys 0..65000 "Codierung zu überarbeiten. Transp.MOST-GW-Migration, 01.09.2006: Zusammenführung der Signalklasse Querbeschleunigung_Schwerpunkt [1] mit den Parametern LateralAccelerationMassCenter [1].", implementation-data-type=ACLNY_COG1
        QU_ACLNY_COG: range raw 0..15, implementation-data-type=QU_ACLNY_COG1
        ACLNY_COG_ERR_AMP: range phys 0..4000, implementation-data-type=ACLNY_COG_ERR_AMP1
        ALIV_ACLNY_COG: range raw 0..15, implementation-data-type=ALIV_ACLNY_COG1
        CRC_ACLNY_COG: range phys 0..255 "Standartabsicherung Apllikations-CRC.", implementation-data-type=CRC_ACLNY_COG1
package /Nexteer/DataTypes
  impl type NtcNr1: compu {1..511=NTCNR_0X001..NTCNR_0X1FF}, implementation-data-type=PlatformTypes/uint16, type-emitter=RTE
  impl type NtcSts1: compu {0=NTCSTS_PASSD, 1=NTCSTS_FAILD, 2=NTCSTS_PREPASSD, 3=NTCSTS_PREFAILD}, implementation-data-type=PlatformTypes/uint8, type-emitter=RTE
package /Nexteer/Units
  4 x unit, all with factor-si-to-unit=1, offset-si-to-unit=0:
    DegCgrd: display-name=degC
    FixdPt
    MtrPerSecSqd: display-name=m/s^2
    Sec: display-name=sec
