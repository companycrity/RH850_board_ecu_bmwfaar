AUTOSAR XML (schema 4-0-3)
package /Nexteer/Calibrations
  parameter interface uint8_CalPortIf1
    parameter data prototype Val: sw-calibration-access=READ-WRITE, type=uint8
package /Nexteer/PortInterfaces
  client server interface FltInj_u08_PortIf1
    operation Oper
      arg SigPah_Arg: type=uint8, direction=INOUT
      arg LocnKey_Arg: type=uint16, direction=IN
  client server interface GetNtcQlfrSts_PortIf1
    operation Oper: possible-error=GetNtcQlfrSts_PortIf1/E_NOT_OK
      arg NtcNr_Arg: type=NtcNr1, direction=IN
      arg NtcQlfr_Arg: type=SigQlfr1, direction=OUT
    error E_NOT_OK: error-code=1
  client server interface SetNtcSts_PortIf1
    operation Oper: possible-error=SetNtcSts_PortIf1/E_NOT_OK
      4 x arg, all with direction=IN:
        NtcNr_Arg: type=NtcNr1
        NtcStInfo_Arg: type=uint8
        NtcSts_Arg: type=NtcSts1
        DebStep_Arg: type=uint16
    error E_NOT_OK: error-code=1
  sender receiver interface SigQlfr_PortIf1: invalidation-policy{data-element=SigQlfr_PortIf1/Val, handle-invalid=DONT-INVALIDATE}
    data Val: sw-calibration-access=READ-ONLY, type=SigQlfr1
  sender receiver interface u0p16_PortIf1: invalidation-policy{data-element=u0p16_PortIf1/Val, handle-invalid=DONT-INVALIDATE}
    data Val: sw-calibration-access=READ-ONLY, type=u0p16
  sender receiver interface uint8_PortIf1: invalidation-policy{data-element=uint8_PortIf1/Val, handle-invalid=DONT-INVALIDATE}
    data Val: sw-calibration-access=READ-ONLY, type=uint8
