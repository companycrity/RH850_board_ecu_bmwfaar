AUTOSAR XML (schema 4-0-3)
package /Nexteer/PortInterfaces
  sender receiver interface BmwEpsFctSts1_PortIf1: invalidation-policy{data-element=BmwEpsFctSts1_PortIf1/Val, handle-invalid=DONT-INVALIDATE}
    data Val: sw-calibration-access=READ-ONLY, type=BmwEpsFctSts1
package /PortInterfaces
  sender receiver interface DrvgDynIfSt_PortIf1: invalidation-policy{data-element=DrvgDynIfSt_PortIf1/Val, handle-invalid=DONT-INVALIDATE}
    data Val: type=DrvgDynIfSt1
  sender receiver interface HaptcFbSt_PortIf1: invalidation-policy{data-element=HaptcFbSt_PortIf1/Val, handle-invalid=DONT-INVALIDATE}
    data Val: type=HaptcFbSt1
  sender receiver interface sigGroup_ST_EST: invalidation-policy{data-element=sigGroup_ST_EST, handle-invalid=DONT-INVALIDATE}
    data sigGroup_ST_EST: type=sigGroup_ST_EST1
