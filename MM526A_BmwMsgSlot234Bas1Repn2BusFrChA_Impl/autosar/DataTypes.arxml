AUTOSAR XML (schema 4-0-3)
standard types defined: boolean, dtRef_const_VOID, dtRef_VOID, float32, float64, sint16, sint16_least, sint32, sint32_least, sint64, sint8, sint8_least, uint16, uint16_least, uint32, uint32_least, uint64, uint8, uint8_least, boolean_CompuMethod, boolean_DataConstr, float32_DataConstr, float64_DataConstr, sint16_DataConstr, sint16_least_DataConstr, sint32_DataConstr, sint32_least_DataConstr, sint64_DataConstr, sint8_DataConstr, sint8_least_DataConstr, uint16_DataConstr, uint16_least_DataConstr, uint32_DataConstr, uint32_least_DataConstr, uint64_DataConstr, uint8_DataConstr, uint8_least_DataConstr
package /BMW/SystemDescription/Units
  13 x unit, all with factor-si-to-unit=1, offset-si-to-unit=0:
    ampere: display-name=A
    degree_celsius: display-name=°C
    degree_per_second: display-name=°/s
    kilometer: display-name=km
    kilometer_per_hour: display-name=km/h
    kilonewton: display-name=kN
    kilowatt: display-name=kW
    meter_per_second_squared: display-name=m/s²
    newton_meter: display-name=Nm
    no_unit
    percent: display-name=%
    radian_per_second: display-name=rad/s
    second: display-name=s
package /DataTypes
  9 x impl type:
    ALIV_ST_EST_FTAX1: category=VALUE, base-type=uint8, compu {0=Zaehlerstand0DotDotE (ALIV_COU_4_Zaehlerstand0DotDotE) (BNE original name: Zählerstand 0..E), 15=SignalUngueltig (ALIV_COU_4_SignalUngueltig) (BNE original name: Signal ungültig)}
    CRC_ST_EST_FTAX1: category=VALUE, base-type=uint8, compu {identical} "Standartabsicherung Apllikations-CRC."
    DrvgDynIfSt1: category=VALUE, base-type=uint8, sw-calibration-access=READ-ONLY, compu {32=DRVGDYNIFST_IFAVLRDYFOROPERWOADDLDAMPG, 33=DRVGDYNIFST_IFACTVADDLDAMPGNOTAVL, 34=DRVGDYNIFST_IFAVLRDYFOROPERADDLDAMPG, 35=DRVGDYNIFST_IFACTVADDLDAMPGAVL, 96=DRVGDYNIFST_SRVNOTAVLERR, 128=DRVGDYNIFST_IFINID, 224=DRVGDYNIFST_SRVNOTAVLSTBPMA, 225=DRVGDYNIFST_SRVNOTAVLSTBEPSSTS, 255=DRVGDYNIFST_INVLDSIG}, type-emitter=RTE
    HaptcFbSt1: category=VALUE, base-type=uint8, sw-calibration-access=READ-ONLY, compu {1=HAPTCFBST_FCTAVLNOTACTV, 6=HAPTCFBST_ERR, 9=HAPTCFBST_FCTAVLACTV, 14=HAPTCFBST_FCTNOTAVL, 15=HAPTCFBST_INVLDSIG}, type-emitter=RTE
    QU_FN_EST1:
      category=VALUE
      base-type=uint8
      compu {128=Initialisierung (QU_FN_EST_Initialisierung) (EPS Initialisierungszustand), 160=FunktionVerfuegbar_Aktiv12VEPS (QU_FN_EST_FunktionVerfuegbar_Aktiv12VEPS) (BNE original name: Funktion verfügbar - Aktiv, 12V EPS), 164=FunktionVerfuegbar_Aktiv12VEAS (QU_FN_EST_FunktionVerfuegbar_Aktiv12VEAS) (BNE original name: Funktion verfügbar - Aktiv, 12V EAS), 168=FunktionVerfuegbar_Aktiv24VEAS (QU_FN_EST_FunktionVerfuegbar_Aktiv24VEAS) (BNE original name: Funktion verfügbar - Aktiv, 24V EAS), 162=FunktionVerfuegbar_AktivNotfallfunktionUmwelteinfluesse_Aktiv (QU_FN_EST_FunktionVerfuegbar_AktivNotfallfunktionUmwelteinfluesse_Aktiv) (BNE original name: Funktion verfügbar - Aktiv, Notfallfunktion Umwelteinflüsse - Aktiv), 49=FunktionInRueckfallebene (QU_FN_EST_FunktionInRueckfallebene) (BNE original name: Funktion in Rückfallebene), 51=FunktionInRueckfallebeneNotfallfunktionUmwelteinfluesse_Aktiv (QU_FN_EST_FunktionInRueckfallebeneNotfallfunktionUmwelteinfluesse_Aktiv) (BNE original name: Funktion in Rückfallebene, Notfallfunktion Umwelteinflüsse- Aktiv), 176=FunktionTemporaerInRueckfallebene (QU_FN_EST_FunktionTemporaerInRueckfallebene) (BNE original name: Funktion temporär in Rückfallebene), 178=FunktionTemporaerInRueckfallebeneNotfallfunktionUmwelteinfluesse_Aktiv (QU_FN_EST_FunktionTemporaerInRueckfallebeneNotfallfunktionUmwelteinfluesse_Aktiv) (BNE original name: Funktion temporär in Rückfallebene, Notfallfunktion Umwelteinflüsse- Aktiv), 96=FunktionNichtVerfuegbar_Fehler (QU_FN_EST_FunktionNichtVerfuegbar_Fehler) (BNE original name: Funktion nicht verfügbar - Fehler), 224=FunktionNichtVerfuegbar_Ausgeschaltet (QU_FN_EST_FunktionNichtVerfuegbar_Ausgeschaltet) (BNE original name: Funktion nicht verfügbar - ausgeschaltet), 255=SignalUngueltig (QU_FN_EST_SignalUngueltig) (BNE original name: Signal ungültig)}
    QU_FN_VIB_EPS1:
      category=VALUE
      base-type=uint8
      compu {1=Funktion_verfuegbar_nicht_aktiv (QU_FN_VIB_EPS_Funktion_verfuegbar_nicht_aktiv) (Funktion EPS-Lenkradvibration ist verfügbar, Vibration ist aber nicht aktiv.), 9=Funktion_verfuegbar_aktiv (QU_FN_VIB_EPS_Funktion_verfuegbar_aktiv) (Funktion EPS-Lenkradvibration ist verfügbar und Vibration ist aktiv), 14=Funktion_nicht_verfuegbar (QU_FN_VIB_EPS_Funktion_nicht_verfuegbar) (Funktion EPS-Lenkradvibration ist temporär nicht verfügbar Dieser Zustand stellt sich dann ein, wenn die Funktion aufgrund eines EPS-internen Fehlers oder einer Degradation vorübergehend nicht zur Verfügung gestellt werden kann.), 6=Fehler (QU_FN_VIB_EPS_Fehler) (Funktion EPS-Lenkradvibration ist dauerhaft nicht verfügbar Dieser Zustand stellt sich dann ein, wenn die Funktion aufgrund eines EPS-internen Fehlers oder einer Degradation in dem aktuellen Klemme15-Zyklus nicht mehr zur Verfügung gestellt werden kann.), 15=Signal_unbefuellt (QU_FN_VIB_EPS_Signal_unbefuellt) (Sendefunktion nicht in Betrieb)}
    QU_SER_STMOM_DV_ACT1:
      category=VALUE
      base-type=uint8
      compu {128=SchnittstelleWirdInitialisiert (QU_SER_STMOM_STMOM_DV_ACT_SchnittstelleWirdInitialisiert) (BNE original name: Schnittstelle wird initialisiert), 32=SchnittstelleVerfuegbarSlashFunktionsbereitOhneZusatzdaempfung (QU_SER_STMOM_STMOM_DV_ACT_SchnittstelleVerfuegbarSlashFunktionsbereitOhneZusatzdaempfung) (BNE original name: Schnittstelle verfügbar / funktionsbereit ohne Zusatzdämpfung), 34=SchnittstelleVerfuegbarSlashFunktionsbereitMitZusatzdaempfung (QU_SER_STMOM_STMOM_DV_ACT_SchnittstelleVerfuegbarSlashFunktionsbereitMitZusatzdaempfung) (BNE original name: Schnittstelle verfügbar / funktionsbereit mit Zusatzdämpfung), 33=SchnittstelleAktiv_ZusatzdaempfungNichtVerfuegbar (QU_SER_STMOM_STMOM_DV_ACT_SchnittstelleAktiv_ZusatzdaempfungNichtVerfuegbar) (BNE original name: Schnittstelle aktiv - Zusatzdämpfung nicht verfügbar), 35=SchnittstelleAktiv_ZusatzdaempfungVerfuegbar (QU_SER_STMOM_STMOM_DV_ACT_SchnittstelleAktiv_ZusatzdaempfungVerfuegbar) (BNE original name: Schnittstelle aktiv - Zusatzdämpfung verfügbar), 96=ServiceNichtVerfuegbar_Fehler (QU_SER_STMOM_STMOM_DV_ACT_ServiceNichtVerfuegbar_Fehler) (BNE original name: Service nicht verfügbar - Fehler), 224=ServiceNichtVerfuegbar_Standby_PMA (QU_SER_STMOM_STMOM_DV_ACT_ServiceNichtVerfuegbar_Standby_PMA) (BNE original name: Service nicht verfügbar - Standby - PMA), 225=ServiceNichtVerfuegbar_Standby_EPSStatus (QU_SER_STMOM_STMOM_DV_ACT_ServiceNichtVerfuegbar_Standby_EPSStatus) (BNE original name: Service nicht verfügbar - Standby - EPS Status), 255=SignalUngueltig (QU_SER_STMOM_STMOM_DV_ACT_SignalUngueltig) (BNE original name: Signal ungültig)}
    sigGroup_ST_EST1: category=STRUCTURE
      6 x element, all with category=TYPE_REFERENCE:
        QU_SER_STMOM_DV_ACT: implementation-data-type=QU_SER_STMOM_DV_ACT1
        QU_FN_VIB_EPS: range raw 0..15, implementation-data-type=QU_FN_VIB_EPS1
        ST_EST_dummy_16_23: range phys 0..255, implementation-data-type=ST_EST_dummy_16_231
        ALIV_ST_EST_FTAX: range raw 0..15, implementation-data-type=ALIV_ST_EST_FTAX1
        CRC_ST_EST_FTAX: range phys 0..255 "Standartabsicherung Apllikations-CRC.", implementation-data-type=CRC_ST_EST_FTAX1
        QU_FN_EST: implementation-data-type=QU_FN_EST1
    ST_EST_dummy_16_231: category=VALUE, base-type=uint8, compu {identical}
package /Nexteer/DataTypes
  impl type BmwEpsFctSts1:
    compu {49=BMWEPSFCTSTS_FCTINFALLBACK, 51=BMWEPSFCTSTS_FCTINFALLBACKEMGYFCNENVTLINFLSACTV, 96=BMWEPSFCTSTS_NOTAVIERR, 128=BMWEPSFCTSTS_ININ, 160=BMWEPSFCTSTS_FCTAVIACTV12VEPS, 162=BMWEPSFCTSTS_FCTAVIACTVEMGYFCNENVTLINFLSACTV, 164=BMWEPSFCTSTS_FCTAVIACTV12VEAS, 168=BMWEPSFCTSTS_FCTAVIACTV24VEAS, 176=BMWEPSFCTSTS_FCTTMPINFALLBACK, 178=BMWEPSFCTSTS_FCTTMPINFALLBACKEMGYFCNENVTLINFLSACT, 224=BMWEPSFCTSTS_NOTAVISWDOFF, 255=BMWEPSFCTSTS_INVLD}
    implementation-data-type=uint8
    type-emitter=RTE
package /Nexteer/Units
  4 x unit, all with factor-si-to-unit=1, offset-si-to-unit=0:
    DegCgrd: display-name=degC
    FixdPt
    MtrPerSecSqd: display-name=m/s^2
    Sec: display-name=sec
