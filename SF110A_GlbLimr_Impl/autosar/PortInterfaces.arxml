AUTOSAR XML (schema 4-0-3)
package /Nexteer/Calibrations
  parameter interface Ary1D_u9p7_10_CalPortIf1
    parameter data prototype Ary1D: sw-calibration-access=READ-WRITE, type=Ary1D_u9p7_10
  parameter interface Ary2D_s4p11_10_13_CalPortIf1
    parameter data prototype Ary2D: sw-calibration-access=READ-WRITE, type=Ary2D_s4p11_10_13
  parameter interface FilNotchGainRec1_CalPortIf1
    parameter data prototype Rec: sw-calibration-access=READ-WRITE, type=FilNotchGainRec1
package /Nexteer/PortInterfaces
  sender receiver interface float32_PortIf1: invalidation-policy{data-element=Val, handle-invalid=DONT-INVALIDATE}
    data Val: sw-calibration-access=READ-ONLY, type=float32
