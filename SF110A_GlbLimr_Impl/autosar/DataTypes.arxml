AUTOSAR XML (schema 4-0-3)
standard types defined: float32, sint16, uint16, float32_DataConstr, sint16_DataConstr, uint16_DataConstr
package /Nexteer/DataTypes
  6 x impl type, all with type-emitter=RTE:
    Ary1D_s4p11_13: category=ARRAY, sw-calibration-access=READ-ONLY
      element Element: array-size=13, array-size-semantics=FIXED-SIZE, implementation-data-type=s4p11
    Ary1D_u9p7_10: category=ARRAY, sw-calibration-access=READ-ONLY
      element Element: array-size=10, array-size-semantics=FIXED-SIZE, implementation-data-type=u9p7
    Ary2D_s4p11_10_13: category=ARRAY, sw-calibration-access=READ-ONLY
      element Element: array-size=10, array-size-semantics=FIXED-SIZE, implementation-data-type=Ary1D_s4p11_13
    FilNotchGainRec1: category=STRUCTURE, sw-calibration-access=READ-ONLY
      5 x element, all with category=TYPE_REFERENCE, implementation-data-type=float32:
        FilGainB{0..2}
        FilGainA1
        FilGainA2
    s4p11: implementation-data-type=sint16
    u9p7: implementation-data-type=uint16
