AUTOSAR XML (schema 4-0-3)
standard types defined: uint16, uint32, uint8, uint16_DataConstr, uint8_DataConstr
package /DataTypes
  7 x impl type:
    ALIV_SU_EPS1: category=VALUE, base-type=uint8, compu {identical}
    CRC_SU_EPS1: category=VALUE, base-type=uint8, compu {identical} "Standartabsicherung Apllikations-CRC."
    sigGroup_SU_EPS1: category=STRUCTURE
      6 x element, all with category=TYPE_REFERENCE:
        CRC_SU_EPS: range phys 0..255 "Standartabsicherung Apllikations-CRC.", implementation-data-type=CRC_SU_EPS1
        UN_TOT_STR_EPS: range raw 0..3, implementation-data-type=UN_TOT_STR_EPS1
        ALIV_SU_EPS: range phys 0..14, implementation-data-type=ALIV_SU_EPS1
        TOT_STR_EPS: range phys 0..4093.998, implementation-data-type=TOT_STR_EPS1
        SU_EPS_dummy_20_51: range phys 0..4294967295, implementation-data-type=SU_EPS_dummy_20_511
        SU_EPS_dummy_14_19: range phys 0..63, implementation-data-type=SU_EPS_dummy_14_191
    SU_EPS_dummy_14_191: category=VALUE, base-type=uint8, compu {identical}
    SU_EPS_dummy_20_511: category=VALUE, base-type=uint32, compu {identical}
    TOT_STR_EPS1: category=VALUE, base-type=uint16, compu {phys=raw*0.012213 for raw 0..335216.4250094811}
    UN_TOT_STR_EPS1: category=VALUE, base-type=uint8, compu {0=Ritzelschnittstelle (UN_TOT_STR_EPS_Ritzelschnittstelle) (Die Position wird in Grad übertragen), 1=Zahnstangenhubschnittstelle (UN_TOT_STR_EPS_Zahnstangenhubschnittstelle) (Die Position wird in Millimeter übertragen (Einheit: 0.2mm)), 3=SignalUngueltig (UN_TOT_STR_EPS_SignalUngueltig) (BNE original name: Signal ungültig)}
