AUTOSAR XML (schema 4-0-3)
package /PortInterfaces
  client server interface CfgMsgTxReq_PortIf1
    operation Oper
  sender receiver interface sigGroup_SU_EPS: invalidation-policy{data-element=sigGroup_SU_EPS, handle-invalid=DONT-INVALIDATE}
    data sigGroup_SU_EPS: type=sigGroup_SU_EPS1
