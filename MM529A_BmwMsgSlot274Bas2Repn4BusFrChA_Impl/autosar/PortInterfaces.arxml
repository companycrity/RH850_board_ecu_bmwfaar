AUTOSAR XML (schema 4-0-3)
package /Nexteer/PortInterfaces
  sender receiver interface BmwFltLampFlsgFrq_PortIf1: invalidation-policy{data-element=BmwFltLampFlsgFrq_PortIf1/Val, handle-invalid=DONT-INVALIDATE}
    data Val: sw-calibration-access=READ-ONLY, type=BmwFltLampFlsgFrq1
  sender receiver interface BmwFltLampReqSts_PortIf1: invalidation-policy{data-element=BmwFltLampReqSts_PortIf1/Val, handle-invalid=DONT-INVALIDATE}
    data Val: sw-calibration-access=READ-ONLY, type=BmwFltLampReqSts1
  sender receiver interface uint8_PortIf1: invalidation-policy{data-element=uint8_PortIf1/Val, handle-invalid=DONT-INVALIDATE}
    data Val: sw-calibration-access=READ-ONLY, type=uint8
package /PortInterfaces
  sender receiver interface BmwFltLampReqTyp2_PortIf1: invalidation-policy{data-element=BmwFltLampReqTyp2_PortIf1/Val, handle-invalid=DONT-INVALIDATE}
    data Val: type=BmwFltLampReqTyp2
  sender receiver interface sigGroup_DISP_CC_EPS: invalidation-policy{data-element=sigGroup_DISP_CC_EPS, handle-invalid=KEEP}
    data sigGroup_DISP_CC_EPS: type=sigGroup_DISP_CC_EPS1
