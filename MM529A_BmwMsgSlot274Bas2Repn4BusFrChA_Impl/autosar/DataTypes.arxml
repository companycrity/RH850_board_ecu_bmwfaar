AUTOSAR XML (schema 4-0-3)
standard types defined: uint16, uint8, uint16_DataConstr, uint8_DataConstr
package /DataTypes
  8 x impl type:
    ALIV_DISP_CC_EPS1: category=VALUE, base-type=uint8
    CHL_DISP_CC_EPS1: category=VALUE, base-type=uint8
    CRC_DISP_CC_EPS1: category=VALUE, base-type=uint8
    NO_CC_EPS1: category=VALUE, base-type=uint16
    sigGroup_DISP_CC_EPS1: category=STRUCTURE
      7 x element, all with category=TYPE_REFERENCE:
        ST_CC_EPS: range raw 0..3, implementation-data-type=ST_CC_EPS1
        ALIV_DISP_CC_EPS: range phys 0..14, implementation-data-type=ALIV_DISP_CC_EPS1
        ST_IDC_CC_EPS: range raw 0..3, implementation-data-type=ST_IDC_CC_EPS1
        CRC_DISP_CC_EPS: range phys 0..255 "Standartabsicherung Apllikations-CRC.", implementation-data-type=CRC_DISP_CC_EPS1
        CHL_DISP_CC_EPS: range phys 0..14, implementation-data-type=CHL_DISP_CC_EPS1
        NO_CC_EPS: range phys 0..65534, implementation-data-type=NO_CC_EPS1
        TRANF_CC_EPS: range phys 0..14, implementation-data-type=TRANF_CC_EPS1
    ST_CC_EPS1: category=VALUE, base-type=uint8, compu {0=Ruecksetzen (ST_CC_EPS_Ruecksetzen) (BNE original name: Rücksetzen), 1=Setzen (ST_CC_EPS_Setzen) (CC-message display), 3=SignalUngueltig (ST_CC_EPS_SignalUngueltig) (BNE original name: Signal ungültig)}
    ST_IDC_CC_EPS1: category=VALUE, base-type=uint8, compu {0=KeinBlinken (ST_IDC_CC_EPS_KeinBlinken) (BNE original name: Kein Blinken), 1=LangsamesBlinken (ST_IDC_CC_EPS_LangsamesBlinken) (BNE original name: Langsames Blinken), 2=SchnellesBlinken (ST_IDC_CC_EPS_SchnellesBlinken) (BNE original name: Schnelles Blinken), 3=SignalUngueltig (ST_IDC_CC_EPS_SignalUngueltig) (BNE original name: Signal ungültig)}
    TRANF_CC_EPS1: category=VALUE, base-type=uint8
package /Nexteer/DataTypes
  impl type BmwFltLampFlsgFrq1: compu {0=BMWFLTLAMPFLSGFRQ_NOFLSG, 1=BMWFLTLAMPFLSGFRQ_SLOWFLSG, 2=BMWFLTLAMPFLSGFRQ_FASTFLSG, 3=BMWFLTLAMPFLSGFRQ_INVLD}, implementation-data-type=uint8, type-emitter=RTE
  impl type BmwFltLampReqSts1: compu {0=BMWFLTLAMPREQSTS_FLTLAMPRSTREQD, 1=BMWFLTLAMPREQSTS_FLTLAMPSETREQD, 3=BMWFLTLAMPREQSTS_INVLD}, implementation-data-type=uint8, type-emitter=RTE
  impl type BmwFltLampReqTyp2: compu {0=BMWFLTLAMPREQTYP_NOLAMP, 1=BMWFLTLAMPREQTYP_EPTI_INSPNRLVLAMP, 2=BMWFLTLAMPREQTYP_NORMWARNLAMP, 3=BMWFLTLAMPREQTYP_THERMWARNLAMP}, implementation-data-type=uint16, type-emitter=RTE
package /Nexteer/DataTypes/CompuMethods
  compu method BmwFltLampReqTyp1: 627=BMWFLTLAMPREQTYP_GENFLTLAMPREQD, 997=BMWFLTLAMPREQTYP_THERMLIMFLTLAMPREQD, 65534=BMWFLTLAMPREQTYP_NOFLTLAMPREQD, 65535=BMWFLTLAMPREQTYP_INVLD
