AUTOSAR XML (schema 4-0-3)
standard types defined: boolean, dtRef_const_VOID, dtRef_VOID, float32, float64, sint16, sint16_least, sint32, sint32_least, sint64, sint8, sint8_least, uint16, uint16_least, uint32, uint32_least, uint64, uint8, uint8_least, boolean_CompuMethod, boolean_DataConstr, float32_DataConstr, float64_DataConstr, sint16_DataConstr, sint16_least_DataConstr, sint32_DataConstr, sint32_least_DataConstr, sint64_DataConstr, sint8_DataConstr, sint8_least_DataConstr, uint16_DataConstr, uint16_least_DataConstr, uint32_DataConstr, uint32_least_DataConstr, uint64_DataConstr, uint8_DataConstr, uint8_least_DataConstr
package /Nexteer/DataTypes
  17 x impl type, all with type-emitter=RTE:
    Ary1D_s4p11_7: category=ARRAY, sw-calibration-access=READ-ONLY
      element Element: array-size=7, array-size-semantics=FIXED-SIZE, implementation-data-type=s4p11
    Ary1D_u15p1_4: category=ARRAY, sw-calibration-access=READ-ONLY
      element Element: array-size=4, array-size-semantics=FIXED-SIZE, implementation-data-type=u15p1
    Ary1D_u2p14_2: category=ARRAY, sw-calibration-access=READ-ONLY
      element Element: array-size=2, array-size-semantics=FIXED-SIZE, implementation-data-type=u2p14
    Ary1D_u2p14_4: category=ARRAY, sw-calibration-access=READ-ONLY
      element Element: array-size=4, array-size-semantics=FIXED-SIZE, implementation-data-type=u2p14
    Ary1D_u2p14_7: category=ARRAY, sw-calibration-access=READ-ONLY
      element Element: array-size=7, array-size-semantics=FIXED-SIZE, implementation-data-type=u2p14
    Ary1D_u4p12_5: category=ARRAY, sw-calibration-access=READ-ONLY
      element Element: array-size=5, array-size-semantics=FIXED-SIZE, implementation-data-type=u4p12
    Ary1D_u6p10_12: category=ARRAY, sw-calibration-access=READ-ONLY
      element Element: array-size=12, array-size-semantics=FIXED-SIZE, implementation-data-type=u6p10
    Ary1D_u6p10_2: category=ARRAY, sw-calibration-access=READ-ONLY
      element Element: array-size=2, array-size-semantics=FIXED-SIZE, implementation-data-type=u6p10
    Ary1D_u9p7_12: category=ARRAY, sw-calibration-access=READ-ONLY
      element Element: array-size=12, array-size-semantics=FIXED-SIZE, implementation-data-type=u9p7
    Ary1D_u9p7_5: category=ARRAY, sw-calibration-access=READ-ONLY
      element Element: array-size=5, array-size-semantics=FIXED-SIZE, implementation-data-type=u9p7
    Ary2D_u2p14_12_4: category=ARRAY, sw-calibration-access=READ-ONLY
      element Element: array-size=12, array-size-semantics=FIXED-SIZE, implementation-data-type=Ary1D_u2p14_4
    s4p11: implementation-data-type=sint16
    u15p1: implementation-data-type=uint16
    u2p14: implementation-data-type=uint16
    u4p12: implementation-data-type=uint16
    u6p10: implementation-data-type=uint16
    u9p7: implementation-data-type=uint16
