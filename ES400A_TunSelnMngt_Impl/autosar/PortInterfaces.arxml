AUTOSAR XML (schema 4-0-3)
package /Nexteer/PortInterfaces
  8 x client server interface:
    Calc32BitCrc_u32_PortIf1
      operation Oper: possible-error=Calc32BitCrc_u32_PortIf1/E_NOT_OK
        5 x arg, all with server-argument-impl-policy=USE-ARGUMENT-TYPE:
          DataPtr_Arg: type=uint32, direction=INOUT
          Len_Arg: type=uint32, direction=IN
          StrtVal_Arg: type=uint32, direction=IN
          FirstCall_Arg: type=boolean, direction=IN
          CalcCrcRes_Arg: type=uint32, direction=OUT
      error E_NOT_OK: error-code=1
    CopyCalPageReq_PortIf1
      operation Oper: possible-error=CopyCalPageReq_PortIf1/E_NOT_OK
        arg Seg_Arg: type=uint8, direction=IN, server-argument-impl-policy=USE-ARGUMENT-TYPE
      error E_NOT_OK: error-code=1
    GetCalPageReq_PortIf1
      operation Oper
        4 x arg, all with type=uint8, server-argument-impl-policy=USE-ARGUMENT-TYPE:
          Seg_Arg: direction=IN
          Mod_Arg: direction=IN
          Page_Arg: direction=INOUT
          Rtn_Arg: direction=OUT
    GetSegInfoReq_PortIf2
      operation Oper
        7 x arg, all with server-argument-impl-policy=USE-ARGUMENT-TYPE:
          Mod_Arg: type=GetSegMod1, direction=IN
          Seg_Arg: type=uint8, direction=IN
          SegInfo_Arg: type=uint8, direction=IN
          MpgIdx_Arg: type=uint8, direction=IN
          Resp_Arg: type=uint8, direction=INOUT
          RespLen_Arg: type=uint8, direction=INOUT
          Rtn_Arg: type=uint8, direction=OUT
    OnlineTunRamAdrMpg_PortIf1
      operation Oper: possible-error=OnlineTunRamAdrMpg_PortIf1/E_NOT_OK
        arg ReqAdr_Arg: type=uint32, direction=IN, server-argument-impl-policy=USE-ARGUMENT-TYPE
        arg CorrdAdr_Arg: type=uint32, direction=INOUT, server-argument-impl-policy=USE-ARGUMENT-TYPE
        arg ReqTyp_Arg: type=AdrMpgReqTyp1, direction=IN, server-argument-impl-policy=USE-ARGUMENT-TYPE
      error E_NOT_OK: error-code=1
    RtCalChgReq_PortIf1
      operation Oper: possible-error=RtCalChgReq_PortIf1/E_NOT_OK
      error E_NOT_OK: error-code=1
    SetCalPageReq_PortIf1
      operation Oper
        arg Seg_Arg: type=uint8, direction=IN, server-argument-impl-policy=USE-ARGUMENT-TYPE
        arg Mod_Arg: type=uint8, direction=IN, server-argument-impl-policy=USE-ARGUMENT-TYPE
        arg Page_Arg: type=uint8, direction=IN, server-argument-impl-policy=USE-ARGUMENT-TYPE
    SetNtcSts_PortIf1
      operation Oper: possible-error=SetNtcSts_PortIf1/E_NOT_OK
        4 x arg, all with direction=IN, server-argument-impl-policy=USE-ARGUMENT-TYPE:
          NtcNr_Arg: type=NtcNr1
          NtcStInfo_Arg: type=uint8
          NtcSts_Arg: type=NtcSts1
          DebStep_Arg: type=uint16
      error E_NOT_OK: error-code=1
  4 x sender receiver interface:
    ActvGroup_PortIf1: invalidation-policy{data-element=ActvGroup_PortIf1/Val, handle-invalid=DONT-INVALIDATE}
      data Val: type=uint8
    CalCopySts_PortIf1: invalidation-policy{data-element=CalCopySts_PortIf1/Val, handle-invalid=DONT-INVALIDATE}
      data Val: type=CalCopySts1
    RtIdxChgSts_PortIf1: invalidation-policy{data-element=RtIdxChgSts_PortIf1/Val, handle-invalid=DONT-INVALIDATE}
      data Val: sw-calibration-access=READ-ONLY, type=RtIdxChgSts1
    uint8_PortIf1: invalidation-policy{data-element=uint8_PortIf1/Val, handle-invalid=DONT-INVALIDATE}
      data Val: sw-calibration-access=READ-ONLY, type=uint8
