AUTOSAR XML (schema 4-0-3)
standard types defined: float32_DataConstr, float64_DataConstr, sint16_DataConstr, sint32_DataConstr, sint8_DataConstr, uint16_DataConstr, uint32_DataConstr, uint8_DataConstr, boolean, float32, float64, sint16, sint32, sint8, uint16, uint32, uint8
package /Nexteer/DataTypes
  11 x impl type:
    AdrMpgReqTyp1: compu {phys=raw for raw 0, phys=raw for raw 1}, implementation-data-type=uint8, type-emitter=RTE
    Ary1D_OnlineCalPageInfoRec1_2: category=ARRAY, sw-calibration-access=READ-ONLY, type-emitter=TunSelnMngt
      element Element: array-size=2, array-size-semantics=FIXED-SIZE, implementation-data-type=OnlineCalPageInfoRec1
    Ary1D_OnlineCalSegInfoRec1_TunSelnMngt1: category=ARRAY, sw-calibration-access=READ-ONLY, type-emitter=TunSelnMngt
      element Element: array-size=65535, array-size-semantics=VARIABLE-SIZE, implementation-data-type=OnlineCalSegInfoRec1
    CalCopySts1: compu {0=CALCOPYSTS_NOTRDY, 1=CALCOPYSTS_COPYPNDING, 2=CALCOPYSTS_COPYCMPL, 3=CALCOPYSTS_PROCERR}, implementation-data-type=uint8, type-emitter=RTE
    GetSegMod1: compu {0=GETSEGMOD_ADRINFO, 1=GETSEGMOD_STDINFO, 2=GETSEGMOD_ADRMPG}, implementation-data-type=uint8, type-emitter=RTE
    NtcNr1: compu {1..511=NTCNR_0X001..NTCNR_0X1FF}, implementation-data-type=uint16, type-emitter=RTE
    NtcSts1: compu {0=NTCSTS_PASSD, 1=NTCSTS_FAILD, 2=NTCSTS_PREPASSD, 3=NTCSTS_PREFAILD}, implementation-data-type=uint8, type-emitter=RTE
    OnlineCalPageInfoRec1: category=STRUCTURE, sw-calibration-access=READ-ONLY, type-emitter=TunSelnMngt
      element PageAcs: implementation-data-type=uint8
    OnlineCalSegInfoRec1: category=STRUCTURE, sw-calibration-access=READ-ONLY, type-emitter=TunSelnMngt
      element Page: implementation-data-type=Ary1D_OnlineCalPageInfoRec1_2
    OnlineCalStsRec2: category=STRUCTURE, type-emitter=RTE
      6 x element, all with category=TYPE_REFERENCE:
        Seg: implementation-data-type=Ary1D_OnlineCalSegInfoRec1_TunSelnMngt1
        CopySts: implementation-data-type=CalCopySts1
        ActvGroup: implementation-data-type=uint8
        ActvInin: implementation-data-type=uint8
        ActvIninOptSetA: implementation-data-type=uint8
        ActvRt: implementation-data-type=uint8
    RtIdxChgSts1: compu {phys=raw for raw 0, phys=raw for raw 1, phys=raw for raw 2, phys=raw for raw 3, phys=raw for raw 4, phys=raw for raw 5}, implementation-data-type=uint8, type-emitter=RTE
