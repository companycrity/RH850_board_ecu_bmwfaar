AUTOSAR XML (schema 4-0-3)
package /Nexteer/EcucDefs_TunSelnMngt
  ecuc definition collection NexteerParameterDefinition_TunSelnMngt: module=TunSelnMngt
  module definition TunSelnMngt [0..1]: category=VENDOR_SPECIFIC_MODULE_DEFINITION, refined-module-def=TunSelnMngt, variants pre-compile  # Calibration configuration and grouping for Tuning Selection Management.
    container TunSelnMngtCommon  # Contains the common settings for Tuning Selection Management.
      integer OnlineCalibrationRamSize: 0..20480, origin=NEXTEER, default-value=0  # This value sets the size of the RAM variable to hold the calibration components when online calibration is active. Size is in bytes, 0 will disable online calibration support.
      string TunSelnMngtIncludes [0..65535]: origin=Nexteer  # List of header files to be included.
    container XcpWriteAccess  # Contains the settings for XCP Write Access.
      enumeration EnableDevelopmentMode: {STD_OFF, STD_ON}, set at pre-compile, origin=Nexteer, default-value=STD_OFF  # If TRUE, XCP will have write access to the regions defined in both production and development . If FALSE, XCP write access will be limited to the regions defined for production only.
      container XcpWriteAccessRegions [0..65535]  # Container for XCP write access regions.
        integer StartingAddress: 0..4294967296, origin=NEXTEER, default-value=0  # Starting Address of the RAM range.
        integer EndingAddress: 0..4294967296, origin=NEXTEER, default-value=0  # Ending Address of the RAM range.
        boolean UseSymbolName: origin=NEXTEER, default-value=0  # If TRUE, symbol names for start and end address will be used. If FALSE, raw addresses will be used.
        boolean EnableForProduction: origin=NEXTEER, default-value=0  # If TRUE, can be used in both production and development mode settings. If FALSE, region will only be enabled for development mode.
        string StartingAddressSymbol: origin=NEXTEER, default-value=NULL_PTR  # Symbol name for the starting address of RAM
        string EndingAddressSymbol: origin=NEXTEER, default-value=NULL_PTR  # Symbol name for the ending address of RAM
    container CalRegions [1..65535]  # A calibration region defines where the group of calibration components are located in flash memory.
      container CommonComponent [0..65535]  # Container for common calibration containers.
        boolean ComponentPartOfIntegration: origin=NEXTEER, default-value=0  # Set to true if this component shall be connected to the application components in Developer and not the dummy components.
        symbolic name reference CommonComponentReference [0..1]: origin=NEXTEER, destination=CommonComponent  # Calibration Configuration: Common Component Reference | Reference for calibrations within the common calibration configuration.
      container InitializationComponent [0..65535]  # Container for initialization calibration containers.
        boolean ComponentPartOfIntegration: origin=NEXTEER, default-value=0  # Set to true if this component shall be connected to the application components in Developer and not the dummy components.
        symbolic name reference InitializationComponentReference [0..1]: origin=NEXTEER, destination=InitializationComponent  # Calibration Configuration: Initialization Component Reference | Reference for calibrations within the initialization calibration configuration.
      container InitializationOptionalSetAComponent [0..65535]  # Container for initialization optioanl set A calibration containers.
        boolean ComponentPartOfIntegration: origin=NEXTEER, default-value=0  # Set to true if this component shall be connected to the application components in Developer and not the dummy components.
        symbolic name reference InitializationOptionalSetAComponentReference [0..1]: origin=NEXTEER, destination=InitializationOptionalSetAComponent  # Calibration Configuration: Initialization Optional Set A Component Reference | Reference for calibrations within the initialization optional set A calibration configuration.
      container RuntimeComponent [0..65535]  # Container for supplier calibration containers.
        boolean ComponentPartOfIntegration: origin=NEXTEER  # Set to true if this component shall be connected to the application components in Developer and not the dummy components.
        symbolic name reference RuntimeComponentReference [0..1]: origin=NEXTEER, destination=RuntimeComponent  # Calibration Configuration: Supplier Component Reference | Reference for calibrations within the runtime calibration configuration.
    container CalibrationConfiguration  # The following groups represent the calibration components used in each calibration configuration.
      container InitializationSelectableCalibrationConfiguration [0..65535]  # The following groups represent the initialization calibration components for the given index.
        integer InitializationIndex: 0..65535, origin=NEXTEER  # Value represents the group of calibration components that will be activated when the desired initialization index is equal to this value.
        symbolic name reference InitializationComponentReference [0..65535]: origin=NEXTEER, destination=InitializationComponent  # Calibration Configuration: Initialization Component Reference | Initialization component reference for calibrations within this calibration configuration.
      container InitializationOptionalSetASelectableCalibrationConfiguration [0..65535]  # The following groups represent the initialization optional set A calibration components for the given index.
        integer InitializationOptionalSetAIndex: 0..65535, origin=NEXTEER  # Value represents the group of calibration components that will be activated when the desired initialization optional set A index is equal to this value.
        symbolic name reference InitializationOptionalSetAComponentReference [0..65535]: origin=NEXTEER, destination=InitializationOptionalSetAComponent  # Calibration Configuration: Initialization Optional Set A Component Reference | Initialization optional set A component reference for calibrations within this calibration configuration.
      container RuntimeSelectableCalibrationConfiguration [0..65535]  # The following groups represent the runtime selectable calibration components for the given index.
        integer RuntimeIndex: 0..65535, origin=NEXTEER  # Value represents the group of calibration components that will be activated when the desired runtime selection index is equal to this value.
        symbolic name reference RuntimeComponentReference [0..65535]: origin=NEXTEER, destination=RuntimeComponent  # Calibration Configuration: Runtime Component Reference | Runtime component reference for calibrations within this calibration configuration.
    container OnlineCalibrationGroup [0..65535]  # The following groups represent the calibration components used in each online calibration configuration.
      integer GroupIndex: 0..65535, origin=NEXTEER  # Value represents the group of calibration components that will be activated when the desired group (segment) index is equal to this value.
      symbolic name reference CommonComponentReference [0..65535]: origin=NEXTEER, destination=CommonComponent  # Calibration Configuration: Common Component Reference | Common component reference for calibrations within this calibration configuration.
      symbolic name reference InitializationComponentReference [0..65535]: origin=NEXTEER, destination=InitializationComponent  # Calibration Configuration: Initialization Component Reference | Initialization component reference for calibrations within this calibration configuration.
      symbolic name reference InitializationOptionalSetAComponentReference [0..65535]: origin=NEXTEER, destination=InitializationOptionalSetAComponent  # Calibration Configuration: Initialization Component Reference | Initialization component reference for calibrations within this calibration configuration.
      symbolic name reference RuntimeComponentReference [0..65535]: origin=NEXTEER, destination=RuntimeComponent  # Calibration Configuration: Runtime Component Reference | Runtime component reference for calibrations within this calibration configuration.
