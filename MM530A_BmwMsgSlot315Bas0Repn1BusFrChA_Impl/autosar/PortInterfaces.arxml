AUTOSAR XML (schema 4-0-3)
package /BMW/Platform/Stm/PortInterfaces
  sender receiver interface CentralErrorLockSignalInterface: invalidation-policy{data-element=centralErrorLock, handle-invalid=DONT-INVALIDATE}
    data centralErrorLock: type=Stm_CentralErrorLockType
  sender receiver interface EnergyStateSignalInterface: invalidation-policy{data-element=energyState, handle-invalid=DONT-INVALIDATE}
    data energyState: type=Stm_EnergyStateType
package /BMW/Platform/SysTime/PortInterfaces
  sender receiver interface SysTimeRx: invalidation-policy{data-element=timeSignal, handle-invalid=DONT-INVALIDATE}
    data timeSignal: type=uint32
package /ComponentTypes/DataTypeMappingSets
  port interface mapping set InterfaceMappingSet
    port-interface-mappings:
      4 x variable and parameter interface mapping:
        CentralErrorLockSignalInterfaceST_ILK_ERRM_FZM_Mapping: data-prototype-mapping{first-data-prototype=centralErrorLock, second-data-prototype=ST_ILK_ERRM_FZM}
        EnergyStateSignalInterfaceST_ENERG_FZM_Mapping: data-prototype-mapping{first-data-prototype=energyState, second-data-prototype=ST_ENERG_FZM}
        SysTimeRxT_SEC_COU_REL_PortIf1_Mapping: data-prototype-mapping{first-data-prototype=timeSignal, second-data-prototype=T_SEC_COU_REL}
        uint16_PortIf1TRGG_ENGTORQ_EPS_Mapping: data-prototype-mapping{first-data-prototype=uint16_PortIf1/Val, second-data-prototype=TRGG_ENGTORQ_EPS}
package /Nexteer/PortInterfaces
  sender receiver interface float32_PortIf1: invalidation-policy{data-element=float32_PortIf1/Val, handle-invalid=DONT-INVALIDATE}
    data Val: sw-calibration-access=READ-ONLY, type=float32
  sender receiver interface SysSt1_PortIf1: invalidation-policy{data-element=SysSt1_PortIf1/Val, handle-invalid=DONT-INVALIDATE}
    data Val: sw-calibration-access=READ-ONLY, type=SysSt1
  sender receiver interface uint16_PortIf1: invalidation-policy{data-element=uint16_PortIf1/Val, handle-invalid=DONT-INVALIDATE}
    data Val: sw-calibration-access=READ-ONLY, type=uint16
package /PortInterfaces
  20 x sender receiver interface:
    BATT_VLTG_EPS: invalidation-policy{data-element=BATT_VLTG_EPS, handle-invalid=DONT-INVALIDATE}
      data BATT_VLTG_EPS: type=BATT_VLTG_EPS
    BmwVehCdn1_PortIf1: invalidation-policy{data-element=BmwVehCdn1_PortIf1/Val, handle-invalid=DONT-INVALIDATE}
      data Val: type=BmwVehCdn1
    DBG_EPS_BS_MOD_58_BYTE_ID2: invalidation-policy{data-element=DBG_EPS_BS_MOD_58_BYTE_ID2, handle-invalid=DONT-INVALIDATE}
      data DBG_EPS_BS_MOD_58_BYTE_ID2: type=DBG_EPS_BS_MOD_58_BYTE_ID2
    ECU_TEMP_EPS: invalidation-policy{data-element=ECU_TEMP_EPS, handle-invalid=DONT-INVALIDATE}
      data ECU_TEMP_EPS: type=ECU_TEMP_EPS
    ESTIMD_PEAK_MOT_CURR_EPS: invalidation-policy{data-element=ESTIMD_PEAK_MOT_CURR_EPS, handle-invalid=DONT-INVALIDATE}
      data ESTIMD_PEAK_MOT_CURR_EPS: type=ESTIMD_PEAK_MOT_CURR_EPS
    MOT_FET_TEMP_EPS: invalidation-policy{data-element=MOT_FET_TEMP_EPS, handle-invalid=DONT-INVALIDATE}
      data MOT_FET_TEMP_EPS: type=MOT_FET_TEMP_EPS
    MOT_MAG_TEMP_EPS: invalidation-policy{data-element=MOT_MAG_TEMP_EPS, handle-invalid=DONT-INVALIDATE}
      data MOT_MAG_TEMP_EPS: type=MOT_MAG_TEMP_EPS
    MOT_TQ_CMD_EPS: invalidation-policy{data-element=MOT_TQ_CMD_EPS, handle-invalid=DONT-INVALIDATE}
      data MOT_TQ_CMD_EPS: type=MOT_TQ_CMD_EPS
    MOT_TQ_CMD_LIMD_EPS: invalidation-policy{data-element=MOT_TQ_CMD_LIMD_EPS, handle-invalid=DONT-INVALIDATE}
      data MOT_TQ_CMD_LIMD_EPS: type=MOT_TQ_CMD_LIMD_EPS
    MOT_VEL_EPS: invalidation-policy{data-element=MOT_VEL_EPS, handle-invalid=DONT-INVALIDATE}
      data MOT_VEL_EPS: type=MOT_VEL_EPS
    MOT_WIDG_TEMP_EPS: invalidation-policy{data-element=MOT_WIDG_TEMP_EPS, handle-invalid=DONT-INVALIDATE}
      data MOT_WIDG_TEMP_EPS: type=MOT_WIDG_TEMP_EPS
    PRIM_HW_TQ_SNSR_VLTG_EPS: invalidation-policy{data-element=PRIM_HW_TQ_SNSR_VLTG_EPS, handle-invalid=DONT-INVALIDATE}
      data PRIM_HW_TQ_SNSR_VLTG_EPS: type=PRIM_HW_TQ_SNSR_VLTG_EPS
    SECDRY_HW_TQ_SNSR_VLTG_EPS: invalidation-policy{data-element=SECDRY_HW_TQ_SNSR_VLTG_EPS, handle-invalid=DONT-INVALIDATE}
      data SECDRY_HW_TQ_SNSR_VLTG_EPS: type=SECDRY_HW_TQ_SNSR_VLTG_EPS
    ST_CON_VEH_EPS: invalidation-policy{data-element=ST_CON_VEH_EPS, handle-invalid=DONT-INVALIDATE}
      data ST_CON_VEH_EPS: type=ST_CON_VEH_EPS
    ST_ENERG_FZM: invalidation-policy{data-element=ST_ENERG_FZM, handle-invalid=DONT-INVALIDATE}
      data ST_ENERG_FZM: type=ST_ENERG_FZM1
    ST_ILK_ERRM_FZM: invalidation-policy{data-element=ST_ILK_ERRM_FZM, handle-invalid=DONT-INVALIDATE}
      data ST_ILK_ERRM_FZM: type=ST_ILK_ERRM_FZM1
    SYS_ST_EPS: invalidation-policy{data-element=SYS_ST_EPS, handle-invalid=DONT-INVALIDATE}
      data SYS_ST_EPS: type=SYS_ST_EPS
    T_SEC_COU_REL_PortIf1: invalidation-policy{data-element=T_SEC_COU_REL, handle-invalid=DONT-INVALIDATE}
      data T_SEC_COU_REL: data-constr=T_SEC_COU_REL_DataConstr, type=uint32
    TRGG_ENGTORQ_EPS: invalidation-policy{data-element=TRGG_ENGTORQ_EPS, handle-invalid=DONT-INVALIDATE}
      data TRGG_ENGTORQ_EPS: type=TRGG_ENGTORQ_EPS1
    VEH_SPD_EPS: invalidation-policy{data-element=VEH_SPD_EPS, handle-invalid=DONT-INVALIDATE}
      data VEH_SPD_EPS: type=VEH_SPD_EPS
