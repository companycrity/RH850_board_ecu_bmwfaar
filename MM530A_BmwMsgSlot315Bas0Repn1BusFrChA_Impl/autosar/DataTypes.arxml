AUTOSAR XML (schema 4-0-3)
standard types defined: boolean, float32, uint16, uint32, uint8, boolean_CompuMethod, boolean_DataConstr, float32_DataConstr, uint16_DataConstr, uint32_DataConstr, uint8_DataConstr
package /BMW/Platform/Stm/ImplementationDataTypes
  impl type Stm_CentralErrorLockType: compu {0=STM_CEL_UNLOCKED, 1=STM_CEL_LOCKED, 3=STM_CEL_INVALID}, implementation-data-type=uint8
  impl type Stm_EnergyStateType: compu {0=STM_ENERGY_GOOD, 1=STM_ENERGY_OK, 2=STM_ENERGY_SHORTAGE, 3=STM_ENERGY_SEVERE_SHORTAGE, 15=STM_ENERGY_INVALID}, implementation-data-type=uint8
package /DataTypes
  18 x impl type, all with category=VALUE:
    BATT_VLTG_EPS: base-type=uint16, compu {identical}, range phys 0..65535
    DBG_EPS_BS_MOD_58_BYTE_ID2: base-type=uint8
    ECU_TEMP_EPS: base-type=uint8, compu {identical}, range phys 0..255
    ESTIMD_PEAK_MOT_CURR_EPS: base-type=uint32, compu {identical}, range phys 0..4294967295
    MOT_FET_TEMP_EPS: base-type=uint8, compu {identical}, range phys 0..255
    MOT_MAG_TEMP_EPS: base-type=uint8, compu {identical}, range phys 0..255
    MOT_TQ_CMD_EPS: base-type=uint16, compu {identical}, range phys 0..65535
    MOT_TQ_CMD_LIMD_EPS: base-type=uint16, compu {identical}, range phys 0..65535
    MOT_VEL_EPS: base-type=uint16, compu {identical}, range phys 0..65535
    MOT_WIDG_TEMP_EPS: base-type=uint16, compu {identical}, range phys 0..65535
    PRIM_HW_TQ_SNSR_VLTG_EPS: base-type=uint8, compu {identical}, range phys 0..255
    SECDRY_HW_TQ_SNSR_VLTG_EPS: base-type=uint8, compu {identical}, range phys 0..255
    ST_CON_VEH_EPS: base-type=uint8, compu {identical}, range phys 0..255
    ST_ENERG_FZM1:
      base-type=uint8
      compu {0=ENSTATE_GOOD (ST_ENERG_FZM_ENSTATE_GOOD), 1=ENSTATE_OK (ST_ENERG_FZM_ENSTATE_OK), 2=ENSTATE_SHORTAGE (ST_ENERG_FZM_ENSTATE_SHORTAGE), 3=ENSTATE_SEVERE_SHORTAGE (ST_ENERG_FZM_ENSTATE_SEVERE_SHORTAGE), 15=SignalUngueltig (ST_ENERG_FZM_SignalUngueltig) (BNE original name: Signal ungültig)} "Transp.MOST-GW-Migration, 01.09.2006: Zusammenführung der Signalklasse Status_Energie_FZM [1] mit den Parametern EnergyStatus [2]."
      range raw 0..15
      invalid-value=15
    ST_ILK_ERRM_FZM1:
      base-type=uint8
      compu {0=Fehlerspeicherfreigabe (ST_ILK_ERRM_FZM_Fehlerspeicherfreigabe) (Eintrag von Fehlern uneingeschränkt), 1=Fehlerspeichersperre (ST_ILK_ERRM_FZM_Fehlerspeichersperre) (Bereich Netzwerkfehler ist zu sperren), 2=Reserve (ST_ILK_ERRM_FZM_Reserve) (reserviert für zukünftige Erweiterungen), 3=SignalUngueltig (ST_ILK_ERRM_FZM_SignalUngueltig) (BNE original name: Signal ungültig)} "Automatisch generiert (Migration 2004-10-30) Transp.MOST-GW-Migration, 01.09.2006: Zusammenführung der Signalklasse Status_Sperre_Fehlerspeicher_FZM [2] mit den Parametern ErrorMemoryLock [1]."
      range raw 0..3
      invalid-value=3
    SYS_ST_EPS: base-type=uint8, compu {identical}, range phys 0..255
    TRGG_ENGTORQ_EPS1:
      base-type=uint16
      compu {phys=raw*0.01-10 for raw 1000..201000, 4093=Funktionsschnittstelle_ist_nicht_verfuegbar (TRGG_ENGTORQ_EPS_Funktionsschnittstelle_ist_nicht_verfuegbar) (Sendefunktion in Betrieb, Werte nicht verfügbar), 4094=Funktion_meldet_Fehler (TRGG_ENGTORQ_EPS_Funktion_meldet_Fehler) (Sendefunktion in Betrieb, meldet Fehler), 4095=Signal_unbefuellt (TRGG_ENGTORQ_EPS_Signal_unbefuellt) (Sendefunktion nicht in Betrieb)}
      range phys 0..2000
      invalid-value=4095
    VEH_SPD_EPS: base-type=uint16, compu {identical}, range phys 0..65535
package /DataTypes/DataConstrs
  range T_SEC_COU_REL_DataConstr: raw 0..4294967294
package /Nexteer/DataTypes
  impl type BmwVehCdn1: compu {1=BMWVEHCDN_PRKGNBNOK, 2=BMWVEHCDN_PRKGBNOK, 3=BMWVEHCDN_FCTCUSTNOTINFZG, 5=BMWVEHCDN_LVNG, 7=BMWVEHCDN_CHKDIAGCANLS, 8=BMWVEHCDN_DRVRPREPGFOROPER, 10=BMWVEHCDN_DRVG, 12=BMWVEHCDN_DRVRPREPGFOREXITOPER, 15=BMWVEHCDN_INVLD}, implementation-data-type=uint8, type-emitter=RTE
  impl type SysSt1: compu {0=SYSST_DI, 1=SYSST_OFF, 2=SYSST_ENA, 3=SYSST_WRMININ}, implementation-data-type=uint8, type-emitter=RTE
