AUTOSAR XML (schema 4-0-3)
package /Nexteer/Calibrations
  parameter interface sint8_CalPortIf1
    parameter data prototype Val: sw-calibration-access=READ-WRITE, type=sint8
package /Nexteer/PortInterfaces
  6 x sender receiver interface:
    BmwPinionAgQlfr1_PortIf1: invalidation-policy{data-element=BmwPinionAgQlfr1_PortIf1/Val, handle-invalid=DONT-INVALIDATE}
      data Val: sw-calibration-access=READ-ONLY, type=BmwPinionAgQlfr1
    BmwSeldPosnUnit1_PortIf1: invalidation-policy{data-element=BmwSeldPosnUnit1_PortIf1/Val, handle-invalid=DONT-INVALIDATE}
      data Val: sw-calibration-access=READ-ONLY, type=BmwSeldPosnUnit1
    BmwTqSnsrIdx1_Port1: invalidation-policy{data-element=BmwTqSnsrIdx1_Port1/Val, handle-invalid=DONT-INVALIDATE}
      data Val: sw-calibration-access=READ-ONLY, type=BmwTqSnsrIdx1
    boolean_PortIf1: invalidation-policy{data-element=Logl, handle-invalid=DONT-INVALIDATE}
      data Logl: sw-calibration-access=READ-ONLY, type=boolean
    float32_PortIf1: invalidation-policy{data-element=float32_PortIf1/Val, handle-invalid=DONT-INVALIDATE}
      data Val: sw-calibration-access=READ-ONLY, type=float32
    uint16_PortIf1: invalidation-policy{data-element=uint16_PortIf1/Val, handle-invalid=DONT-INVALIDATE}
      data Val: sw-calibration-access=READ-ONLY, type=uint16
package /PortInterfaces
  sender receiver interface sigGroup_AVL_PO_EPS: invalidation-policy{data-element=sigGroup_AVL_PO_EPS, handle-invalid=KEEP}
    data sigGroup_AVL_PO_EPS: type=sigGroup_AVL_PO_EPS1
