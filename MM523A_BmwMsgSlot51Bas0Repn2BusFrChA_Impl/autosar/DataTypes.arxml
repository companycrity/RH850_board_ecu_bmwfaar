AUTOSAR XML (schema 4-0-3)
standard types defined: boolean, float32, sint8, uint16, uint8, boolean_CompuMethod, boolean_DataConstr, float32_DataConstr, sint8_DataConstr, uint16_DataConstr, uint8_DataConstr
package /DataTypes
  9 x impl type:
    ALIV_AVL_PO_EPS1: category=VALUE, base-type=uint8, compu {0=Zaehlerstand0DotDotE (ALIV_COU_4_Zaehlerstand0DotDotE) (BNE original name: Zählerstand 0..E), 15=SignalUngueltig (ALIV_COU_4_SignalUngueltig) (BNE original name: Signal ungültig)}
    AVL_PO_EPS1: category=VALUE, base-type=uint16
    AVL_PO_IDX_EPS1: category=VALUE, base-type=uint16
    CRC_AVL_PO_EPS1: category=VALUE, base-type=uint8
    IDX_TORQ_SEN1: category=VALUE, base-type=uint8, compu {0=Initialisierung (IDX_TORQ_SEN_Initialisierung), 1=KeineIndexFlanke (IDX_TORQ_SEN_KeineIndexFlanke) (BNE original name: Keine Index Flanke), 2=IndexFlanke (IDX_TORQ_SEN_IndexFlanke) (BNE original name: Index Flanke), 3=SignalUngueltig (IDX_TORQ_SEN_SignalUngueltig) (BNE original name: Signal ungültig)}
    OFFS_GRD_MID_EPS1: category=VALUE, base-type=uint16
    QU_AVL_PO_EPS1:
      category=VALUE
      base-type=uint8
      compu {8=Initialisierung (QU_AVL_PINA_EPS_Initialisierung) (Nach jedem Reset und Aufstarten des EPS-Steuergeräts. Nutzsignal wird permanent mit Nutzwert 0 befüllt.), 1=SignalwertIstGueltigUndAbgesichertUndPlausibilisiert (QU_AVL_PINA_EPS_SignalwertIstGueltigUndAbgesichertUndPlausibilisiert) (BNE original name: Signalwert ist gültig und abgesichert und plausibilisiert), 2=SignalwertIstGueltig (QU_AVL_PINA_EPS_SignalwertIstGueltig) (BNE original name: Signalwert ist gültig), 4=ErsatzwertIstImNutzsignalGesetzt (QU_AVL_PINA_EPS_ErsatzwertIstImNutzsignalGesetzt) (BNE original name: Ersatzwert ist im Nutzsignal gesetzt), 9=SignalwertIstGueltigZustandSlashStatusTemporaer_mittlereSignalqualitaet_ (QU_AVL_PINA_EPS_SignalwertIstGueltigZustandSlashStatusTemporaer_mittlereSignalqualitaet_) (BNE original name: Signalwert ist gültig, Zustand/Status temporär (mittlere Signalqualität)), 10=SignalwertIstGueltigZustandSlashStatusTemporaer_geringeSignalqualitaet_ (QU_AVL_PINA_EPS_SignalwertIstGueltigZustandSlashStatusTemporaer_geringeSignalqualitaet_) (BNE original name: Signalwert ist gültig, Zustand/Status temporär (geringe Signalqualität)), 12=AbgleichwertIstImNutzsignalGesetztZustandSlashStatusTemporaer (QU_AVL_PINA_EPS_AbgleichwertIstImNutzsignalGesetztZustandSlashStatusTemporaer) (BNE original name: Abgleichwert ist im Nutzsignal gesetzt, Zustand/Status temporär), 14=SignalwertIstUngueltigZustandSlashStatusTemporaer (QU_AVL_PINA_EPS_SignalwertIstUngueltigZustandSlashStatusTemporaer) (BNE original name: Signalwert ist ungültig, Zustand/Status temporär), 15=SignalUngueltig (QU_AVL_PINA_EPS_SignalUngueltig) (BNE original name: Signal ungültig)}
    sigGroup_AVL_PO_EPS1: category=STRUCTURE
      8 x element, all with category=TYPE_REFERENCE:
        AVL_PO_EPS: range phys 0..65534, implementation-data-type=AVL_PO_EPS1
        IDX_TORQ_SEN: range raw 0..3, implementation-data-type=IDX_TORQ_SEN1
        OFFS_GRD_MID_EPS: range phys 0..4094, implementation-data-type=OFFS_GRD_MID_EPS1
        AVL_PO_IDX_EPS: range phys 0..65534, implementation-data-type=AVL_PO_IDX_EPS1
        CRC_AVL_PO_EPS: range phys 0..255 "Standartabsicherung Apllikations-CRC.", implementation-data-type=CRC_AVL_PO_EPS1
        QU_AVL_PO_EPS: range raw 0..15, implementation-data-type=QU_AVL_PO_EPS1
        ALIV_AVL_PO_EPS: range raw 0..15, implementation-data-type=ALIV_AVL_PO_EPS1
        UN_PO_EPS: range raw 0..3, implementation-data-type=UN_PO_EPS1
    UN_PO_EPS1: category=VALUE, base-type=uint8, compu {0=Ritzelschnittstelle (UN_PO_EPS_Ritzelschnittstelle) (Die Position wird in Grad übertragen.), 1=Zahnstangenhubschnittstelle (UN_PO_EPS_Zahnstangenhubschnittstelle) (Die Position wird in Millimeter übertragen (Einheit=0.2mm).), 3=SignalUngueltig (UN_PO_EPS_SignalUngueltig) (BNE original name: Signal ungültig)}
package /Nexteer/DataTypes
  impl type BmwPinionAgQlfr1: compu {1=PinionAgQlfrSigValVldAndPlaus, 2=PinionAgQlfrSigValVld, 4=PinionAgQlfrSubValSetInUsrSig, 8=PinionAgQlfrInit, 9=PinionAgQlfrSigValVldAndTmpOfAvrgQly, 10=PinionAgQlfrSigValVldAndTmpOfLoQly, 12=PinionAgQlfrAdjmtValSetInUsrSig, 14=PinionAgQlfrSigValInvldButStTmp, 15=PinionAgQlfrInvldSig}, implementation-data-type=uint8, type-emitter=RTE
  impl type BmwSeldPosnUnit1: compu {0=BMWSELDPOSNUNIT_PINIONIF, 1=BMWSELDPOSNUNIT_TOOTHEDRACKSTROKEIF, 3=BMWSELDPOSNUNIT_INVLDSIG}, implementation-data-type=uint8, type-emitter=RTE
  impl type BmwTqSnsrIdx1: compu {0=BMWTQSNSRIDX_INIT, 1=BMWTQSNSRIDX_NOIDXEDGE, 2=BMWTQSNSRIDX_IDXEDGE, 3=BMWTQSNSRIDX_INVLDSIG}, implementation-data-type=uint8, type-emitter=RTE
package /Nexteer/Units
  unit Uls: display-name=Uls, factor-si-to-unit=1, offset-si-to-unit=0
