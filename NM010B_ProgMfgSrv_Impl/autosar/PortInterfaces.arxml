AUTOSAR XML (schema 4-0-3)
package /Nexteer/PortInterfaces
  4 x client server interface:
    MotVrntRead_PortIf1
      operation Oper: possible-error=MotVrntRead_PortIf1/E_NOT_OK
        arg BmwDesIninOptSetAIdx_Arg: type=uint8, direction=OUT, server-argument-impl-policy=USE-ARGUMENT-TYPE
      error E_NOT_OK: error-code=1
    MotVrntWr_PortIf1
      operation Oper: possible-error=MotVrntWr_PortIf1/E_NOT_OK
        arg BmwDesIninOptSetAIdx_Arg: type=uint8, direction=IN, server-argument-impl-policy=USE-ARGUMENT-TYPE
      error E_NOT_OK: error-code=1
    TunVrntRead_PortIf1
      operation Oper: possible-error=TunVrntRead_PortIf1/E_NOT_OK
        arg BmwDesIninIdx_Arg: type=uint8, direction=OUT, server-argument-impl-policy=USE-ARGUMENT-TYPE
      error E_NOT_OK: error-code=1
    TunVrntWr_PortIf1
      operation Oper: possible-error=TunVrntWr_PortIf1/E_NOT_OK
        arg BmwDesIninIdx_Arg: type=uint8, direction=IN, server-argument-impl-policy=USE-ARGUMENT-TYPE
      error E_NOT_OK: error-code=1
