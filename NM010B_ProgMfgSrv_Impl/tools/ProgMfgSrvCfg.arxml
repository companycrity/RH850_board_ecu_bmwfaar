AUTOSAR XML (schema 4-0-3)
package /ActiveEcuC
  module config NxtrMfgSrv: implementation-config-variant=VARIANT-PRE-COMPILE
    6 x ProgramSpecificService:
      SrvSessionDflt: ServiceType=Session - 0x10, RequestLength=0, ResponseLength=0, SubFunction=1
        AccessControls: NexteerSession=false, SecurityAccess=false
      SrvFED0Rd: ServiceType=Read - 0x22, RequestLength=0, ResponseLength=1, ServiceId=65232
        AccessControls: NexteerSession=true, SecurityAccess=false
      SrvFED0Wr: ServiceType=Write - 0x2E, RequestLength=1, ResponseLength=0, ServiceId=65232
        AccessControls: NexteerSession=true, SecurityAccess=true
      SrvFED1Rd: ServiceType=Read - 0x22, RequestLength=0, ResponseLength=1, ServiceId=65233
        AccessControls: NexteerSession=true, SecurityAccess=false
      SrvFED1Wr: ServiceType=Write - 0x2E, RequestLength=1, ResponseLength=0, ServiceId=65233
        AccessControls: NexteerSession=true, SecurityAccess=true
      SrvTesterPresent_Send: ServiceType=TesterPresent - 0x3E, RequestLength=0, ResponseLength=0, SubFunction=0
        AccessControls: NexteerSession=false, SecurityAccess=false
    4 x CommonService, all with ServiceType=Periodic - 0x2A, ResponseLength=0:
      SrvPerRdFast: RequestLength=65535, SubFunction=1
        AccessControls: NexteerSession=true, SecurityAccess=false
      SrvPerRdMed: RequestLength=65535, SubFunction=2
        AccessControls: NexteerSession=true, SecurityAccess=false
      SrvPerRdSlow: RequestLength=65535, SubFunction=3
        AccessControls: NexteerSession=true, SecurityAccess=false
      SrvPerRdStop: RequestLength=0, SubFunction=4
        AccessControls: NexteerSession=true, SecurityAccess=false
