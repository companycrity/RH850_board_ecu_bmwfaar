AUTOSAR XML (schema 4-0-3)
standard types defined: float32, uint16, uint8, float32_DataConstr, uint16_DataConstr, uint8_DataConstr
package /Nexteer/DataTypes
  18 x impl type, all with type-emitter=RTE:
    Ary1D_u10p6_4: category=ARRAY, sw-calibration-access=READ-ONLY
      element Element: array-size=4, array-size-semantics=FIXED-SIZE, implementation-data-type=u10p6
    Ary1D_u15p1_9: category=ARRAY, sw-calibration-access=READ-ONLY
      element Element: array-size=9, array-size-semantics=FIXED-SIZE, implementation-data-type=u15p1
    Ary1D_u1p15_4: category=ARRAY, sw-calibration-access=READ-ONLY
      element Element: array-size=4, array-size-semantics=FIXED-SIZE, implementation-data-type=u1p15
    Ary1D_u1p15_9: category=ARRAY, sw-calibration-access=READ-ONLY
      element Element: array-size=9, array-size-semantics=FIXED-SIZE, implementation-data-type=u1p15
    Ary1D_u4p12_9: category=ARRAY, sw-calibration-access=READ-ONLY
      element Element: array-size=9, array-size-semantics=FIXED-SIZE, implementation-data-type=u4p12
    Ary1D_u6p10_9: category=ARRAY, sw-calibration-access=READ-ONLY
      element Element: array-size=9, array-size-semantics=FIXED-SIZE, implementation-data-type=u6p10
    Ary1D_u9p7_12: category=ARRAY, sw-calibration-access=READ-ONLY
      element Element: array-size=12, array-size-semantics=FIXED-SIZE, implementation-data-type=u9p7
    Ary2D_u15p1_12_9: category=ARRAY, sw-calibration-access=READ-ONLY
      element Element: array-size=12, array-size-semantics=FIXED-SIZE, implementation-data-type=Ary1D_u15p1_9
    Ary2D_u1p15_12_9: category=ARRAY, sw-calibration-access=READ-ONLY
      element Element: array-size=12, array-size-semantics=FIXED-SIZE, implementation-data-type=Ary1D_u1p15_9
    Ary2D_u4p12_12_9: category=ARRAY, sw-calibration-access=READ-ONLY
      element Element: array-size=12, array-size-semantics=FIXED-SIZE, implementation-data-type=Ary1D_u4p12_9
    Ary2D_u6p10_12_9: category=ARRAY, sw-calibration-access=READ-ONLY
      element Element: array-size=12, array-size-semantics=FIXED-SIZE, implementation-data-type=Ary1D_u6p10_9
    EotSt1: compu {0=EOTST_DISAD, 1=EOTST_NORM, 2=EOTST_ENTR, 3=EOTST_EXIT}, implementation-data-type=uint8
    u10p6: implementation-data-type=uint16
    u15p1: implementation-data-type=uint16
    u1p15: implementation-data-type=uint16
    u4p12: implementation-data-type=uint16
    u6p10: implementation-data-type=uint16
    u9p7: implementation-data-type=uint16
