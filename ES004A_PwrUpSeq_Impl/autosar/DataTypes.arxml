AUTOSAR XML (schema 4-0-3)
standard types defined: boolean, uint8, boolean_CompuMethod, boolean_DataConstr, uint8_DataConstr
package /Nexteer/DataTypes
  impl type SysSt1: compu {0=SYSST_DI, 1=SYSST_OFF, 2=SYSST_ENA, 3=SYSST_WRMININ}, implementation-data-type=ImplementationDataTypes/uint8, type-emitter=RTE
