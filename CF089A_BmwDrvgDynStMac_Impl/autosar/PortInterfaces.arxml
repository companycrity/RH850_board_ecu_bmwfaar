AUTOSAR XML (schema 4-0-3)
package /Nexteer/Calibrations
  parameter interface float32_CalPortIf1
    parameter data prototype Val: sw-calibration-access=READ-WRITE, type=float32
  parameter interface uint16_CalPortIf1
    parameter data prototype Val: sw-calibration-access=READ-WRITE, type=uint16
package /Nexteer/PortInterfaces
  client server interface GetRefTmr100MicroSec32bit_PortIf1
    operation Oper
      arg RefTmr_Arg: type=uint32, direction=OUT, server-argument-impl-policy=USE-ARGUMENT-TYPE
  client server interface GetTiSpan100MicroSec32bit_PortIf1
    operation Oper
      arg RefTmr_Arg: type=uint32, direction=IN, server-argument-impl-policy=USE-ARGUMENT-TYPE
      arg TiSpan_Arg: type=uint32, direction=OUT, server-argument-impl-policy=USE-ARGUMENT-TYPE
  6 x sender receiver interface:
    BmwOvrlCmdQlfr1_PortIf1: invalidation-policy{data-element=BmwOvrlCmdQlfr1_PortIf1/Val, handle-invalid=DONT-INVALIDATE}
      data Val: sw-calibration-access=READ-ONLY, type=BmwOvrlCmdQlfr1
    BmwTrfcJamAssiDampgStReq1_PortIf1: invalidation-policy{data-element=BmwTrfcJamAssiDampgStReq1_PortIf1/Val, handle-invalid=DONT-INVALIDATE}
      data Val: sw-calibration-access=READ-ONLY, type=BmwTrfcJamAssiDampgStReq1
    boolean_PortIf1: invalidation-policy{data-element=Logl, handle-invalid=DONT-INVALIDATE}
      data Logl: sw-calibration-access=READ-ONLY, type=boolean
    DrvgDynIfSt1_PortIf1: invalidation-policy{data-element=DrvgDynIfSt1_PortIf1/Val, handle-invalid=DONT-INVALIDATE}
      data Val: sw-calibration-access=READ-ONLY, type=DrvgDynIfSt1
    float32_PortIf1: invalidation-policy{data-element=float32_PortIf1/Val, handle-invalid=DONT-INVALIDATE}
      data Val: sw-calibration-access=READ-ONLY, type=float32
    StsSteerAssi1_PortIf1: invalidation-policy{data-element=StsSteerAssi1_PortIf1/Val, handle-invalid=DONT-INVALIDATE}
      data Val: sw-calibration-access=READ-ONLY, type=StsSteerAssi1
package /PortInterfaces
  sender receiver interface BmwVehCdn1_PortIf1: invalidation-policy{data-element=BmwVehCdn1_PortIf1/Val, handle-invalid=DONT-INVALIDATE}
    data Val: type=BmwVehCdn1
