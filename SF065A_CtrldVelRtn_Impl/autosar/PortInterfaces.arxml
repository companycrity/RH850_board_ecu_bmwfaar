AUTOSAR XML (schema 4-0-3)
package /Nexteer/Calibrations
  26 x parameter interface:
    Ary1D_f32_4_CalPortIf1
      parameter data prototype Ary1D: sw-calibration-access=READ-WRITE, type=Ary1D_f32_4
    Ary1D_f32_5_CalPortIf1
      parameter data prototype Ary1D: sw-calibration-access=READ-WRITE, type=Ary1D_f32_5
    Ary1D_s10p5_8_CalPortIf1
      parameter data prototype Ary1D: sw-calibration-access=READ-WRITE, type=Ary1D_s10p5_8
    Ary1D_u12p4_7_CalPortIf1
      parameter data prototype Ary1D: sw-calibration-access=READ-WRITE, type=Ary1D_u12p4_7
    Ary1D_u12p4_9_CalPortIf1
      parameter data prototype Ary1D: sw-calibration-access=READ-WRITE, type=Ary1D_u12p4_9
    Ary1D_u2p14_4_CalPortIf1
      parameter data prototype Ary1D: sw-calibration-access=READ-WRITE, type=Ary1D_u2p14_4
    Ary1D_u2p14_5_CalPortIf1
      parameter data prototype Ary1D: sw-calibration-access=READ-WRITE, type=Ary1D_u2p14_5
    Ary1D_u2p14_9_CalPortIf1
      parameter data prototype Ary1D: sw-calibration-access=READ-WRITE, type=Ary1D_u2p14_9
    Ary1D_u4p12_8_CalPortIf1
      parameter data prototype Ary1D: sw-calibration-access=READ-WRITE, type=Ary1D_u4p12_8
    Ary1D_u8p8_8_CalPortIf1
      parameter data prototype Ary1D: sw-calibration-access=READ-WRITE, type=Ary1D_u8p8_8
    Ary1D_u9p7_5_CalPortIf1
      parameter data prototype Ary1D: sw-calibration-access=READ-WRITE, type=Ary1D_u9p7_5
    Ary1D_u9p7_8_CalPortIf1
      parameter data prototype Ary1D: sw-calibration-access=READ-WRITE, type=Ary1D_u9p7_8
    Ary2D_f32_5_4_CalPortIf1
      parameter data prototype Ary2D: sw-calibration-access=READ-WRITE, type=Ary2D_f32_5_4
    Ary2D_f32_5_5_CalPortIf1
      parameter data prototype Ary2D: sw-calibration-access=READ-WRITE, type=Ary2D_f32_5_5
    Ary2D_u10p6_8_12_CalPortIf1
      parameter data prototype Ary2D: sw-calibration-access=READ-WRITE, type=Ary2D_u10p6_8_12
    Ary2D_u10p6_8_9_CalPortIf1
      parameter data prototype Ary2D: sw-calibration-access=READ-WRITE, type=Ary2D_u10p6_8_9
    Ary2D_u12p4_8_12_CalPortIf1
      parameter data prototype Ary2D: sw-calibration-access=READ-WRITE, type=Ary2D_u12p4_8_12
    Ary2D_u2p14_5_10_CalPortIf1
      parameter data prototype Ary2D: sw-calibration-access=READ-WRITE, type=Ary2D_u2p14_5_10
    Ary2D_u2p14_5_8_CalPortIf1
      parameter data prototype Ary2D: sw-calibration-access=READ-WRITE, type=Ary2D_u2p14_5_8
    Ary2D_u2p14_7_8_CalPortIf1
      parameter data prototype Ary2D: sw-calibration-access=READ-WRITE, type=Ary2D_u2p14_7_8
    Ary2D_u6p10_5_9_CalPortIf1
      parameter data prototype Ary2D: sw-calibration-access=READ-WRITE, type=Ary2D_u6p10_5_9
    Ary2D_u6p10_8_9_CalPortIf1
      parameter data prototype Ary2D: sw-calibration-access=READ-WRITE, type=Ary2D_u6p10_8_9
    Ary2D_u8p8_5_10_CalPortIf1
      parameter data prototype Ary2D: sw-calibration-access=READ-WRITE, type=Ary2D_u8p8_5_10
    Ary2D_u8p8_5_8_CalPortIf1
      parameter data prototype Ary2D: sw-calibration-access=READ-WRITE, type=Ary2D_u8p8_5_8
    boolean_CalPortIf1
      parameter data prototype Logl: sw-calibration-access=READ-WRITE, type=boolean
    float32_CalPortIf1
      parameter data prototype Val: sw-calibration-access=READ-WRITE, type=float32
package /Nexteer/PortInterfaces
  sender receiver interface boolean_PortIf1: invalidation-policy{data-element=Logl, handle-invalid=DONT-INVALIDATE}
    data Logl: sw-calibration-access=READ-ONLY, type=boolean
  sender receiver interface float32_PortIf1: invalidation-policy{data-element=float32_PortIf1/Val, handle-invalid=DONT-INVALIDATE}
    data Val: sw-calibration-access=READ-ONLY, type=float32
  sender receiver interface sint8_PortIf1: invalidation-policy{data-element=sint8_PortIf1/Val, handle-invalid=DONT-INVALIDATE}
    data Val: sw-calibration-access=READ-ONLY, type=sint8
