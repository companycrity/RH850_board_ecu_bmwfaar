AUTOSAR XML (schema 4-0-3)
standard types defined: boolean, float32, sint16, sint8, uint16, boolean_CompuMethod, boolean_DataConstr, float32_DataConstr, sint16_DataConstr, sint8_DataConstr, uint16_DataConstr, float64_DataConstr, sint32_DataConstr, uint32_DataConstr, uint8_DataConstr
package /Nexteer/DataTypes
  40 x impl type:
    Ary1D_f32_4: category=ARRAY, sw-calibration-access=READ-ONLY, type-emitter=RTE
      element Element: array-size=4, array-size-semantics=FIXED-SIZE, implementation-data-type=ImplementationDataTypes/float32
    Ary1D_f32_5: category=ARRAY, sw-calibration-access=READ-ONLY, type-emitter=RTE
      element Element: array-size=5, array-size-semantics=FIXED-SIZE, implementation-data-type=ImplementationDataTypes/float32
    Ary1D_s10p5_8: category=ARRAY, sw-calibration-access=READ-ONLY, type-emitter=RTE
      element Element: array-size=8, array-size-semantics=FIXED-SIZE, implementation-data-type=s10p5
    Ary1D_u10p6_12: category=ARRAY, sw-calibration-access=READ-ONLY, type-emitter=RTE
      element Element: array-size=12, array-size-semantics=FIXED-SIZE, implementation-data-type=u10p6
    Ary1D_u10p6_9: category=ARRAY, sw-calibration-access=READ-ONLY, type-emitter=RTE
      element Element: array-size=9, array-size-semantics=FIXED-SIZE, implementation-data-type=u10p6
    Ary1D_u12p4_12: category=ARRAY, sw-calibration-access=READ-ONLY, type-emitter=RTE
      element Element: array-size=12, array-size-semantics=FIXED-SIZE, implementation-data-type=u12p4
    Ary1D_u12p4_7: category=ARRAY, sw-calibration-access=READ-ONLY, type-emitter=RTE
      element Element: array-size=7, array-size-semantics=FIXED-SIZE, implementation-data-type=u12p4
    Ary1D_u12p4_9: category=ARRAY, sw-calibration-access=READ-ONLY, type-emitter=RTE
      element Element: array-size=9, array-size-semantics=FIXED-SIZE, implementation-data-type=u12p4
    Ary1D_u2p14_10: category=ARRAY, sw-calibration-access=READ-ONLY, type-emitter=RTE
      element Element: array-size=10, array-size-semantics=FIXED-SIZE, implementation-data-type=u2p14
    Ary1D_u2p14_4: category=ARRAY, sw-calibration-access=READ-ONLY, type-emitter=RTE
      element Element: array-size=4, array-size-semantics=FIXED-SIZE, implementation-data-type=u2p14
    Ary1D_u2p14_5: category=ARRAY, sw-calibration-access=READ-ONLY, type-emitter=RTE
      element Element: array-size=5, array-size-semantics=FIXED-SIZE, implementation-data-type=u2p14
    Ary1D_u2p14_8: category=ARRAY, sw-calibration-access=READ-ONLY, type-emitter=RTE
      element Element: array-size=8, array-size-semantics=FIXED-SIZE, implementation-data-type=u2p14
    Ary1D_u2p14_9: category=ARRAY, sw-calibration-access=READ-ONLY, type-emitter=RTE
      element Element: array-size=9, array-size-semantics=FIXED-SIZE, implementation-data-type=u2p14
    Ary1D_u4p12_8: category=ARRAY, sw-calibration-access=READ-ONLY, type-emitter=RTE
      element Element: array-size=8, array-size-semantics=FIXED-SIZE, implementation-data-type=u4p12
    Ary1D_u6p10_9: category=ARRAY, sw-calibration-access=READ-ONLY, type-emitter=RTE
      element Element: array-size=9, array-size-semantics=FIXED-SIZE, implementation-data-type=u6p10
    Ary1D_u8p8_10: category=ARRAY, sw-calibration-access=READ-ONLY, type-emitter=RTE
      element Element: array-size=10, array-size-semantics=FIXED-SIZE, implementation-data-type=u8p8
    Ary1D_u8p8_8: category=ARRAY, sw-calibration-access=READ-ONLY, type-emitter=RTE
      element Element: array-size=8, array-size-semantics=FIXED-SIZE, implementation-data-type=u8p8
    Ary1D_u9p7_5: category=ARRAY, sw-calibration-access=READ-ONLY, type-emitter=RTE
      element Element: array-size=5, array-size-semantics=FIXED-SIZE, implementation-data-type=u9p7
    Ary1D_u9p7_8: category=ARRAY, sw-calibration-access=READ-ONLY, type-emitter=RTE
      element Element: array-size=8, array-size-semantics=FIXED-SIZE, implementation-data-type=u9p7
    Ary2D_f32_5_4: category=ARRAY, sw-calibration-access=READ-ONLY, type-emitter=RTE
      element Element: array-size=5, array-size-semantics=FIXED-SIZE, implementation-data-type=Ary1D_f32_4
    Ary2D_f32_5_5: category=ARRAY, sw-calibration-access=READ-ONLY, type-emitter=RTE
      element Element: array-size=5, array-size-semantics=FIXED-SIZE, implementation-data-type=Ary1D_f32_5
    Ary2D_u10p6_8_12: category=ARRAY, sw-calibration-access=READ-ONLY, type-emitter=RTE
      element Element: array-size=8, array-size-semantics=FIXED-SIZE, implementation-data-type=Ary1D_u10p6_12
    Ary2D_u10p6_8_9: category=ARRAY, sw-calibration-access=READ-ONLY, type-emitter=RTE
      element Element: array-size=8, array-size-semantics=FIXED-SIZE, implementation-data-type=Ary1D_u10p6_9
    Ary2D_u12p4_8_12: category=ARRAY, sw-calibration-access=READ-ONLY, type-emitter=RTE
      element Element: array-size=8, array-size-semantics=FIXED-SIZE, implementation-data-type=Ary1D_u12p4_12
    Ary2D_u2p14_5_10: category=ARRAY, sw-calibration-access=READ-ONLY, type-emitter=RTE
      element Element: array-size=5, array-size-semantics=FIXED-SIZE, implementation-data-type=Ary1D_u2p14_10
    Ary2D_u2p14_5_8: category=ARRAY, sw-calibration-access=READ-ONLY, type-emitter=RTE
      element Element: array-size=5, array-size-semantics=FIXED-SIZE, implementation-data-type=Ary1D_u2p14_8
    Ary2D_u2p14_7_8: category=ARRAY, sw-calibration-access=READ-ONLY, type-emitter=RTE
      element Element: array-size=7, array-size-semantics=FIXED-SIZE, implementation-data-type=Ary1D_u2p14_8
    Ary2D_u6p10_5_9: category=ARRAY, sw-calibration-access=READ-ONLY, type-emitter=RTE
      element Element: array-size=5, array-size-semantics=FIXED-SIZE, implementation-data-type=Ary1D_u6p10_9
    Ary2D_u6p10_8_9: category=ARRAY, sw-calibration-access=READ-ONLY, type-emitter=RTE
      element Element: array-size=8, array-size-semantics=FIXED-SIZE, implementation-data-type=Ary1D_u6p10_9
    Ary2D_u8p8_5_10: category=ARRAY, sw-calibration-access=READ-ONLY, type-emitter=RTE
      element Element: array-size=5, array-size-semantics=FIXED-SIZE, implementation-data-type=Ary1D_u8p8_10
    Ary2D_u8p8_5_8: category=ARRAY, sw-calibration-access=READ-ONLY, type-emitter=RTE
      element Element: array-size=5, array-size-semantics=FIXED-SIZE, implementation-data-type=Ary1D_u8p8_8
    FilLpRec1: category=STRUCTURE, sw-calibration-access=READ-ONLY, type-emitter=NxtrFil
      element FilSt: implementation-data-type=ImplementationDataTypes/float32
      element FilGain: implementation-data-type=ImplementationDataTypes/float32
      symbol props FilLpRec1
    s10p5: implementation-data-type=sint16, type-emitter=RTE
    u10p6: implementation-data-type=uint16, type-emitter=RTE
    u12p4: implementation-data-type=uint16, type-emitter=RTE
    u2p14: implementation-data-type=uint16, type-emitter=RTE
    u4p12: implementation-data-type=uint16, type-emitter=RTE
    u6p10: implementation-data-type=uint16, type-emitter=RTE
    u8p8: implementation-data-type=uint16, type-emitter=RTE
    u9p7: implementation-data-type=uint16, type-emitter=RTE
