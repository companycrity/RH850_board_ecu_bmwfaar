AUTOSAR XML (schema 4-0-3)
standard types defined: boolean, float32, sint8, uint16, uint8, boolean_CompuMethod, boolean_DataConstr, float32_DataConstr, sint8_DataConstr, uint16_DataConstr, uint8_DataConstr
package /DataTypes
  6 x impl type:
    ALIV_OFFS_QUAD_EPS1: category=VALUE, base-type=uint8, compu {0=Zaehlerstand0DotDotE (ALIV_COU_4_Zaehlerstand0DotDotE) (BNE original name: Zählerstand 0..E), 15=SignalUngueltig (ALIV_COU_4_SignalUngueltig) (BNE original name: Signal ungültig)}
    AVL_PO_IDX_ICM1: category=VALUE, base-type=uint16
    CRC_OFFS_QUAD_EPS1: category=VALUE, base-type=uint8
    OFFS_QUAD_RTR_EPS1: category=VALUE, base-type=uint8
    sigGroup_OFFS_QUAD_EPS1: category=STRUCTURE
      5 x element, all with category=TYPE_REFERENCE:
        AVL_PO_IDX_ICM: range phys 0..65534, implementation-data-type=AVL_PO_IDX_ICM1
        ST_OFFS_QUAD_EPS: range raw 0..15, implementation-data-type=ST_OFFS_QUAD_EPS1
        CRC_OFFS_QUAD_EPS: range phys 0..255 "Standartabsicherung Apllikations-CRC.", implementation-data-type=CRC_OFFS_QUAD_EPS1
        OFFS_QUAD_RTR_EPS: range phys 0..254, implementation-data-type=OFFS_QUAD_RTR_EPS1
        ALIV_OFFS_QUAD_EPS: range raw 0..15, implementation-data-type=ALIV_OFFS_QUAD_EPS1
    ST_OFFS_QUAD_EPS1:
      category=VALUE
      base-type=uint8
      compu {0=Algorithmus_Funktion_ImSleep_Modus (ST_OFFS_QUAD_PINA_EPS_Algorithmus_Funktion_ImSleep_Modus) (BNE original name: Algorithmus (Funktion) im Sleep-Modus), 1=OffsetWirdErmittelt (ST_OFFS_QUAD_PINA_EPS_OffsetWirdErmittelt) (BNE original name: Offset wird ermittelt), 2=OffsetUebernehmenAufsetzenUeberIndex (ST_OFFS_QUAD_PINA_EPS_OffsetUebernehmenAufsetzenUeberIndex) (BNE original name: Offset übernehmen, Aufsetzen über Index), 3=OffsetUebernehmenAufsetzenUeberModelvergleich (ST_OFFS_QUAD_PINA_EPS_OffsetUebernehmenAufsetzenUeberModelvergleich) (BNE original name: Offset übernehmen, Aufsetzen über Modelvergleich), 4=OffsetUebernehmenAufsetzenUeberAnschlag_Anschlag (ST_OFFS_QUAD_PINA_EPS_OffsetUebernehmenAufsetzenUeberAnschlag_Anschlag) (BNE original name: Offset übernehmen, Aufsetzen über Anschlag-Anschlag), 5=OffsetUebernehmenAufsetzenUeberSummenlenkwinkel_imAFS_Fall_ (ST_OFFS_QUAD_PINA_EPS_OffsetUebernehmenAufsetzenUeberSummenlenkwinkel_imAFS_Fall_) (BNE original name: Offset übernehmen, Aufsetzen über Summenlenkwinkel (im AFS-Fall)), 6=OffsetInPruefung (ST_OFFS_QUAD_PINA_EPS_OffsetInPruefung) (BNE original name: Offset in Prüfung), 7=OffsetKorrigieren (ST_OFFS_QUAD_PINA_EPS_OffsetKorrigieren) (BNE original name: Offset korrigieren), 8=Initialisierung (ST_OFFS_QUAD_PINA_EPS_Initialisierung) (wird im aller ersten Rechenzyklus gesetzt (10ms)), 9=RestoffsetWirdErmittelt (ST_OFFS_QUAD_PINA_EPS_RestoffsetWirdErmittelt) (BNE original name: Restoffset wird ermittelt), 11=OffsetUebernehmenGroboffsetUeberModell (ST_OFFS_QUAD_PINA_EPS_OffsetUebernehmenGroboffsetUeberModell) (BNE original name: Offset übernehmen, Groboffset über Modell), 15=SignalUngueltig (ST_OFFS_QUAD_PINA_EPS_SignalUngueltig) (BNE original name: Signal ungültig)}
package /Nexteer/DataTypes
  impl type BmwQuadOffsSts1:
    compu {0=BMWQUADOFFSSTS_ALGSLEEP, 1=BMWQUADOFFSSTS_OFFSKWN, 2=BMWQUADOFFSSTS_OFFSBYIDX, 3=BMWQUADOFFSSTS_OFFSBYMDLCOMP, 4=BMWQUADOFFSSTS_OFFSPOSNGBYSTRTSTOP, 5=BMWQUADOFFSSTS_OFFSPOSNGBYSUMCTRLAG, 6=BMWQUADOFFSSTS_OFFSINTEST, 7=BMWQUADOFFSSTS_CORROFFS, 8=BMWQUADOFFSSTS_ININ, 9=BMWQUADOFFSSTS_RSTOFFSKWN, 11=BMWQUADOFFSSTS_OFFSBYMDL, 15=BMWQUADOFFSSTS_INVLD}
    implementation-data-type=ImplementationDataTypes/uint8
    type-emitter=RTE
  impl type NtcNr1: compu {1..511=NTCNR_0X001..NTCNR_0X1FF}, implementation-data-type=PlatformTypes/uint16, type-emitter=RTE
  impl type NtcSts1: compu {0=NTCSTS_PASSD, 1=NTCSTS_FAILD, 2=NTCSTS_PREPASSD, 3=NTCSTS_PREFAILD}, implementation-data-type=PlatformTypes/uint8, type-emitter=RTE
package /Nexteer/Units
  unit Uls: display-name=Uls, factor-si-to-unit=1, offset-si-to-unit=0
