AUTOSAR XML (schema 4-0-3)
standard types defined: boolean, float32, sint8, uint16, uint8, boolean_CompuMethod, boolean_DataConstr, float32_DataConstr, sint8_DataConstr, uint16_DataConstr, uint8_DataConstr
package /DataTypes
  impl type AVL_STEA_PNI_OFFS1:
    category=VALUE
    base-type=uint16
    compu {phys=raw*0.021994-45 for raw 2046.0125488769665..188097.8947783001, 4093=Funktionsschnittstelle_ist_nicht_verfuegbar (AVL_STEA_PNI_OFFS_Funktionsschnittstelle_ist_nicht_verfuegbar) (Signal Tag - Schnittstelle ist nicht verfügbar), 4094=Funktion_meldet_Fehler (AVL_STEA_PNI_OFFS_Funktion_meldet_Fehler) (Signal Tag - Funktion meldet Fehler), 4095=Signal_unbefuellt (AVL_STEA_PNI_OFFS_Signal_unbefuellt) (Signal Tag - Signal ist unbefüllt)}
    range phys 0..4092.025
    invalid-value=4095
  impl type BmwPinionAgOffsSts1: category=VALUE, base-type=uint8, sw-calibration-access=READ-ONLY, compu {1=BMWPINIONAGOFFSSTS_VLD, 2=BMWPINIONAGOFFSSTS_FCTIFNOTAVL, 3=BMWPINIONAGOFFSSTS_FCTRPRTERR, 4=BMWPINIONAGOFFSSTS_INVLD}, type-emitter=RTE
package /Nexteer/DataTypes
  impl type NtcNr1: compu {1..511=NTCNR_0X001..NTCNR_0X1FF}, implementation-data-type=PlatformTypes/uint16, type-emitter=RTE
  impl type NtcSts1: compu {0=NTCSTS_PASSD, 1=NTCSTS_FAILD, 2=NTCSTS_PREPASSD, 3=NTCSTS_PREFAILD}, implementation-data-type=PlatformTypes/uint8, type-emitter=RTE
