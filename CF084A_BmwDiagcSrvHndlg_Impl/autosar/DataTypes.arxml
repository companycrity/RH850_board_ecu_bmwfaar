AUTOSAR XML (schema 4-3-0)
standard types defined: boolean, dtRef_const_VOID, dtRef_VOID, float32, sint32, sint8, uint16, uint32, uint8, boolean_CompuMethod, boolean_DataConstr, float32_DataConstr, sint32_DataConstr, sint8_DataConstr, uint16_DataConstr, uint32_DataConstr, uint8_DataConstr, Boolean
package /BMW/Platform/Dlog/Dcm/ImplementationDataTypes
  impl type ProgCounterArrayType: category=ARRAY
    element SubProgCounterArrayType: array-size=4, array-size-semantics=FIXED-SIZE, implementation-data-type=ImplementationDataTypes/uint8
package /MICROSAR/Dcm_swc/DataTypes
  9 x impl type:
    Dcm_Data140ByteType: category=ARRAY, sw-calibration-access=READ-ONLY
      element Dcm_Data140ByteTypeElement: array-size=140, array-size-semantics=FIXED-SIZE, implementation-data-type=ImplementationDataTypes/uint8
    Dcm_Data15ByteType: category=ARRAY, sw-calibration-access=READ-ONLY
      element Dcm_Data15ByteTypeElement: array-size=15, array-size-semantics=FIXED-SIZE, implementation-data-type=ImplementationDataTypes/uint8
    Dcm_Data1ByteType: category=ARRAY, sw-calibration-access=READ-ONLY
      element Dcm_Data1ByteTypeElement: array-size=1, array-size-semantics=FIXED-SIZE, implementation-data-type=ImplementationDataTypes/uint8
    Dcm_Data2ByteType: category=ARRAY, sw-calibration-access=READ-ONLY
      element Dcm_Data2ByteTypeElement: array-size=2, array-size-semantics=FIXED-SIZE, implementation-data-type=ImplementationDataTypes/uint8
    Dcm_Data3ByteType: category=ARRAY, sw-calibration-access=READ-ONLY
      element Dcm_Data3ByteTypeElement: array-size=3, array-size-semantics=FIXED-SIZE, implementation-data-type=ImplementationDataTypes/uint8
    Dcm_Data7ByteType: category=ARRAY, sw-calibration-access=READ-ONLY
      element Dcm_Data7ByteTypeElement: array-size=7, array-size-semantics=FIXED-SIZE, implementation-data-type=ImplementationDataTypes/uint8
    Dcm_Data8ByteType: category=ARRAY, sw-calibration-access=READ-ONLY
      element Dcm_Data8ByteTypeElement: array-size=8, array-size-semantics=FIXED-SIZE, implementation-data-type=ImplementationDataTypes/uint8
    Dcm_NegativeResponseCodeType: compu {0=DCM_E_POSITIVERESPONSE, 16=DCM_E_GENERALREJECT, 17=DCM_E_SERVICENOTSUPPORTED, 18=DCM_E_SUBFUNCTIONNOTSUPPORTED, 19=DCM_E_INCORRECTMESSAGELENGTHORINVALIDFORMAT, 20=DCM_E_RESPONSETOOLONG, 33=DCM_E_BUSYREPEATREQUEST, 34=DCM_E_CONDITIONSNOTCORRECT, 36=DCM_E_REQUESTSEQUENCEERROR, 37=DCM_E_NORESPONSEFROMSUBNETCOMPONENT, 38=DCM_E_FAILUREPREVENTSEXECUTIONOFREQUESTEDACTION, 49=DCM_E_REQUESTOUTOFRANGE, 51=DCM_E_SECURITYACCESSDENIED, 53=DCM_E_INVALIDKEY, 54=DCM_E_EXCEEDNUMBEROFATTEMPTS, 55=DCM_E_REQUIREDTIMEDELAYNOTEXPIRED, 112=DCM_E_UPLOADDOWNLOADNOTACCEPTED, 113=DCM_E_TRANSFERDATASUSPENDED, 114=DCM_E_GENERALPROGRAMMINGFAILURE, 115=DCM_E_WRONGBLOCKSEQUENCECOUNTER, 120=DCM_E_REQUESTCORRECTLYRECEIVEDRESPONSEPENDING, 126=DCM_E_SUBFUNCTIONNOTSUPPORTEDINACTIVESESSION, 127=DCM_E_SERVICENOTSUPPORTEDINACTIVESESSION, 129=DCM_E_RPMTOOHIGH, 130=DCM_E_RPMTOOLOW, 131=DCM_E_ENGINEISRUNNING, 132=DCM_E_ENGINEISNOTRUNNING, 133=DCM_E_ENGINERUNTIMETOOLOW, 134=DCM_E_TEMPERATURETOOHIGH, 135=DCM_E_TEMPERATURETOOLOW, 136=DCM_E_VEHICLESPEEDTOOHIGH, 137=DCM_E_VEHICLESPEEDTOOLOW, 138=DCM_E_THROTTLE_PEDALTOOHIGH, 139=DCM_E_THROTTLE_PEDALTOOLOW, 140=DCM_E_TRANSMISSIONRANGENOTINNEUTRAL, 141=DCM_E_TRANSMISSIONRANGENOTINGEAR, 143=DCM_E_BRAKESWITCH_NOTCLOSED, 144=DCM_E_SHIFTERLEVERNOTINPARK, 145=DCM_E_TORQUECONVERTERCLUTCHLOCKED, 146=DCM_E_VOLTAGETOOHIGH, 147=DCM_E_VOLTAGETOOLOW, 240..249=DCM_E_VMSCNC_0..DCM_E_VMSCNC_9, 250=DCM_E_VMSCNC_A, 251=DCM_E_VMSCNC_B, 252=DCM_E_VMSCNC_C, 253=DCM_E_VMSCNC_D, 254=DCM_E_VMSCNC_E}, implementation-data-type=ImplementationDataTypes/uint8
    Dcm_OpStatusType: compu {0=DCM_INITIAL, 1=DCM_PENDING, 2=DCM_CANCEL, 3=DCM_FORCE_RCRRP_OK, 64=DCM_FORCE_RCRRP_NOT_OK}, implementation-data-type=ImplementationDataTypes/uint8
package /MICROSAR/Dem_swc/DataTypes
  impl type DataArrayType_uint8_1: category=ARRAY, sw-calibration-access=READ-ONLY
    element DataArrayType_uint8_1Element: array-size=1, array-size-semantics=FIXED-SIZE, implementation-data-type=ImplementationDataTypes/uint8
  impl type DataArrayType_uint8_2: category=ARRAY, sw-calibration-access=READ-ONLY
    element DataArrayType_uint8_2Element: array-size=2, array-size-semantics=FIXED-SIZE, implementation-data-type=ImplementationDataTypes/uint8
  impl type DataArrayType_uint8_3: category=ARRAY, sw-calibration-access=READ-ONLY
    element DataArrayType_uint8_3Element: array-size=3, array-size-semantics=FIXED-SIZE, implementation-data-type=ImplementationDataTypes/uint8
package /Nexteer/DataTypes
  8 x impl type, all with type-emitter=RTE:
    Ary1D_u08_3: category=ARRAY, sw-calibration-access=READ-ONLY
      element Element: array-size=3, array-size-semantics=FIXED-SIZE, implementation-data-type=ImplementationDataTypes/uint8
    BmwBasPtlNetCtrl1: compu {0=NoCommunication, 1=ParkingNotOk, 2=ParkingOk, 3=StandingFunctions, 5=Living, 7=CheckDiagnosticAnalysis, 8=DriverPreparingforOperation, 10=Driving, 12=DriverPreparingToExitOperation, 15=Invalid}, implementation-data-type=ImplementationDataTypes/uint8
    BmwPinionAgQlfr1: compu {1=BMWPINIONAGQLFR_SIGVALVLDANDPLAUS, 2=BMWPINIONAGQLFR_SIGVALVLD, 4=BMWPINIONAGQLFR_SUBVALSETINUSRSIG, 8=BMWPINIONAGQLFR_INIT, 9=BMWPINIONAGQLFR_SIGVALVLDANDTMPOFAVRGQLY, 10=BMWPINIONAGQLFR_SIGVALVLDANDTMPOFLOQLY, 12=BMWPINIONAGQLFR_ADJMTVALSETINUSRSIG, 14=BMWPINIONAGQLFR_SIGVALINVLDBUTSTTMP, 15=BMWPINIONAGQLFR_INVLDSIG}, implementation-data-type=ImplementationDataTypes/uint8
    BmwSetVehCentrOffsSts1: compu {0=BMWVEHCENTROFFSSTS_OFFSPRFMD, 1=BMWVEHCENTROFFSSTS_OFFSFAILD, 2=BMWVEHCENTROFFSSTS_OFFSFAILDVALOUTOFRNG}, implementation-data-type=ImplementationDataTypes/uint8
    BmwVehCdn1: compu {1=BMWVEHCDN_PRKGNBNOK, 2=BMWVEHCDN_PRKGBNOK, 3=BMWVEHCDN_FCTCUSTNOTINFZG, 5=BMWVEHCDN_LVNG, 7=BMWVEHCDN_CHKDIAGCANLS, 8=BMWVEHCDN_DRVRPREPGFOROPER, 10=BMWVEHCDN_DRVG, 12=BMWVEHCDN_DRVRPREPGFOREXITOPER, 15=BMWVEHCDN_INVLD}, implementation-data-type=ImplementationDataTypes/uint8
    DrvgDynIfSt1: compu {32=DRVGDYNIFST_IFAVLRDYFOROPERWOADDLDAMPG, 33=DRVGDYNIFST_IFACTVADDLDAMPGNOTAVL, 34=DRVGDYNIFST_IFAVLRDYFOROPERADDLDAMPG, 35=DRVGDYNIFST_IFACTVADDLDAMPGAVL, 96=DRVGDYNIFST_SRVNOTAVLERR, 128=DRVGDYNIFST_IFINID, 224=DRVGDYNIFST_SRVNOTAVLSTBPMA, 225=DRVGDYNIFST_SRVNOTAVLSTBEPSSTS, 255=DRVGDYNIFST_INVLDSIG}, implementation-data-type=ImplementationDataTypes/uint8
    NtcNr1: compu {1..511=NTCNR_0X001..NTCNR_0X1FF}, implementation-data-type=ImplementationDataTypes/uint16
    SysSt1: compu {0=SYSST_DI, 1=SYSST_OFF, 2=SYSST_ENA, 3=SYSST_WRMININ}, implementation-data-type=ImplementationDataTypes/uint8
package /Nexteer/DataTypes/CompuMethods
  compu method BmwMotAgSelnSt1: 2=BMWMOTAGSELNST_OFFSCMPD, 4=BMWMOTAGSELNST_SUBVAL, 8=BMWMOTAGSELNST_INI, 10=BMWMOTAGSELNST_TMPCMPD, 12=BMWMOTAGSELNST_OFFSCORRN, 14=BMWMOTAGSELNST_SIGINVLD, 15=BMWMOTAGSELNST_INVLD
  compu method BmwPinionAgOffsSts1: 1=BMWPINIONAGOFFSSTS_VLD, 2=BMWPINIONAGOFFSSTS_FCTIFNOTAVL, 3=BMWPINIONAGOFFSSTS_FCTRPRTERR, 4=BMWPINIONAGOFFSSTS_INVLD
  compu method BmwQuadOffsSts1: 0=BMWQUADOFFSSTS_ALGSLEEP, 1=BMWQUADOFFSSTS_OFFSKWN, 2=BMWQUADOFFSSTS_OFFSBYIDX, 3=BMWQUADOFFSSTS_OFFSBYMDLCOMP, 4=BMWQUADOFFSSTS_OFFSPOSNGBYSTRTSTOP, 5=BMWQUADOFFSSTS_OFFSPOSNGBYSUMCTRLAG, 6=BMWQUADOFFSSTS_OFFSINTEST, 7=BMWQUADOFFSSTS_CORROFFS, 8=BMWQUADOFFSSTS_ININ, 9=BMWQUADOFFSSTS_RSTOFFSKWN, 11=BMWQUADOFFSSTS_OFFSBYMDL, 15=BMWQUADOFFSSTS_INVLD
  compu method BmwRackToVehCentrOffsSts1: 0=BMWRACKTOVEHCENTROFFSSTS_RACKTOVEHCENTRINVLD, 1=BMWRACKTOVEHCENTROFFSSTS_RACKTOVEHCENTRLRND, 2=BMWRACKTOVEHCENTROFFSSTS_RACKTOVEHCENTRUNLRND
  compu method BmwVehSpdSts1: 1=BMWVEHSPDSTS_VLD, 4=BMWVEHSPDSTS_SUBVALSETINUSFLSIGVEHSTANDG, 12=BMWVEHSPDSTS_SUBVALSETINUSFLSIGVEHRUNNG, 14=BMWVEHSPDSTS_SUBVALSETINUSRSIGNOINFO, 15=BMWVEHSPDSTS_INVLD
  compu method NtcSts1: 0=NTCSTS_PASSD, 1=NTCSTS_FAILD, 2=NTCSTS_PREPASSD, 3=NTCSTS_PREFAILD
  compu method SigQlfr1: 0=SIGQLFR_NORES, 1=SIGQLFR_PASSD, 2=SIGQLFR_FAILD
package /Nexteer/NvMProxy_swc/DataTypes
  impl type NvM_RequestResultType: category=VALUE, base-type=NvM_RequestResultType, compu {0=NVM_REQ_OK, 1=NVM_REQ_NOT_OK, 2=NVM_REQ_PENDING, 3=NVM_REQ_INTEGRITY_FAILED, 4=NVM_REQ_BLOCK_SKIPPED, 5=NVM_REQ_NV_INVALIDATED, 6=NVM_REQ_CANCELED, 7=NVM_REQ_REDUNDANCY_FAILED, 8=NVM_REQ_RESTORED_FROM_ROM}
package /Nexteer/NvMProxy_swc/DataTypes/BaseTypes
  base type NvM_RequestResultType: category=FIXED_LENGTH, base-type-size=8, base-type-encoding=NONE, native-declaration=uint8
package /Predefined_DEV/ImplementationDataTypes
  impl type NvM_RequestResultType: compu {0=NVM_REQ_OK, 1=NVM_REQ_NOT_OK, 2=NVM_REQ_PENDING, 3=NVM_REQ_INTEGRITY_FAILED, 4=NVM_REQ_BLOCK_SKIPPED, 5=NVM_REQ_NV_INVALIDATED, 6=NVM_REQ_CANCELED, 7=NVM_REQ_REDUNDANCY_FAILED, 8=NVM_REQ_RESTORED_FROM_ROM}, implementation-data-type=ImplementationDataTypes/uint8
