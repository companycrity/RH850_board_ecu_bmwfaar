AUTOSAR XML (schema 4-3-0)
package /BMW/Platform/Dlog/Dcm/PortInterfaces
  client server interface DataServices_ProgCounter: is-service=true
    operation ReadData: possible-error=DataServices_ProgCounter/E_NOT_OK
      arg Data: type=ProgCounterArrayType, direction=OUT, server-argument-impl-policy=USE-ARGUMENT-TYPE
    error E_NOT_OK: error-code=1
package /MICROSAR/Dcm_swc/Interfaces
  18 x client server interface, all with is-service=true, service-kind=DIAGNOSTIC-COMMUNICATION-MANAGER:
    DataServices_DID_1000_Pruefstempel
      operation ConditionCheckRead: possible-error=[DataServices_DID_1000_Pruefstempel/E_NOT_OK, DataServices_DID_1000_Pruefstempel/DCM_E_PENDING]
        arg OpStatus: type=Dcm_OpStatusType, direction=IN, server-argument-impl-policy=USE-ARGUMENT-TYPE
        arg ErrorCode: type=Dcm_NegativeResponseCodeType, direction=OUT, server-argument-impl-policy=USE-ARGUMENT-TYPE
      operation ReadData: possible-error=[DataServices_DID_1000_Pruefstempel/E_NOT_OK, DataServices_DID_1000_Pruefstempel/DCM_E_PENDING]
        arg OpStatus: type=Dcm_OpStatusType, direction=IN, server-argument-impl-policy=USE-ARGUMENT-TYPE
        arg Data: type=Dcm_Data3ByteType, direction=OUT, server-argument-impl-policy=USE-ARGUMENT-TYPE
      operation WriteData: possible-error=[DataServices_DID_1000_Pruefstempel/E_NOT_OK, DataServices_DID_1000_Pruefstempel/DCM_E_PENDING]
        arg Data: type=Dcm_Data3ByteType, direction=IN, server-argument-impl-policy=USE-ARGUMENT-TYPE
        arg OpStatus: type=Dcm_OpStatusType, direction=IN, server-argument-impl-policy=USE-ARGUMENT-TYPE
        arg ErrorCode: type=Dcm_NegativeResponseCodeType, direction=OUT, server-argument-impl-policy=USE-ARGUMENT-TYPE
      error DCM_E_PENDING: error-code=10
      error E_NOT_OK: error-code=1
    DataServices_DID_2503_ProgrammingCounterMaxValue
      operation ConditionCheckRead: possible-error=DataServices_DID_2503_ProgrammingCounterMaxValue/E_NOT_OK
        arg ErrorCode: type=Dcm_NegativeResponseCodeType, direction=OUT, server-argument-impl-policy=USE-ARGUMENT-TYPE
      operation ReadData: possible-error=DataServices_DID_2503_ProgrammingCounterMaxValue/E_NOT_OK
        arg Data: type=Dcm_Data2ByteType, direction=OUT, server-argument-impl-policy=USE-ARGUMENT-TYPE
      operation WriteData: possible-error=DataServices_DID_2503_ProgrammingCounterMaxValue/E_NOT_OK
        arg Data: type=Dcm_Data2ByteType, direction=IN, server-argument-impl-policy=USE-ARGUMENT-TYPE
        arg ErrorCode: type=Dcm_NegativeResponseCodeType, direction=OUT, server-argument-impl-policy=USE-ARGUMENT-TYPE
      error E_NOT_OK: error-code=1
    DataServices_DID_250B_ReadSwRevision
      operation ConditionCheckRead: possible-error=[DataServices_DID_250B_ReadSwRevision/E_NOT_OK, DataServices_DID_250B_ReadSwRevision/DCM_E_PENDING]
        arg OpStatus: type=Dcm_OpStatusType, direction=IN, server-argument-impl-policy=USE-ARGUMENT-TYPE
        arg ErrorCode: type=Dcm_NegativeResponseCodeType, direction=OUT, server-argument-impl-policy=USE-ARGUMENT-TYPE
      operation ReadData: possible-error=[DataServices_DID_250B_ReadSwRevision/E_NOT_OK, DataServices_DID_250B_ReadSwRevision/DCM_E_PENDING]
        arg OpStatus: type=Dcm_OpStatusType, direction=IN, server-argument-impl-policy=USE-ARGUMENT-TYPE
        arg Data: type=Dcm_Data140ByteType, direction=OUT, server-argument-impl-policy=USE-ARGUMENT-TYPE
      error DCM_E_PENDING: error-code=10
      error E_NOT_OK: error-code=1
    DataServices_DID_2540_MileKmEeprom
      operation ConditionCheckRead: possible-error=[DataServices_DID_2540_MileKmEeprom/E_NOT_OK, DataServices_DID_2540_MileKmEeprom/DCM_E_PENDING]
        arg OpStatus: type=Dcm_OpStatusType, direction=IN, server-argument-impl-policy=USE-ARGUMENT-TYPE
        arg ErrorCode: type=Dcm_NegativeResponseCodeType, direction=OUT, server-argument-impl-policy=USE-ARGUMENT-TYPE
      operation ReadData: possible-error=[DataServices_DID_2540_MileKmEeprom/E_NOT_OK, DataServices_DID_2540_MileKmEeprom/DCM_E_PENDING]
        arg OpStatus: type=Dcm_OpStatusType, direction=IN, server-argument-impl-policy=USE-ARGUMENT-TYPE
        arg Data: type=Dcm_Data3ByteType, direction=OUT, server-argument-impl-policy=USE-ARGUMENT-TYPE
      error DCM_E_PENDING: error-code=10
      error E_NOT_OK: error-code=1
    DataServices_DID_DB3C_StatusFzgBordnetz
      operation ConditionCheckRead: possible-error=[DataServices_DID_DB3C_StatusFzgBordnetz/E_NOT_OK, DataServices_DID_DB3C_StatusFzgBordnetz/DCM_E_PENDING]
        arg OpStatus: type=Dcm_OpStatusType, direction=IN, server-argument-impl-policy=USE-ARGUMENT-TYPE
        arg ErrorCode: type=Dcm_NegativeResponseCodeType, direction=OUT, server-argument-impl-policy=USE-ARGUMENT-TYPE
      operation ReadData: possible-error=[DataServices_DID_DB3C_StatusFzgBordnetz/E_NOT_OK, DataServices_DID_DB3C_StatusFzgBordnetz/DCM_E_PENDING]
        arg OpStatus: type=Dcm_OpStatusType, direction=IN, server-argument-impl-policy=USE-ARGUMENT-TYPE
        arg Data: type=Dcm_Data15ByteType, direction=OUT, server-argument-impl-policy=USE-ARGUMENT-TYPE
      error DCM_E_PENDING: error-code=10
      error E_NOT_OK: error-code=1
    DataServices_DID_DB57_EpsRitzelwinkelsensor
      operation ConditionCheckRead: possible-error=[DataServices_DID_DB57_EpsRitzelwinkelsensor/E_NOT_OK, DataServices_DID_DB57_EpsRitzelwinkelsensor/DCM_E_PENDING]
        arg OpStatus: type=Dcm_OpStatusType, direction=IN, server-argument-impl-policy=USE-ARGUMENT-TYPE
        arg ErrorCode: type=Dcm_NegativeResponseCodeType, direction=OUT, server-argument-impl-policy=USE-ARGUMENT-TYPE
      operation ReadData: possible-error=[DataServices_DID_DB57_EpsRitzelwinkelsensor/E_NOT_OK, DataServices_DID_DB57_EpsRitzelwinkelsensor/DCM_E_PENDING]
        arg OpStatus: type=Dcm_OpStatusType, direction=IN, server-argument-impl-policy=USE-ARGUMENT-TYPE
        arg Data: type=Dcm_Data7ByteType, direction=OUT, server-argument-impl-policy=USE-ARGUMENT-TYPE
      error DCM_E_PENDING: error-code=10
      error E_NOT_OK: error-code=1
    DataServices_DID_DB5A_EpsLenkwinkelsensorKalibrierung
      operation ConditionCheckRead: possible-error=[DataServices_DID_DB5A_EpsLenkwinkelsensorKalibrierung/E_NOT_OK, DataServices_DID_DB5A_EpsLenkwinkelsensorKalibrierung/DCM_E_PENDING]
        arg OpStatus: type=Dcm_OpStatusType, direction=IN, server-argument-impl-policy=USE-ARGUMENT-TYPE
        arg ErrorCode: type=Dcm_NegativeResponseCodeType, direction=OUT, server-argument-impl-policy=USE-ARGUMENT-TYPE
      operation ReadData: possible-error=[DataServices_DID_DB5A_EpsLenkwinkelsensorKalibrierung/E_NOT_OK, DataServices_DID_DB5A_EpsLenkwinkelsensorKalibrierung/DCM_E_PENDING]
        arg OpStatus: type=Dcm_OpStatusType, direction=IN, server-argument-impl-policy=USE-ARGUMENT-TYPE
        arg Data: type=Dcm_Data2ByteType, direction=OUT, server-argument-impl-policy=USE-ARGUMENT-TYPE
      operation WriteData: possible-error=[DataServices_DID_DB5A_EpsLenkwinkelsensorKalibrierung/E_NOT_OK, DataServices_DID_DB5A_EpsLenkwinkelsensorKalibrierung/DCM_E_PENDING]
        arg Data: type=Dcm_Data2ByteType, direction=IN, server-argument-impl-policy=USE-ARGUMENT-TYPE
        arg OpStatus: type=Dcm_OpStatusType, direction=IN, server-argument-impl-policy=USE-ARGUMENT-TYPE
        arg ErrorCode: type=Dcm_NegativeResponseCodeType, direction=OUT, server-argument-impl-policy=USE-ARGUMENT-TYPE
      error DCM_E_PENDING: error-code=10
      error E_NOT_OK: error-code=1
    DataServices_DID_DB99_EpsMomentensensor
      operation ConditionCheckRead: possible-error=[DataServices_DID_DB99_EpsMomentensensor/E_NOT_OK, DataServices_DID_DB99_EpsMomentensensor/DCM_E_PENDING]
        arg OpStatus: type=Dcm_OpStatusType, direction=IN, server-argument-impl-policy=USE-ARGUMENT-TYPE
        arg ErrorCode: type=Dcm_NegativeResponseCodeType, direction=OUT, server-argument-impl-policy=USE-ARGUMENT-TYPE
      operation ReadData: possible-error=[DataServices_DID_DB99_EpsMomentensensor/E_NOT_OK, DataServices_DID_DB99_EpsMomentensensor/DCM_E_PENDING]
        arg OpStatus: type=Dcm_OpStatusType, direction=IN, server-argument-impl-policy=USE-ARGUMENT-TYPE
        arg Data: type=Dcm_Data3ByteType, direction=OUT, server-argument-impl-policy=USE-ARGUMENT-TYPE
      error DCM_E_PENDING: error-code=10
      error E_NOT_OK: error-code=1
    DataServices_DID_DC77_EpsZahnstangenmitte
      operation ConditionCheckRead: possible-error=[DataServices_DID_DC77_EpsZahnstangenmitte/E_NOT_OK, DataServices_DID_DC77_EpsZahnstangenmitte/DCM_E_PENDING]
        arg OpStatus: type=Dcm_OpStatusType, direction=IN, server-argument-impl-policy=USE-ARGUMENT-TYPE
        arg ErrorCode: type=Dcm_NegativeResponseCodeType, direction=OUT, server-argument-impl-policy=USE-ARGUMENT-TYPE
      operation ReadData: possible-error=[DataServices_DID_DC77_EpsZahnstangenmitte/E_NOT_OK, DataServices_DID_DC77_EpsZahnstangenmitte/DCM_E_PENDING]
        arg OpStatus: type=Dcm_OpStatusType, direction=IN, server-argument-impl-policy=USE-ARGUMENT-TYPE
        arg Data: type=Dcm_Data1ByteType, direction=OUT, server-argument-impl-policy=USE-ARGUMENT-TYPE
      error DCM_E_PENDING: error-code=10
      error E_NOT_OK: error-code=1
    DataServices_DID_DFDD_GelernterZahnstangenweg
      operation ConditionCheckRead: possible-error=[DataServices_DID_DFDD_GelernterZahnstangenweg/E_NOT_OK, DataServices_DID_DFDD_GelernterZahnstangenweg/DCM_E_PENDING]
        arg OpStatus: type=Dcm_OpStatusType, direction=IN, server-argument-impl-policy=USE-ARGUMENT-TYPE
        arg ErrorCode: type=Dcm_NegativeResponseCodeType, direction=OUT, server-argument-impl-policy=USE-ARGUMENT-TYPE
      operation ReadData: possible-error=[DataServices_DID_DFDD_GelernterZahnstangenweg/E_NOT_OK, DataServices_DID_DFDD_GelernterZahnstangenweg/DCM_E_PENDING]
        arg OpStatus: type=Dcm_OpStatusType, direction=IN, server-argument-impl-policy=USE-ARGUMENT-TYPE
        arg Data: type=Dcm_Data8ByteType, direction=OUT, server-argument-impl-policy=USE-ARGUMENT-TYPE
      error DCM_E_PENDING: error-code=10
      error E_NOT_OK: error-code=1
    DataServices_DID_F18A_SystemSupplierIdentifier
      operation ConditionCheckRead: possible-error=[DataServices_DID_F18A_SystemSupplierIdentifier/E_NOT_OK, DataServices_DID_F18A_SystemSupplierIdentifier/DCM_E_PENDING]
        arg OpStatus: type=Dcm_OpStatusType, direction=IN, server-argument-impl-policy=USE-ARGUMENT-TYPE
        arg ErrorCode: type=Dcm_NegativeResponseCodeType, direction=OUT, server-argument-impl-policy=USE-ARGUMENT-TYPE
      operation ReadData: possible-error=[DataServices_DID_F18A_SystemSupplierIdentifier/E_NOT_OK, DataServices_DID_F18A_SystemSupplierIdentifier/DCM_E_PENDING]
        arg OpStatus: type=Dcm_OpStatusType, direction=IN, server-argument-impl-policy=USE-ARGUMENT-TYPE
        arg Data: type=Dcm_Data3ByteType, direction=OUT, server-argument-impl-policy=USE-ARGUMENT-TYPE
      error DCM_E_PENDING: error-code=10
      error E_NOT_OK: error-code=1
    RoutineServices_EpsInitialisierungService_Routine
      operation RequestResults: possible-error=[RoutineServices_EpsInitialisierungService_Routine/E_NOT_OK, RoutineServices_EpsInitialisierungService_Routine/DCM_E_PENDING, RoutineServices_EpsInitialisierungService_Routine/DCM_E_FORCE_RCRRP]
        5 x arg, all with server-argument-impl-policy=USE-ARGUMENT-TYPE:
          OpStatus: type=Dcm_OpStatusType, direction=IN
          StatRoutineStatus_Out: type=uint8, direction=OUT
          StatLenkradwinkelWert_Out: type=Dcm_Data2ByteType, direction=OUT
          StatSensorZustandNr_Out: type=uint8, direction=OUT
          ErrorCode: type=Dcm_NegativeResponseCodeType, direction=OUT
      operation Start: possible-error=[RoutineServices_EpsInitialisierungService_Routine/E_NOT_OK, RoutineServices_EpsInitialisierungService_Routine/DCM_E_PENDING, RoutineServices_EpsInitialisierungService_Routine/DCM_E_FORCE_RCRRP]
        arg OpStatus: type=Dcm_OpStatusType, direction=IN, server-argument-impl-policy=USE-ARGUMENT-TYPE
        arg ErrorCode: type=Dcm_NegativeResponseCodeType, direction=OUT, server-argument-impl-policy=USE-ARGUMENT-TYPE
      operation Stop: possible-error=[RoutineServices_EpsInitialisierungService_Routine/E_NOT_OK, RoutineServices_EpsInitialisierungService_Routine/DCM_E_PENDING, RoutineServices_EpsInitialisierungService_Routine/DCM_E_FORCE_RCRRP]
        arg OpStatus: type=Dcm_OpStatusType, direction=IN, server-argument-impl-policy=USE-ARGUMENT-TYPE
        arg ErrorCode: type=Dcm_NegativeResponseCodeType, direction=OUT, server-argument-impl-policy=USE-ARGUMENT-TYPE
      error DCM_E_FORCE_RCRRP: error-code=12
      error DCM_E_PENDING: error-code=10
      error E_NOT_OK: error-code=1
    RoutineServices_EpsInitialisierungWerk_Routine
      operation RequestResults: possible-error=[RoutineServices_EpsInitialisierungWerk_Routine/E_NOT_OK, RoutineServices_EpsInitialisierungWerk_Routine/DCM_E_PENDING, RoutineServices_EpsInitialisierungWerk_Routine/DCM_E_FORCE_RCRRP]
        arg OpStatus: type=Dcm_OpStatusType, direction=IN, server-argument-impl-policy=USE-ARGUMENT-TYPE
        arg StatRoutineStatus_Out: type=uint8, direction=OUT, server-argument-impl-policy=USE-ARGUMENT-TYPE
        arg ErrorCode: type=Dcm_NegativeResponseCodeType, direction=OUT, server-argument-impl-policy=USE-ARGUMENT-TYPE
      operation Start: possible-error=[RoutineServices_EpsInitialisierungWerk_Routine/E_NOT_OK, RoutineServices_EpsInitialisierungWerk_Routine/DCM_E_PENDING, RoutineServices_EpsInitialisierungWerk_Routine/DCM_E_FORCE_RCRRP]
        5 x arg, all with server-argument-impl-policy=USE-ARGUMENT-TYPE:
          Winkel_In: type=uint8, direction=IN
          Winkelgeschwindigkeit_In: type=uint8, direction=IN
          Winkelbeschleunigung_In: type=uint8, direction=IN
          OpStatus: type=Dcm_OpStatusType, direction=IN
          ErrorCode: type=Dcm_NegativeResponseCodeType, direction=OUT
      operation Stop: possible-error=[RoutineServices_EpsInitialisierungWerk_Routine/E_NOT_OK, RoutineServices_EpsInitialisierungWerk_Routine/DCM_E_PENDING, RoutineServices_EpsInitialisierungWerk_Routine/DCM_E_FORCE_RCRRP]
        arg OpStatus: type=Dcm_OpStatusType, direction=IN, server-argument-impl-policy=USE-ARGUMENT-TYPE
        arg ErrorCode: type=Dcm_NegativeResponseCodeType, direction=OUT, server-argument-impl-policy=USE-ARGUMENT-TYPE
      error DCM_E_FORCE_RCRRP: error-code=12
      error DCM_E_PENDING: error-code=10
      error E_NOT_OK: error-code=1
    RoutineServices_EpsLenkwinkelsensorKalibrierungReset_Routine
      operation Start: possible-error=[RoutineServices_EpsLenkwinkelsensorKalibrierungReset_Routine/E_NOT_OK, RoutineServices_EpsLenkwinkelsensorKalibrierungReset_Routine/DCM_E_PENDING, RoutineServices_EpsLenkwinkelsensorKalibrierungReset_Routine/DCM_E_FORCE_RCRRP]
        arg OpStatus: type=Dcm_OpStatusType, direction=IN, server-argument-impl-policy=USE-ARGUMENT-TYPE
        arg ErrorCode: type=Dcm_NegativeResponseCodeType, direction=OUT, server-argument-impl-policy=USE-ARGUMENT-TYPE
      error DCM_E_FORCE_RCRRP: error-code=12
      error DCM_E_PENDING: error-code=10
      error E_NOT_OK: error-code=1
    RoutineServices_EpsPendeln_Routine
      operation RequestResults: possible-error=[RoutineServices_EpsPendeln_Routine/E_NOT_OK, RoutineServices_EpsPendeln_Routine/DCM_E_PENDING, RoutineServices_EpsPendeln_Routine/DCM_E_FORCE_RCRRP]
        arg OpStatus: type=Dcm_OpStatusType, direction=IN, server-argument-impl-policy=USE-ARGUMENT-TYPE
        arg StatEpsPendelnAktivNr_Out: type=uint8, direction=OUT, server-argument-impl-policy=USE-ARGUMENT-TYPE
        arg ErrorCode: type=Dcm_NegativeResponseCodeType, direction=OUT, server-argument-impl-policy=USE-ARGUMENT-TYPE
      operation Start: possible-error=[RoutineServices_EpsPendeln_Routine/E_NOT_OK, RoutineServices_EpsPendeln_Routine/DCM_E_PENDING, RoutineServices_EpsPendeln_Routine/DCM_E_FORCE_RCRRP]
        5 x arg, all with server-argument-impl-policy=USE-ARGUMENT-TYPE:
          Frequenz_In: type=uint8, direction=IN
          MaxAmplitude_In: type=uint8, direction=IN
          NumberOfCycles_In: type=uint8, direction=IN
          OpStatus: type=Dcm_OpStatusType, direction=IN
          ErrorCode: type=Dcm_NegativeResponseCodeType, direction=OUT
      error DCM_E_FORCE_RCRRP: error-code=12
      error DCM_E_PENDING: error-code=10
      error E_NOT_OK: error-code=1
    RoutineServices_EpsVerfahren_Routine
      operation RequestResults: possible-error=[RoutineServices_EpsVerfahren_Routine/E_NOT_OK, RoutineServices_EpsVerfahren_Routine/DCM_E_PENDING, RoutineServices_EpsVerfahren_Routine/DCM_E_FORCE_RCRRP]
        arg OpStatus: type=Dcm_OpStatusType, direction=IN, server-argument-impl-policy=USE-ARGUMENT-TYPE
        arg StatEpsVerfahrenAktivNr_Out: type=uint8, direction=OUT, server-argument-impl-policy=USE-ARGUMENT-TYPE
        arg ErrorCode: type=Dcm_NegativeResponseCodeType, direction=OUT, server-argument-impl-policy=USE-ARGUMENT-TYPE
      operation Start: possible-error=[RoutineServices_EpsVerfahren_Routine/E_NOT_OK, RoutineServices_EpsVerfahren_Routine/DCM_E_PENDING, RoutineServices_EpsVerfahren_Routine/DCM_E_FORCE_RCRRP]
        6 x arg, all with server-argument-impl-policy=USE-ARGUMENT-TYPE:
          Winkel_In: type=Dcm_Data2ByteType, direction=IN
          Winkelgeschwindigkeit_In: type=uint8, direction=IN
          Winkelbeschleunigung_In: type=uint8, direction=IN
          AbsolutEin_In: type=uint8, direction=IN
          OpStatus: type=Dcm_OpStatusType, direction=IN
          ErrorCode: type=Dcm_NegativeResponseCodeType, direction=OUT
      error DCM_E_FORCE_RCRRP: error-code=12
      error DCM_E_PENDING: error-code=10
      error E_NOT_OK: error-code=1
    RoutineServices_EpsZahnstangenmitteReset_Routine
      operation Start: possible-error=[RoutineServices_EpsZahnstangenmitteReset_Routine/E_NOT_OK, RoutineServices_EpsZahnstangenmitteReset_Routine/DCM_E_PENDING, RoutineServices_EpsZahnstangenmitteReset_Routine/DCM_E_FORCE_RCRRP]
        arg OpStatus: type=Dcm_OpStatusType, direction=IN, server-argument-impl-policy=USE-ARGUMENT-TYPE
        arg ErrorCode: type=Dcm_NegativeResponseCodeType, direction=OUT, server-argument-impl-policy=USE-ARGUMENT-TYPE
      error DCM_E_FORCE_RCRRP: error-code=12
      error DCM_E_PENDING: error-code=10
      error E_NOT_OK: error-code=1
    RoutineServices_SteuernEpsMultiturnwertReset_Routine
      operation Start: possible-error=[RoutineServices_SteuernEpsMultiturnwertReset_Routine/E_NOT_OK, RoutineServices_SteuernEpsMultiturnwertReset_Routine/DCM_E_PENDING, RoutineServices_SteuernEpsMultiturnwertReset_Routine/DCM_E_FORCE_RCRRP]
        arg OpStatus: type=Dcm_OpStatusType, direction=IN, server-argument-impl-policy=USE-ARGUMENT-TYPE
        arg ErrorCode: type=Dcm_NegativeResponseCodeType, direction=OUT, server-argument-impl-policy=USE-ARGUMENT-TYPE
      error DCM_E_FORCE_RCRRP: error-code=12
      error DCM_E_PENDING: error-code=10
      error E_NOT_OK: error-code=1
package /MICROSAR/Dem_swc/Interfaces
  9 x client server interface, all with is-service=true, service-kind=DIAGNOSTIC-EVENT-MANAGER:
    CSDataServices_DID_1700_KmStand
      operation ReadData: possible-error=CSDataServices_DID_1700_KmStand/E_NOT_OK
        arg Data: type=DataArrayType_uint8_3, direction=OUT, server-argument-impl-policy=USE-ARGUMENT-TYPE
      error E_NOT_OK: error-code=1
    CSDataServices_DID_1750_FUwBn
      operation ReadData: possible-error=CSDataServices_DID_1750_FUwBn/E_NOT_OK
        arg Data: type=DataArrayType_uint8_1, direction=OUT, server-argument-impl-policy=USE-ARGUMENT-TYPE
      error E_NOT_OK: error-code=1
    CSDataServices_DID_2805_Aussentemperatur
      operation ReadData: possible-error=CSDataServices_DID_2805_Aussentemperatur/E_NOT_OK
        arg Data: type=DataArrayType_uint8_1, direction=OUT, server-argument-impl-policy=USE-ARGUMENT-TYPE
      error E_NOT_OK: error-code=1
    CSDataServices_DID_2866_Betriebsspannung
      operation ReadData: possible-error=CSDataServices_DID_2866_Betriebsspannung/E_NOT_OK
        arg Data: type=DataArrayType_uint8_1, direction=OUT, server-argument-impl-policy=USE-ARGUMENT-TYPE
      error E_NOT_OK: error-code=1
    CSDataServices_DID_2867_Fahrzeuggeschwindigkeit
      operation ReadData: possible-error=CSDataServices_DID_2867_Fahrzeuggeschwindigkeit/E_NOT_OK
        arg Data: type=DataArrayType_uint8_1, direction=OUT, server-argument-impl-policy=USE-ARGUMENT-TYPE
      error E_NOT_OK: error-code=1
    CSDataServices_DID_5003_HwAg
      operation ReadData: possible-error=CSDataServices_DID_5003_HwAg/E_NOT_OK
        arg Data: type=DataArrayType_uint8_2, direction=OUT, server-argument-impl-policy=USE-ARGUMENT-TYPE
      error E_NOT_OK: error-code=1
    CSDataServices_DID_500C_PscmSts
      operation ReadData: possible-error=CSDataServices_DID_500C_PscmSts/E_NOT_OK
        arg Data: type=DataArrayType_uint8_2, direction=OUT, server-argument-impl-policy=USE-ARGUMENT-TYPE
      error E_NOT_OK: error-code=1
    CSDataServices_DID_500E_HwTq
      operation ReadData: possible-error=CSDataServices_DID_500E_HwTq/E_NOT_OK
        arg Data: type=DataArrayType_uint8_2, direction=OUT, server-argument-impl-policy=USE-ARGUMENT-TYPE
      error E_NOT_OK: error-code=1
    CSDataServices_DID_500F_MotTq
      operation ReadData: possible-error=CSDataServices_DID_500F_MotTq/E_NOT_OK
        arg Data: type=DataArrayType_uint8_2, direction=OUT, server-argument-impl-policy=USE-ARGUMENT-TYPE
      error E_NOT_OK: error-code=1
package /Nexteer/NvMProxy_swc/Interfaces
  client server interface NvMService_AC3_SRBS: is-service=true
    6 x operation, all with possible-error=NvMService_AC3_SRBS/E_NOT_OK:
      EraseBlock
      GetErrorStatus
        arg ErrorStatus: type=NvM_RequestResultType, direction=OUT, server-argument-impl-policy=USE-ARGUMENT-TYPE
      InvalidateNvBlock
      ReadBlock
        arg DstPtr: type=dtRef_VOID, direction=IN, server-argument-impl-policy=USE-ARGUMENT-TYPE
      SetRamBlockStatus
        arg RamBlockStatus: type=Boolean, direction=IN, server-argument-impl-policy=USE-ARGUMENT-TYPE
      WriteBlock
        arg SrcPtr: type=dtRef_const_VOID, direction=IN, server-argument-impl-policy=USE-ARGUMENT-TYPE
    error E_NOT_OK: error-code=1
package /Nexteer/PortInterfaces
  9 x client server interface:
    ClrBmwRackCentrToVehCentrOffs_PortIf1
      operation Oper
    ClrVehCentrPosn_PortIf1
      operation Oper
    GetNtcActv1_PortIf1
      operation Oper: possible-error=GetNtcActv1_PortIf1/E_NOT_OK
        arg NtcNr: type=NtcNr1, direction=IN, server-argument-impl-policy=USE-ARGUMENT-TYPE
        arg NtcActv: type=boolean, direction=OUT, server-argument-impl-policy=USE-ARGUMENT-TYPE
      error E_NOT_OK: error-code=1
    GetRefTmr1MicroSec32bit_PortIf1
      operation Oper
        arg RefTmr_Arg: type=uint32, direction=OUT, server-argument-impl-policy=USE-ARGUMENT-TYPE
    GetTiSpan1MicroSec32bit_PortIf1
      operation Oper
        arg RefTmr_Arg: type=uint32, direction=IN, server-argument-impl-policy=USE-ARGUMENT-TYPE
        arg TiSpan_Arg: type=uint32, direction=OUT, server-argument-impl-policy=USE-ARGUMENT-TYPE
    RstRackCentrMotAg_PortIf1
      operation Oper
    RstRackCentrMotRev_PortIf1
      operation Oper
    SetInpPrm_PortIf1
      operation Oper
        arg TarVel_Arg: type=float32, direction=IN, server-argument-impl-policy=USE-ARGUMENT-TYPE
        arg TarA_Arg: type=float32, direction=IN, server-argument-impl-policy=USE-ARGUMENT-TYPE
    SetVehCentrPosn_PortIf1
      operation Oper
        arg BmwSetVehCentrOffsSts_Arg: type=BmwSetVehCentrOffsSts1, direction=OUT, server-argument-impl-policy=USE-ARGUMENT-TYPE
  7 x sender receiver interface:
    BmwPinionAgQlfr_PortIf1: invalidation-policy{data-element=BmwPinionAgQlfr_PortIf1/Val, handle-invalid=DONT-INVALIDATE}
      data Val: sw-calibration-access=READ-ONLY, type=BmwPinionAgQlfr1
    boolean_PortIf1: invalidation-policy{data-element=Logl, handle-invalid=DONT-INVALIDATE}
      data Logl: sw-calibration-access=READ-ONLY, type=boolean
    DrvgDynIfSt1_PortIf1: invalidation-policy{data-element=DrvgDynIfSt1_PortIf1/Val, handle-invalid=DONT-INVALIDATE}
      data Val: sw-calibration-access=READ-ONLY, type=DrvgDynIfSt1
    float32_PortIf1: invalidation-policy{data-element=float32_PortIf1/Val, handle-invalid=DONT-INVALIDATE}
      data Val: sw-calibration-access=READ-ONLY, type=float32
    SysSt1_PortIf1: invalidation-policy{data-element=SysSt1_PortIf1/Val, handle-invalid=DONT-INVALIDATE}
      data Val: sw-calibration-access=READ-ONLY, type=SysSt1
    uint32_PortIf1: invalidation-policy{data-element=uint32_PortIf1/Val, handle-invalid=DONT-INVALIDATE}
      data Val: sw-calibration-access=READ-ONLY, type=uint32
    uint8_PortIf1: invalidation-policy{data-element=uint8_PortIf1/Val, handle-invalid=DONT-INVALIDATE}
      data Val: sw-calibration-access=READ-ONLY, type=uint8
package /PortInterfaces
  sender receiver interface BmwBasPtlNetCtrl_PortIf1: invalidation-policy{data-element=BmwBasPtlNetCtrl_PortIf1/Val, handle-invalid=DONT-INVALIDATE}
    data Val: type=BmwBasPtlNetCtrl1
  sender receiver interface BmwVehCdn_PortIf1: invalidation-policy{data-element=BmwVehCdn_PortIf1/Val, handle-invalid=DONT-INVALIDATE}
    data Val: type=BmwVehCdn1
package /Predefined_DEV/PortInterfaces
  client server interface NvMService_AC3_SRBS: is-service=true
    6 x operation, all with possible-error=NvMService_AC3_SRBS/E_NOT_OK:
      EraseBlock
      GetErrorStatus
        arg ErrorStatus: type=NvM_RequestResultType, direction=OUT, server-argument-impl-policy=USE-ARGUMENT-TYPE
      InvalidateNvBlock
      ReadBlock
        arg DstPtr: type=dtRef_VOID, direction=IN, server-argument-impl-policy=USE-ARGUMENT-TYPE
      SetRamBlockStatus
        arg RamBlockStatus: type=boolean, direction=IN, server-argument-impl-policy=USE-ARGUMENT-TYPE
      WriteBlock
        arg SrcPtr: type=dtRef_const_VOID, direction=IN, server-argument-impl-policy=USE-ARGUMENT-TYPE
    error E_NOT_OK: error-code=1
