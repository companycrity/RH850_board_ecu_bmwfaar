AUTOSAR XML (schema 4-3-0)
package /BMW/Platform/Coding/ModeDeclarationGroups
  mode declaration group Coding_DataMode: category=EXPLICIT_ORDER, initial-mode=NCDSTATE_UNDEFINED, on-transition-value=5
    5 x mode:
      NCDSTATE_DEFAULT: value=1
      NCDSTATE_INPROGRESS: value=0
      NCDSTATE_QUALIFIED: value=2
      NCDSTATE_UNDEFINED: value=3
      NCDSTATE_UNQUALIFIED: value=4
package /BMW/Platform/Coding/PortInterfaces
  client server interface Data
    72 x operation, all with possible-error=E_NOT_OK:
      GetCurrentLimit
        arg Value: type=uint8, direction=OUT, server-argument-impl-policy=USE-ARGUMENT-TYPE
      GetNAME00_00_CalculationOfLoadMinusstateMinusdependentSteeringAssistance
        arg Value: type=boolean, direction=OUT, server-argument-impl-policy=USE-ARGUMENT-TYPE
      GetNAME00_01_CalculationOfActiveReturn
        arg Value: type=boolean, direction=OUT, server-argument-impl-policy=USE-ARGUMENT-TYPE
      GetNAME00_02_reserved
        arg Value: type=boolean, direction=OUT, server-argument-impl-policy=USE-ARGUMENT-TYPE
      GetNAME00_03_ActiveInfluenceOnTheSteeringHysterisis
        arg Value: type=boolean, direction=OUT, server-argument-impl-policy=USE-ARGUMENT-TYPE
      GetNAME00_04_reserved
        arg Value: type=boolean, direction=OUT, server-argument-impl-policy=USE-ARGUMENT-TYPE
      GetNAME00_05_reserved
        arg Value: type=boolean, direction=OUT, server-argument-impl-policy=USE-ARGUMENT-TYPE
      GetNAME00_06_reserved
        arg Value: type=boolean, direction=OUT, server-argument-impl-policy=USE-ARGUMENT-TYPE
      GetNAME00_07_reserved
        arg Value: type=boolean, direction=OUT, server-argument-impl-policy=USE-ARGUMENT-TYPE
      GetNAME01_00_reserved
        arg Value: type=boolean, direction=OUT, server-argument-impl-policy=USE-ARGUMENT-TYPE
      GetNAME01_01_reserved
        arg Value: type=boolean, direction=OUT, server-argument-impl-policy=USE-ARGUMENT-TYPE
      GetNAME01_02_reserved
        arg Value: type=boolean, direction=OUT, server-argument-impl-policy=USE-ARGUMENT-TYPE
      GetNAME01_03_ParkingPowerDamping
        arg Value: type=boolean, direction=OUT, server-argument-impl-policy=USE-ARGUMENT-TYPE
      GetNAME01_04_reserved
        arg Value: type=boolean, direction=OUT, server-argument-impl-policy=USE-ARGUMENT-TYPE
      GetNAME01_05_reserved
        arg Value: type=boolean, direction=OUT, server-argument-impl-policy=USE-ARGUMENT-TYPE
      GetNAME01_06_reserved
        arg Value: type=boolean, direction=OUT, server-argument-impl-policy=USE-ARGUMENT-TYPE
      GetNAME01_07_reserved
        arg Value: type=boolean, direction=OUT, server-argument-impl-policy=USE-ARGUMENT-TYPE
      GetNAME02_00_CompensationOfFriction
        arg Value: type=boolean, direction=OUT, server-argument-impl-policy=USE-ARGUMENT-TYPE
      GetNAME02_01_CompensationOfConstantSteeringPullAndLateralInclinationPull
        arg Value: type=boolean, direction=OUT, server-argument-impl-policy=USE-ARGUMENT-TYPE
      GetNAME02_02
        arg Value: type=boolean, direction=OUT, server-argument-impl-policy=USE-ARGUMENT-TYPE
      GetNAME02_03
        arg Value: type=boolean, direction=OUT, server-argument-impl-policy=USE-ARGUMENT-TYPE
      GetNAME02_04_CompensationOfInertiaOfTheSteeringGear
        arg Value: type=boolean, direction=OUT, server-argument-impl-policy=USE-ARGUMENT-TYPE
      GetNAME02_05_CompensationOfInertiaOfTheSteeringWheel
        arg Value: type=boolean, direction=OUT, server-argument-impl-policy=USE-ARGUMENT-TYPE
      GetNAME02_06
        arg Value: type=boolean, direction=OUT, server-argument-impl-policy=USE-ARGUMENT-TYPE
      GetNAME02_07
        arg Value: type=boolean, direction=OUT, server-argument-impl-policy=USE-ARGUMENT-TYPE
      GetNAME03_00_reserved
        arg Value: type=boolean, direction=OUT, server-argument-impl-policy=USE-ARGUMENT-TYPE
      GetNAME03_01_VoltageDependantDegredation
        arg Value: type=boolean, direction=OUT, server-argument-impl-policy=USE-ARGUMENT-TYPE
      GetNAME03_02_SpeedDependantDegredation
        arg Value: type=boolean, direction=OUT, server-argument-impl-policy=USE-ARGUMENT-TYPE
      GetNAME03_03_reserved
        arg Value: type=boolean, direction=OUT, server-argument-impl-policy=USE-ARGUMENT-TYPE
      GetNAME03_04_reserved
        arg Value: type=boolean, direction=OUT, server-argument-impl-policy=USE-ARGUMENT-TYPE
      GetNAME03_05_reserved
        arg Value: type=boolean, direction=OUT, server-argument-impl-policy=USE-ARGUMENT-TYPE
      GetNAME03_06_reserved
        arg Value: type=boolean, direction=OUT, server-argument-impl-policy=USE-ARGUMENT-TYPE
      GetNAME03_07_reserved
        arg Value: type=boolean, direction=OUT, server-argument-impl-policy=USE-ARGUMENT-TYPE
      GetNAME04_00_DrivingDynamicsInterfaceMinusDriversTorque
        arg Value: type=boolean, direction=OUT, server-argument-impl-policy=USE-ARGUMENT-TYPE
      GetNAME04_00_DrivingDynamicsInterfaceMinusMotorTorque
        arg Value: type=boolean, direction=OUT, server-argument-impl-policy=USE-ARGUMENT-TYPE
      GetNAME04_02_DrivingDynamicsInterfaceMinusFactors
        arg Value: type=boolean, direction=OUT, server-argument-impl-policy=USE-ARGUMENT-TYPE
      GetNAME04_03_DrivingDynamicsInterfaceMinusAdditionalDamping
        arg Value: type=boolean, direction=OUT, server-argument-impl-policy=USE-ARGUMENT-TYPE
      GetNAME04_04_EPSVibration
        arg Value: type=boolean, direction=OUT, server-argument-impl-policy=USE-ARGUMENT-TYPE
      GetNAME04_05_DrivingExperienceSwitch
        arg Value: type=boolean, direction=OUT, server-argument-impl-policy=USE-ARGUMENT-TYPE
      GetNAME04_06_reserved
        arg Value: type=boolean, direction=OUT, server-argument-impl-policy=USE-ARGUMENT-TYPE
      GetNAME04_07_automaticEngineStartStopFunction
        arg Value: type=boolean, direction=OUT, server-argument-impl-policy=USE-ARGUMENT-TYPE
      GetNAME05_00_ActiveFanActuation
        arg Value: type=boolean, direction=OUT, server-argument-impl-policy=USE-ARGUMENT-TYPE
      GetNAME05_01_reserved
        arg Value: type=boolean, direction=OUT, server-argument-impl-policy=USE-ARGUMENT-TYPE
      GetNAME05_02_reserved
        arg Value: type=boolean, direction=OUT, server-argument-impl-policy=USE-ARGUMENT-TYPE
      GetNAME05_03_reserved
        arg Value: type=boolean, direction=OUT, server-argument-impl-policy=USE-ARGUMENT-TYPE
      GetNAME05_04_reserved
        arg Value: type=boolean, direction=OUT, server-argument-impl-policy=USE-ARGUMENT-TYPE
      GetNAME05_05_reserved
        arg Value: type=boolean, direction=OUT, server-argument-impl-policy=USE-ARGUMENT-TYPE
      GetNAME05_06_reserved
        arg Value: type=boolean, direction=OUT, server-argument-impl-policy=USE-ARGUMENT-TYPE
      GetNAME05_07_reserved
        arg Value: type=boolean, direction=OUT, server-argument-impl-policy=USE-ARGUMENT-TYPE
      GetNAME08_reserved
        arg Value: type=uint8, direction=OUT, server-argument-impl-policy=USE-ARGUMENT-TYPE
      GetNAME09_reserved
        arg Value: type=uint8, direction=OUT, server-argument-impl-policy=USE-ARGUMENT-TYPE
      GetNAME10_reserved
        arg Value: type=uint8, direction=OUT, server-argument-impl-policy=USE-ARGUMENT-TYPE
      GetNAME11_reserved
        arg Value: type=uint8, direction=OUT, server-argument-impl-policy=USE-ARGUMENT-TYPE
      GetNAME12_reserved
        arg Value: type=uint8, direction=OUT, server-argument-impl-policy=USE-ARGUMENT-TYPE
      GetNAME13_reserved
        arg Value: type=uint8, direction=OUT, server-argument-impl-policy=USE-ARGUMENT-TYPE
      GetNAME14_reserved
        arg Value: type=uint8, direction=OUT, server-argument-impl-policy=USE-ARGUMENT-TYPE
      GetNAME15_reserved
        arg Value: type=uint8, direction=OUT, server-argument-impl-policy=USE-ARGUMENT-TYPE
      GetNAME16_reserved
        arg Value: type=uint8, direction=OUT, server-argument-impl-policy=USE-ARGUMENT-TYPE
      GetNAME17_reserved
        arg Value: type=uint8, direction=OUT, server-argument-impl-policy=USE-ARGUMENT-TYPE
      GetNAME18_reserved
        arg Value: type=uint8, direction=OUT, server-argument-impl-policy=USE-ARGUMENT-TYPE
      GetNAME19_reserved
        arg Value: type=uint8, direction=OUT, server-argument-impl-policy=USE-ARGUMENT-TYPE
      GetNAME20_reserved
        arg Value: type=uint8, direction=OUT, server-argument-impl-policy=USE-ARGUMENT-TYPE
      GetNAME21_reserved
        arg Value: type=uint8, direction=OUT, server-argument-impl-policy=USE-ARGUMENT-TYPE
      GetNAME22_reserved
        arg Value: type=uint8, direction=OUT, server-argument-impl-policy=USE-ARGUMENT-TYPE
      GetNAME23_reserved
        arg Value: type=uint8, direction=OUT, server-argument-impl-policy=USE-ARGUMENT-TYPE
      GetNAME24_reserved
        arg Value: type=uint8, direction=OUT, server-argument-impl-policy=USE-ARGUMENT-TYPE
      GetNAME25_reserved
        arg Value: type=uint8, direction=OUT, server-argument-impl-policy=USE-ARGUMENT-TYPE
      GetNAME26_reserved
        arg Value: type=uint8, direction=OUT, server-argument-impl-policy=USE-ARGUMENT-TYPE
      GetNAME27_reserved
        arg Value: type=uint8, direction=OUT, server-argument-impl-policy=USE-ARGUMENT-TYPE
      GetNAME28_reserved
        arg Value: type=uint8, direction=OUT, server-argument-impl-policy=USE-ARGUMENT-TYPE
      GetNAME29_reserved
        arg Value: type=uint8, direction=OUT, server-argument-impl-policy=USE-ARGUMENT-TYPE
      GetSpeedMinuslimitForMaxCurrent
        arg Value: type=uint8, direction=OUT, server-argument-impl-policy=USE-ARGUMENT-TYPE
    error E_NOT_OK: error-code=1
package /Nexteer/Calibrations
  parameter interface uint8_CalPortIf1
    parameter data prototype Val: sw-calibration-access=READ-WRITE, type=uint8
package /Nexteer/PortInterfaces
  sender receiver interface boolean_PortIf1: invalidation-policy{data-element=Logl, handle-invalid=DONT-INVALIDATE}
    data Logl: sw-calibration-access=READ-ONLY, type=boolean
  sender receiver interface float32_PortIf1: invalidation-policy{data-element=Val, handle-invalid=DONT-INVALIDATE}
    data Val: sw-calibration-access=READ-ONLY, type=float32
package /PortInterfaces
  mode switch interface Coding_DataMode
    mode group Mode: type=Coding_DataMode
