AUTOSAR XML (schema 4-0-3)
standard types defined: boolean, float32, uint16, uint8, boolean_CompuMethod, boolean_DataConstr, float32_DataConstr, uint16_DataConstr, uint8_DataConstr
package /AUTOSAR_Platform/ImplementationDataTypes
  8 x impl type:
    ALIV_V_VEH1: category=VALUE, base-type=uint8
    CRC_V_VEH1: category=VALUE, base-type=uint8
    DVCO_VEH1: category=VALUE, base-type=uint8
    QU_V_VEH_COG1: category=VALUE, base-type=uint8
    sigGroup_V_VEH1: category=STRUCTURE
      7 x element, all with category=TYPE_REFERENCE:
        V_VEH_COG: implementation-data-type=V_VEH_COG1
        ST_V_VEH_NSS: range raw 0..15, implementation-data-type=ImplementationDataTypes/ST_V_VEH_NSS1
        QU_V_VEH_COG: range raw 0..15, implementation-data-type=ImplementationDataTypes/QU_V_VEH_COG1
        ALIV_V_VEH: range raw 0..15, implementation-data-type=ALIV_V_VEH1
        V_VEH_dummy_39_39: implementation-data-type=V_VEH_dummy_39_391
        DVCO_VEH: range raw 0..7, implementation-data-type=DVCO_VEH1
        CRC_V_VEH: implementation-data-type=CRC_V_VEH1
    ST_V_VEH_NSS1: category=VALUE, base-type=uint8
    V_VEH_COG1: category=VALUE, base-type=uint16
    V_VEH_dummy_39_391: category=VALUE, base-type=uint8
package /DataTypes
  impl type QU_V_VEH_COG1:
    category=VALUE
    base-type=uint8
    compu {8=Initialisierung (QU_V_VEH_COG_Initialisierung) (Tritt während der Initialisierungsphase auf bis Ist-Wert verfügbar (Vorbefüllung). Nutzsignal wird permanent mit Nutzwert 0 befüllt.), 1=SignalwertIstGueltigUndAbgesichertUndPlausibilisiert (QU_V_VEH_COG_SignalwertIstGueltigUndAbgesichertUndPlausibilisiert) (BNE original name: Signalwert ist gültig und abgesichert und plausibilisiert), 9=Reserved (QU_V_VEH_COG_Reserved), 2=Reserved_bne_C9CB853E97D84E34ADF2107B01966081_2 (QU_V_VEH_COG_Reserved_bne_C9CB853E97D84E34ADF2107B01966081_2) (BNE original name: Reserved), 10=SignalwertIstGueltigZustandSlashStatusTemporaer (QU_V_VEH_COG_SignalwertIstGueltigZustandSlashStatusTemporaer) (BNE original name: Signalwert ist gültig, Zustand/Status temporär), 3=Reserved_bne_C9CB853E97D84E34ADF2107B01966081_3 (QU_V_VEH_COG_Reserved_bne_C9CB853E97D84E34ADF2107B01966081_3) (BNE original name: Reserved), 11=SignalqualitaetBzwDotUeberwachungEingeschraenktZustandSlashStatusTemporaer (QU_V_VEH_COG_SignalqualitaetBzwDotUeberwachungEingeschraenktZustandSlashStatusTemporaer) (BNE original name: Signalqualität bzw. Überwachung eingeschränkt, Zustand/Status temporär), 4=Reserved_bne_C9CB853E97D84E34ADF2107B01966081_4 (QU_V_VEH_COG_Reserved_bne_C9CB853E97D84E34ADF2107B01966081_4) (BNE original name: Reserved), 12=Reserved_bne_C9CB853E97D84E34ADF2107B01966081_12 (QU_V_VEH_COG_Reserved_bne_C9CB853E97D84E34ADF2107B01966081_12) (BNE original name: Reserved), 6=Reserved_bne_C9CB853E97D84E34ADF2107B01966081_6 (QU_V_VEH_COG_Reserved_bne_C9CB853E97D84E34ADF2107B01966081_6) (BNE original name: Reserved), 14=SignalwertIstUngueltigZustandSlashStatusTemporaer (QU_V_VEH_COG_SignalwertIstUngueltigZustandSlashStatusTemporaer) (BNE original name: Signalwert ist ungültig, Zustand/Status temporär), 7=Reserved_bne_C9CB853E97D84E34ADF2107B01966081_7 (QU_V_VEH_COG_Reserved_bne_C9CB853E97D84E34ADF2107B01966081_7) (BNE original name: Reserved), 15=SignalUngueltig (QU_V_VEH_COG_SignalUngueltig) (BNE original name: Signal ungültig)}
  impl type ST_V_VEH_NSS1:
    category=VALUE
    base-type=uint8
    compu {12=FahrzeugImStillstandsnahenBereich (ST_V_VEH_NSS_FahrzeugImStillstandsnahenBereich) (BNE original name: Fahrzeug im stillstandsnahen Bereich), 13=FahrzeugNichtImStillstandsnahenBereich (ST_V_VEH_NSS_FahrzeugNichtImStillstandsnahenBereich) (BNE original name: Fahrzeug nicht im stillstandsnahen Bereich), 15=SignalUngueltig (ST_V_VEH_NSS_SignalUngueltig) (BNE original name: Signal ungültig)}
package /Nexteer/DataTypes
  4 x impl type, all with category=TYPE_REFERENCE, type-emitter=RTE:
    BmwCogVehSpdQlfr1: compu {1=BMWCOGVEHSPDQLFR_SIGVALVLDANDPLAUS, 8=BMWCOGVEHSPDQLFR_INIT, 10=BMWCOGVEHSPDQLFR_SIGVALTMPVLD, 11=BMWCOGVEHSPDQLFR_SIGQLYMONTMPRSTRCTD, 14=BMWCOGVEHSPDQLFR_SIGVALTMPINVLD, 15=BMWCOGVEHSPDQLFR_INVLD}, implementation-data-type=uint8
    BmwNearStillVehSpdSts1: compu {12=BMWNEARSTILLVEHSPDSTS_VEHREST, 13=BMWNEARSTILLVEHSPDSTS_VEHNOTREST, 15=BMWNEARSTILLVEHSPDSTS_INVLD}, implementation-data-type=uint8
    NtcNr1: compu {1..511=NTCNR_0X001..NTCNR_0X1FF}, implementation-data-type=uint16
    NtcSts1: compu {0=NTCSTS_PASSD, 1=NTCSTS_FAILD, 2=NTCSTS_PREPASSD, 3=NTCSTS_PREFAILD}, implementation-data-type=uint8
