AUTOSAR XML (schema 4-0-3)
standard types defined: float32, sint16, uint16, boolean_CompuMethod, float32_DataConstr, sint16_DataConstr, uint16_DataConstr
package /Nexteer/DataTypes
  12 x impl type, all with type-emitter=RTE:
    Ary1D_s15p0_10: category=ARRAY, sw-calibration-access=READ-ONLY
      element Element: array-size=10, array-size-semantics=FIXED-SIZE, implementation-data-type=s15p0
    Ary1D_u15p1_24: category=ARRAY, sw-calibration-access=READ-ONLY
      element Element: array-size=24, array-size-semantics=FIXED-SIZE, implementation-data-type=u15p1
    Ary1D_u1p15_10: category=ARRAY, sw-calibration-access=READ-ONLY
      element Element: array-size=10, array-size-semantics=FIXED-SIZE, implementation-data-type=u1p15
    Ary1D_u4p12_24: category=ARRAY, sw-calibration-access=READ-ONLY
      element Element: array-size=24, array-size-semantics=FIXED-SIZE, implementation-data-type=u4p12
    Ary1D_u9p7_10: category=ARRAY, sw-calibration-access=READ-ONLY
      element Element: array-size=10, array-size-semantics=FIXED-SIZE, implementation-data-type=u9p7
    Ary2D_u15p1_10_24: category=ARRAY, sw-calibration-access=READ-ONLY
      element Element: array-size=10, array-size-semantics=FIXED-SIZE, implementation-data-type=Ary1D_u15p1_24
    Ary2D_u4p12_10_24: category=ARRAY, sw-calibration-access=READ-ONLY
      element Element: array-size=10, array-size-semantics=FIXED-SIZE, implementation-data-type=Ary1D_u4p12_24
    s15p0: implementation-data-type=sint16
    u15p1: implementation-data-type=uint16
    u1p15: implementation-data-type=uint16
    u4p12: implementation-data-type=uint16
    u9p7: implementation-data-type=uint16
