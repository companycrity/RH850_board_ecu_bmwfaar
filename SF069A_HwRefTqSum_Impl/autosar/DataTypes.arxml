AUTOSAR XML (schema 4-0-3)
standard types defined: float32, float32_DataConstr
