AUTOSAR XML (schema 4-0-3)
package /Nexteer/PortInterfaces
  client server interface SetNtcSts_PortIf1
    operation Oper: possible-error=E_NOT_OK
      4 x arg, all with direction=IN, server-argument-impl-policy=USE-ARGUMENT-TYPE:
        NtcNr_Arg: type=NtcNr1
        NtcStInfo_Arg: type=uint8
        NtcSts_Arg: type=NtcSts1
        DebStep_Arg: type=uint16
    error E_NOT_OK: error-code=1
  sender receiver interface boolean_PortIf1: invalidation-policy{data-element=Logl, handle-invalid=DONT-INVALIDATE}
    data Logl: sw-calibration-access=READ-ONLY, type=boolean
  sender receiver interface float32_PortIf1: invalidation-policy{data-element=float32_PortIf1/Val, handle-invalid=DONT-INVALIDATE}
    data Val: sw-calibration-access=READ-ONLY, type=float32
package /PortInterfaces
  4 x sender receiver interface:
    BmwRtIdx_PortIf1: invalidation-policy{data-element=BmwRtIdx_PortIf1/Val, handle-invalid=DONT-INVALIDATE}
      data Val: type=BmwRtIdx1
    BmwSteerMdfnFacSts_PortIf1: invalidation-policy{data-element=BmwSteerMdfnFacSts_PortIf1/Val, handle-invalid=DONT-INVALIDATE}
      data Val: type=BmwSteerMdfnFacSts1
    FACT_MO_STE_SO_DXP: invalidation-policy{data-element=FACT_MO_STE_SO_DXP, handle-invalid=DONT-INVALIDATE}
      data FACT_MO_STE_SO_DXP: type=FACT_MO_STE_SO_DXP1
    SU_CLU_STMOM_SFE_DXP: invalidation-policy{data-element=SU_CLU_STMOM_SFE_DXP, handle-invalid=DONT-INVALIDATE}
      data SU_CLU_STMOM_SFE_DXP: type=SU_CLU_STMOM_SFE_DXP1
