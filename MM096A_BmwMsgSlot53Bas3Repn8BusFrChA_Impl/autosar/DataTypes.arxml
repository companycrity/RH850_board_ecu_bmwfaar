AUTOSAR XML (schema 4-0-3)
standard types defined: boolean, float32, uint16, uint8, boolean_CompuMethod, boolean_DataConstr, float32_DataConstr, uint16_DataConstr, uint8_DataConstr
package /DataTypes
  4 x impl type, all with category=VALUE, base-type=uint8:
    BmwRtIdx1: sw-calibration-access=READ-ONLY, compu {1=BMWRTIDX_ULTRAHARD, 2=BMWRTIDX_SPTBAL, 3=BMWRTIDX_BAL, 4=BMWRTIDX_SOFT, 13=BMWRTIDX_FCTLIFNOTAVL, 14=BMWRTIDX_FCTRPTERR, 15=BMWRTIDX_INVLD}, type-emitter=RTE
    BmwSteerMdfnFacSts1: sw-calibration-access=READ-ONLY, compu {0=BMWSTEERMDFNFACSTS_OUTOFRNG, 1=BMWSTEERMDFNFACSTS_VLD, 2=BMWSTEERMDFNFACSTS_FCTIFNOTAVL, 3=BMWSTEERMDFNFACSTS_FCTRPRTERR, 4=BMWSTEERMDFNFACSTS_INVLDSIG}, type-emitter=RTE
    FACT_MO_STE_SO_DXP1:
      compu {phys=raw*0.02 for raw 0..12500, 253=Funktionsschnittstelle_ist_nicht_verfuegbar (FACT_MO_STE_SO_DXP_Funktionsschnittstelle_ist_nicht_verfuegbar) (Sendefunktion in Betrieb, Werte nicht verfügbar), 254=Funktion_meldet_Fehler (FACT_MO_STE_SO_DXP_Funktion_meldet_Fehler) (Sendefunktion in Betrieb, meldet Fehler), 255=Signal_unbefuellt (FACT_MO_STE_SO_DXP_Signal_unbefuellt) (Sendefunktion nicht in Betrieb)}
      range phys 0..250
      invalid-value=255
    SU_CLU_STMOM_SFE_DXP1:
      compu {1=Ultrahart (SU_CLU_STMOM_SFE_DXP_Ultrahart), 2=SportlichAusgewogen (SU_CLU_STMOM_SFE_DXP_SportlichAusgewogen) (BNE original name: Sportlich ausgewogen), 3=Ausgewogen (SU_CLU_STMOM_SFE_DXP_Ausgewogen), 4=Weich (SU_CLU_STMOM_SFE_DXP_Weich), 13=Funktionsschnittstelle_ist_nicht_verfuegbar (SU_CLU_STMOM_SFE_DXP_Funktionsschnittstelle_ist_nicht_verfuegbar) (Sendefunktion in Betrieb, Werte nicht verfügbar), 14=Funktion_meldet_Fehler (SU_CLU_STMOM_SFE_DXP_Funktion_meldet_Fehler) (Sendefunktion in Betrieb, meldet Fehler), 15=Signal_unbefuellt (SU_CLU_STMOM_SFE_DXP_Signal_unbefuellt) (Sendefunktion nicht in Betrieb)}
      range raw 0..15
      invalid-value=15
package /Nexteer/DataTypes
  impl type NtcNr1: compu {1..511=NTCNR_0X001..NTCNR_0X1FF}, implementation-data-type=uint16, type-emitter=RTE
  impl type NtcSts1: compu {0=NTCSTS_PASSD, 1=NTCSTS_FAILD, 2=NTCSTS_PREPASSD, 3=NTCSTS_PREFAILD}, implementation-data-type=uint8, type-emitter=RTE
