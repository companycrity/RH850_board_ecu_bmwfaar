AUTOSAR XML (schema 4-0-3)
package /Nexteer/PortInterfaces
  4 x client server interface:
    ClrErrInjReg_PortIf1
      operation Oper
    ReadErrInjReg_PortIf1
      operation Oper
        arg ErrId_Arg: type=uint32, direction=OUT
    StrtErrInjCntr_PortIf1
      operation Oper
    UpdErrInjReg_PortIf1
      operation Oper
        arg NtcNr_Arg: type=uint16, direction=IN
        arg NtcStInfo_Arg: type=uint8, direction=IN
        arg ErrInjNr_Arg: type=uint8, direction=IN
