AUTOSAR XML (schema 4-0-3)
package /Nexteer/Calibrations
  parameter interface boolean_CalPortIf1
    parameter data prototype Logl: sw-calibration-access=READ-WRITE, type=boolean
  parameter interface float32_CalPortIf1
    parameter data prototype Val: sw-calibration-access=READ-WRITE, type=float32
