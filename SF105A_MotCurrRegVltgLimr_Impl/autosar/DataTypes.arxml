AUTOSAR XML (schema 4-0-3)
standard types defined: boolean, float32, boolean_CompuMethod, boolean_DataConstr, float32_DataConstr
package /Nexteer/DataTypes
  impl type FilLpRec1: category=STRUCTURE, sw-calibration-access=READ-ONLY, type-emitter=NxtrFil
    element FilSt: implementation-data-type=ImplementationDataTypes/float32
    element FilGain: implementation-data-type=ImplementationDataTypes/float32
    symbol props FilLpRec1
