AUTOSAR XML (schema 4-0-3)
package /Nexteer
  module definition RvsBattProtn [0..1]: variants pre-compile  # Configuration of the RvsBattProtn.
    container RvsBattProtnGeneral  # This container contains the configuration (parameters) of the RvsBattProtn.
      integer FAILSTEP: 0..65535, set at pre-compile, origin=NEXTEER, default-value=6552  # Debounce NTC set strategy step towards FAIL status
      float GNDMEASDVLTGHILIMN: 0..5, set at pre-compile, origin=NEXTEER, default-value=1.5  # Maximum allowed signal level for ground related measures
      float GNDMEASDVLTGLOLIMN: 0..5, set at pre-compile, origin=NEXTEER, default-value=1.1  # Minimum allowed signal level for ground related measures
      integer PASSSTEP: 0..65535, set at pre-compile, origin=NEXTEER, default-value=3276  # Debounce NTC set strategy step towards PASS status
      float RTNMEASDVLTGHILIMN: 0..5, set at pre-compile, origin=NEXTEER, default-value=1.5  # Maximum allowed signal level for battery return related measures
      float RTNMEASDVLTGLOLIMN: 0..5, set at pre-compile, origin=NEXTEER, default-value=0.12  # Minimum allowed signal level for battery return related measures
      float RVSFLTTHD: 0..5, set at pre-compile, origin=NEXTEER, default-value=0.4  # Threshold level for detection of MOSFET malfunction
