AUTOSAR XML (schema 4-0-3)
package /Nexteer
  module definition MotAg4Meas [0..1]: variants pre-compile  # Configuration of the MotAg4Meas.
    container MotAg4MeasCfg  # This container contains the configuration (parameters) of the MotAg4Meas.
      enumeration MotAg4SnsrRlvBitWidthExp: {0, 1, 2, 3, 4, 5, 6, 7, 8, 9, 10, 11, 12, 13, 14, 15}, set at pre-compile, origin=Nexteer, default-value=4  # Motor Angle 4 Sensor Relevant Bit Width Expansion.
