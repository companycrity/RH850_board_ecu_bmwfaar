AUTOSAR XML (schema 4-0-3)
package /Nexteer
  module definition BmwHwAgArbnAndEotPosn [0..1]: variants pre-compile  # Configuration of the BmwHwAgArbnAndEotPosn.
    container BmwHwAgArbnAndEotPosnGeneral  # This container contains the configuration (parameters) of the BmwHwAgArbnAndEotPosn.
      enumeration NTCHWAGSNSRNOTTRIM: {NTCNR_0X1E0, NTCNR_0X1E1, NTCNR_0X1E2, NTCNR_0X1E3, NTCNR_0X1E4, NTCNR_0X1E5, NTCNR_0X1E6, NTCNR_0X1E7, NTCNR_0X1E8, NTCNR_0X1E9, NTCNR_0X1EA, NTCNR_0X1EB, NTCNR_0X1EC, NTCNR_0X1ED, NTCNR_0X1EE, NTCNR_0X1EF, NTCNR_0X1F0, NTCNR_0X1F1, NTCNR_0X1F2, NTCNR_0X1F3, NTCNR_0X1F4, NTCNR_0X1F5, NTCNR_0X1F6, NTCNR_0X1F7, NTCNR_0X1F8, NTCNR_0X1F9, NTCNR_0X1FA, NTCNR_0X1FB, NTCNR_0X1FC, NTCNR_0X1FD, NTCNR_0X1FE, NTCNR_0X1FF}, set at pre-compile, origin=Nexteer, default-value=NTCNR_0X1E0  # Nexteer Trouble Code Handwheel Angle Sensor Not Trim, released when the offsets exceed their thresholds.
      enumeration NTCLOSSOFPINIOINAGZEROSPD: {NTCNR_0X0E0, NTCNR_0X0E1, NTCNR_0X0E2, NTCNR_0X0E3, NTCNR_0X0E4, NTCNR_0X0E5, NTCNR_0X0E6, NTCNR_0X0E7, NTCNR_0X0E8, NTCNR_0X0E9, NTCNR_0X0EA, NTCNR_0X0EB, NTCNR_0X0EC, NTCNR_0X0ED, NTCNR_0X0EE, NTCNR_0X0EF, NTCNR_0X0F0, NTCNR_0X0F1, NTCNR_0X0F2, NTCNR_0X0F3, NTCNR_0X0F4, NTCNR_0X0F5, NTCNR_0X0F6, NTCNR_0X0F7, NTCNR_0X0F8, NTCNR_0X0F9, NTCNR_0X0FA, NTCNR_0X0FB, NTCNR_0X0FC, NTCNR_0X0FD, NTCNR_0X0FE, NTCNR_0X0FF}, set at pre-compile, origin=Nexteer, default-value=NTCNR_0X0E0  # Nexteer Trouble Code Loss of Pinion Angle Zero Speed, released when the BMW Motor Angle Offset Selection State is "Invalid" or "Substitute Value".
      enumeration NTCLOSSOFPINIONAG: {NTCNR_0X0E0, NTCNR_0X0E1, NTCNR_0X0E2, NTCNR_0X0E3, NTCNR_0X0E4, NTCNR_0X0E5, NTCNR_0X0E6, NTCNR_0X0E7, NTCNR_0X0E8, NTCNR_0X0E9, NTCNR_0X0EA, NTCNR_0X0EB, NTCNR_0X0EC, NTCNR_0X0ED, NTCNR_0X0EE, NTCNR_0X0EF, NTCNR_0X0F0, NTCNR_0X0F1, NTCNR_0X0F2, NTCNR_0X0F3, NTCNR_0X0F4, NTCNR_0X0F5, NTCNR_0X0F6, NTCNR_0X0F7, NTCNR_0X0F8, NTCNR_0X0F9, NTCNR_0X0FA, NTCNR_0X0FB, NTCNR_0X0FC, NTCNR_0X0FD, NTCNR_0X0FE, NTCNR_0X0FF}, set at pre-compile, origin=Nexteer, default-value=NTCNR_0X0E0  # Nexteer Trouble Code Loss of Pinion Angle, triggering criteria discussed in the requirements.
