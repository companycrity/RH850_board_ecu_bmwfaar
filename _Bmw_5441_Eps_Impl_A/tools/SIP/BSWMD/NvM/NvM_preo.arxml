AUTOSAR XML (schema 4-0-3)
package /MICROSAR
  module config NvM_Pre: definition=NvM
    NvMConfigBlock (NvMBlockDescriptor): NvMBlockManagementType=NVM_BLOCK_REDUNDANT
  module config NvM_Rec: definition=NvM, implementation-config-variant=VARIANT-PRE-COMPILE
    NvMCommonVendorParams: NvMCrcIntBuffer=1, NvMKillWriteAllApi=1, NvMMultiblockId=MultiBlockRequest, NvMCfgCbkIncludeList=Dem_Cbk.h, NvMCfgCbkIncludeList=(unset)
