AUTOSAR XML (schema 4-0-3)
package /Nexteer
  module definition MotAg0Meas [0..1]: variants pre-compile  # Configuration of the MotAg0Meas.
    container MotAg0MeasGeneral  # This container contains the configuration (parameters) of the MotAg0Meas.
      boolean DIQEPIF: set at pre-compile, origin=NEXTEER, default-value=false  # Disables usage of QEP readings. Motor position readings switch to SPI interface
      enumeration MOTAG0PRTCLFLTNTCNR: {NTCNR_0X083, NTCNR_0X084, NTCNR_0X085, NTCNR_0X086, NTCNR_0X087, NTCNR_0X088, NTCNR_0X089, NTCNR_0X08A}, set at pre-compile, origin=Nexteer, default-value=NTCNR_0X083  # Motor Angle 0 Protocol Fault NTC Number
