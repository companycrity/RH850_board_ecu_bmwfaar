AUTOSAR XML (schema 4-0-3)
package /MICROSAR/FrTrcv_30_Tja1082
  bsw implementation FrTrcv_Impl: programming-language=C, sw-version=1.00.02, used-code-generator=cMSR, vendor-id=30, ar-release-version=4.00.03, behavior=FrTrcvBehavior, preconfigured-configuration=FrTrcv_Pre, recommended-configuration=FrTrcv_Rec, vendor-api-infix=Tja1082, vendor-specific-module-def=FrTrcv
  module definition FrTrcv [0..*]: category=VENDOR_SPECIFIC_MODULE_DEFINITION, refined-module-def=FrTrcv, variants pre-compile  # Configuration of the FrTrcv (FlexRay Transceiver driver) module.
    container FrTrcvChannel [1..*]  # Container gives FlexRay transceiver driver information about a single FlexRay transceiver channel. | Any FlexRay transceiver driver has such FlexRay transceiver channels.
      integer FrTrcvChannelId: 0..255, set at pre-compile, symbolic-name-value=true, default-value=0  # Unique identifier of the FlexRay Transceiver Channel.
      boolean FrTrcvChannelUsed: set at pre-compile, default-value=true  # Shall the related FlexRay transceiver channel be used?
      boolean FrTrcvControlsPowerSupply: set at pre-compile, default-value=false  # Is ECU power supply controlled by this transceiver?
      function name FrTrcvEnableInterruptCallout [0..1]: set at pre-compile  # This parameter defines the existence and the name of a callout function that enables the interrupt pin for the wakeup. If this parameter is omitted no callout shall take place. Parameter not supported!
      enumeration FrTrcvInitState: {FRTRCV_TRCVMODE_NORMAL, FRTRCV_TRCVMODE_STANDBY}, set at pre-compile, default-value=FRTRCV_TRCVMODE_STANDBY  # State of FlexRay transceiver after power on. | ImplementationType: FrTrcv_TrcvModeType
      enumeration FrTrcvMaxBaudrate: {FR_10M, FR_2M5, FR_5M0}, set at pre-compile, default-value=FR_10M  # Max baudrate for transceiver hardware type. Only used for validation purposes. Value shall be configured by configuration tool based on Parameter not supported! | FRTRCV_HARDWARE_NAME and internal information about ability of this hardware typel.
      boolean FrTrcvWakeupByBusUsed: set at pre-compile, default-value=false  # Is wake up by node supported? If FlexRay transceiver hardware does not support wake up by node value is always FALSE. If FlexRay transceiver hardware supports wake up by node value is TRUE or FALSE depending whether it is used or not.
      symbolic name reference FrTrcvIcuChannelRef [0..1]: set at pre-compile, destination=IcuChannel  # Reference to the IcuChannel to enable/disable the interrupts for wakeups. Parameter not supported!
      symbolic name reference FrTrcvWakeupSourceRef [0..1]: set at pre-compile, destination=EcuMWakeupSource  # Reference to a wakeup source in the EcuM configuration. If | FrTrcvWakeUpSupport is configured as FRTRCV_WAKEUP_NOT_SUPPORTED the FrTrcvWakeupSourceRef is not needed. Implementation Type: reference to EcuM_WakeupSourceType
      choice container FrTrcvAccess
        container FrTrcvDioAccess  # Container gives FR transceiver driver information about accessing ports and port pins. If a FR transceiver hardware has no Dio interface, there is no instance of this container.
          container FrTrcvDioChannelAccess [2..2]  # In this Container the relation between FR transceiver hardware pin names and Dio port access information is given.
            string FrTrcvHardwareInterfaceName: set at pre-compile  # FR transceiver hardware interface name. It is typically the name of a pin. From a Dio point of view it is either a port, a single channel or a channel group. Depending on this fact either FRTRCV_DIO_PORT_SYMBOLIC_NAME or FRTRCV_DIO_CHANNEL_SYMBOLIC_NAME or FRTRCV_DIO_CHANNEL_GROUP_SYMBOLIC_NAME shall reference a Dio configuration. The FR transceiver driver implementation description shall list up this name for the appropriate FR transceiver hardware.
            choice reference FrTrcvDioSymNameRef: set at pre-compile, destination=[DioChannel, DioChannelGroup, DioPort]  # Choice Reference to a DIO Port, DIO Channel or DIO Channel Group. This reference replaces the FRTRCV_DIO_PORT_SYM_NAME, FRTRCV_DIO_CHANNEL_SYM_NAME and FRTRCV_DIO_GROUP_SYM_NAME references in the Fr Trcv SWS.
        container FrTrcvSpiSequence [0..0]  # Container gives FlexRay transceiver driver information about one SPI sequence. One SPI sequence used by FlexRay transceiver driver is in exclusive use for it. No other driver is allowed to access this sequence. FlexRay transceiver driver may use one sequence to access n FlexRay transceiver hardwares chips of the same type or n sequences are used to access one single FlexRay transceiver hardware chip. If a FlexRay transceiver hardware has no SPI interface, there is no instance of this container.
          reference FrTrcvSpiSequenceName: set at pre-compile, destination=SpiSequence  # Reference to a Spi sequence configuration container.
      container FrTrcvBranchIdContainer  # Only one SymbolicNameValue can be defined per container. Therefore this container is necessary.
        integer FrTrcvBranchId: 0..255, set at pre-compile, symbolic-name-value=true, default-value=0  # Unique branch id. It is used by CDDs and internally.
      container FrTrcvChannelDemEventParameterRefs [0..1]  # Container for the references to DemEventParameter elements which shall be invoked using the API Dem_ReportErrorStatus API in case the corresponding error occurs. The EventId is taken from the referenced DemEventParameter's DemEventId value. The standardized errors are provided in the container and can be extended by vendor specific error references.
        symbolic name reference FRTRCV_E_FR_BUSERROR_TRCV [0..1]: set at pre-compile, destination=DemEventParameter  # Reference to configured DEM event to report "Error Status of Class B (SPI) transceiver bus errors where TrcvIdx is the transceiver index"
        symbolic name reference FRTRCV_E_FR_ERRN_TRCV [0..1]: set at pre-compile, destination=DemEventParameter  # Reference to configured DEM event to report "Error Status of Class A (GPIO) transceiver"
    container FrTrcvGeneral  # Container gives FlexRay transceiver driver basic information.
      function name FrTrcvDemReportErrorStatusConfiguration [0..1]: set at pre-compile  # Name of a C function which substitutes Dem_ReportErrorStatus. Parameter not supported!
      boolean FrTrcvDevErrorDetect: set at pre-compile, default-value=true  # Switches development error detection and notification on and off. | If switched on, #define FRTRCV_DEV _ERROR_DETECT ON shall be generated. If switched off, #define FRTRCV_DEV_ERROR _DETECT OFF shall be generated. Define shall be part of file FrTrcv_Cfg.h.
      boolean FrTrcvErrorCheckDuringCommunication: set at pre-compile, default-value=false  # Enable a functionality to check transceiver's state during communication. Parameter not supported!
      boolean FrTrcvErrorCheckInInit: set at pre-compile, default-value=false  # Enable a functionality to check transceiver's state while initialization process of FrTrcv. Parameter not supported!
      boolean FrTrcvGetVersionInfo: set at pre-compile, default-value=true  # Switches version information API on and off. If switched off, function need not be present in compiled code.
      integer FrTrcvIndex: 0..255, set at pre-compile, default-value=0  # Specifies the InstanceId of this module instance. If only one instance is present it shall have the Id 0.
      float FrTrcvMainFunctionCycleTime: 0..1.7976931348623157E+308, set at pre-compile, default-value=0.005  # Cyclic call time for function FrTrcvMainFunction in seconds. A call time of 0ms indicates no calls for this function. In this case function need not be present in compiled code.
      integer FrTrcvRetryCountInInit: 0..255, set at pre-compile, default-value=0  # Specifies the number of retry count when error occurs while initialization process of FrTrcv. Parameter not supported!
      integer FrTrcvWaitCount: 0..4294967295, set at pre-compile, default-value=0  # Wait count for transceiver state changes. Parameter not supported!
      enumeration FrTrcvWakeUpSupport: {FRTRCV_WAKEUP_BY_POLLING, FRTRCV_WAKEUP_NOT_SUPPORTED, FRTRCV_WAKEUP_BY_INTERRUPT}, set at pre-compile, default-value=FRTRCV_WAKEUP_BY_INTERRUPT  # Informs whether wake up is supported by polling or whether it is not supported. | In case no wake up is supported by FlexRay transceiver hardware setting has to be always NO. Only in case wake up is supported by polling main function FlexRayTrcv_main has to be present in source code. In case of support for wake up either by polling wake up ability may be switched on or off for each channel of one FlexRay transceiver channel independently by FrTrcvWakeupByBusUsed.
      string FrTrcvUserConfigFile: set at pre-compile, origin=Vector Informatik
      boolean FrTrcvDemCallback: set at pre-compile, origin=Vector Informatik, default-value=false  # Parameter which activates alternative Dem call-backs.
      boolean FrTrcvSafeBswChecks: set at pre-compile, origin=Vector Informatik, default-value=false  # Selects if safety checks are used. These checks improve robustness as e.g. invalid parameters are checked before function is executed. This attribute has to be enabled for safety projects where this component is mapped to an ASIL partition.
  module config FrTrcv_Pre: definition=FrTrcv, implementation-config-variant=VARIANT-PRE-COMPILE
  module config FrTrcv_Rec: definition=FrTrcv
  module config FrTrcv_Pre_Class1: definition=FrTrcv
    FrTrcvChannel
      FrTrcvAccess
        FrTrcvDioAccess
          STBN (FrTrcvDioChannelAccess): FrTrcvHardwareInterfaceName=STBN
          ERRN (FrTrcvDioChannelAccess): FrTrcvHardwareInterfaceName=ERRN
