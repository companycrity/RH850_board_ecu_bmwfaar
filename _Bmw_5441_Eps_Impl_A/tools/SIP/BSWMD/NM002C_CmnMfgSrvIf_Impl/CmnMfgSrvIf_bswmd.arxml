AUTOSAR XML (schema 4-0-3)
package /Nexteer
  module definition CmnMfgSrvIf [0..1]: variants pre-compile  # Configuration of Nexteer Common Manufacturing Services Interface (to DCM Interface).
