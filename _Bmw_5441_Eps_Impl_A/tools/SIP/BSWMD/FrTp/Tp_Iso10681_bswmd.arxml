AUTOSAR XML (schema 4-0-3)
# COPYRIGHT
# Copyright (c) 2013 by Vector Informatik GmbH. All rights reserved.
# This software is copyright protected and proprietary to Vector Informatik GmbH.
# Vector Informatik GmbH grants to you only those rights as set out in the license conditions.
package /MICROSAR
  module definition FrTp [0..1]: category=VENDOR_SPECIFIC_MODULE_DEFINITION, refined-module-def=FrTp, variants post-build-loadable/pre-compile/link-time/post-build-selectable  # Configuration of the FRTP (FlexRay Transport Protocol) module.
    container FrTpGeneral  # General configuration parameters of the FRTP.
      boolean FrTpAckRt: configuration-class-affection=affection-kind=PC-AFFECTS-LT-AND-PB, set at pre-compile, default-value=false  # This parameter defines if the acknowledgement and retry mechanisms is enabled. RESTRICTIONS: The value of this parameter is irrelevant as the FrTp does not support the feature "Acknowledge and Retry". | True: Acknowledge and Retry is enabled False: Acknowledge and Retry is disabled
      integer FrTpChanNum: 1..32, configuration-class-affection=affection-kind=PC-AFFECTS-LT-AND-PB, set at pre-compile, default-value=1  # This value specifies the number of concurrent channels the module supports.
      boolean FrTpChangeParamApi: configuration-class-affection=affection-kind=PC-AFFECTS-LT-AND-PB, set at pre-compile, default-value=false  # This parameter defines if the API to change FrTp communication parameters is enabled. RESTRICTIONS: The value of this parameter is irrelevant as the API FrTp_ChangeParameter is "always on" and cannot be turned off. | parameters. True: ChangeParameter API is enabled False: ChangeParameter API is disabled.
      boolean FrTpDevErrorDetect: configuration-class-affection=affection-kind=PC-AFFECTS-LT-AND-PB, set at pre-compile, default-value=true  # This parameter switches the Development Error Detection and Notification ON or OFF. true: Development error detection is enabled. false: Development error detection is disabled. | True: Development Error Detection is enabled False: Development Error Detection is disabled
      boolean FrTpFullDuplexEnable: set at pre-compile, default-value=true  # This parameter defines if the full duplex mechanisms for all channels is enabled. RESTRICTIONS: The value of this parameter is irrelevant as the FrTp is always full-duplex-capable. | True: Full duplex is enabled False: Fullduplex is disabled (Half duplex is enabled)
      float FrTpMainFuncCycle: 0.., set at pre-compile, default-value=0.005  # This value specifies the calling period of the TPs Main Function.
      boolean FrTpTransmitCancellation: set at pre-compile, default-value=false  # This parameter defines if Transmit Cancellation is enabled. | True: Transmit Cancellation is enabled False: Transmit Cancellation is disabled
      boolean FrTpUnknownMsgLength: configuration-class-affection=affection-kind=NO-AFFECT, set at pre-compile, default-value=false  # This parameter defines if data transfer with unknown message length is supported. RESTRICTIONS: This feature controlled by this parameter is not supported by the current implementation. | True: Transmission with unknown message length is enabled False: Transmission with unknown message length is disabled
      boolean FrTpVersionInfoApi: configuration-class-affection=affection-kind=PC-AFFECTS-LT-AND-PB, set at pre-compile, default-value=false  # This parameter enables/disables the function FrTp_GetVersionInfo() to get major, minor and patch version information. | True: Version Info API is enabled False: Version Info API is disabled
      string FrTpUserConfigFile [0..1]: configuration-class-affection=affection-kind=PC-AFFECTS-LT-AND-PB, set at pre-compile, origin=Vector Informatik  # Reference to an external text file that will be included into FrTp_Cfg.h during generation. The content of the user configuration file will be added at the end of the generated module configuration file and allows altering or extending the generated code. Caution: User configuration files can cause the software module to malfunction and must only be used with great care!
      boolean FrTpRxIndEarlierThanTxConf: configuration-class-affection=affection-kind=PC-AFFECTS-PB, set at pre-compile, origin=Vector Informatik, default-value=false  # This parameter defines if a) the tx-statemachines tolerate FC pdus received earlier than the tx-confirmation of STF or CF pdus and b) the rx-statemachines tolerate CF pdus received earlier than the tx-confirmation of FC pdus. RESTRICTIONS: None
      integer FrTpInstanceId: 0..255, configuration-class-affection=affection-kind=PC-AFFECTS-LT-AND-PB, set at pre-compile in variant pre-compile+link-time+post-build-selectable / post-build in variant post-build-loadable, origin=Vector Informatik, default-value=0  # This value specifies the Instance-ID of this module to be used for calls to the AUTOSAR DET / DEM. RESTRICTIONS: None
      boolean FrTpMultiPurposeTp: configuration-class-affection=affection-kind=PC-AFFECTS-LT-AND-PB, set at pre-compile, origin=Vector Informatik, default-value=false  # This option enables the possibility to assign one out of 3 Pdu-Owners to each of the connections as sender or receiver of data (i.e. other than PduR). NOTE: This functionality can be used to let a SW-unit use the FrTp independent of the Autosar CDD-concept. RESTRICTIONS: In case one of the owners shall not be used, all fields of that owner have to be left emptied in order to not have the header and callback prototypes in the generated data.
      integer FrTpRxChanNum: 1..254, configuration-class-affection=affection-kind=PC-AFFECTS-LT-AND-PB, set at pre-compile in variant pre-compile+link-time+post-build-selectable / link in variant post-build-loadable, origin=Vector Informatik, default-value=2  # This value specifies the number of FrTp-Rx-channels which is equivalent to the number of active connections in Rx-mode at the same time.
      integer FrTpTxChanNum: 1..254, configuration-class-affection=affection-kind=PC-AFFECTS-LT-AND-PB, set at pre-compile in variant pre-compile+link-time+post-build-selectable / link in variant post-build-loadable, origin=Vector Informatik, default-value=1  # This value specifies the number of FrTp-Tx-channels which is equivalent to the number of active connections in Tx-mode at the same time.
      boolean FrTpRuntimeMeasurementSupport: set at pre-compile, origin=Vector Informatik, default-value=false  # This parameter defines if AMD Runtime Measurement (RTM) is enabled for this module.
      boolean FrTpReceiveCancellation: set at pre-compile, default-value=false  # This parameter defines if Receive Cancellation is enabled. RESTRICTIONS: None | True: Receive Cancellation is enabled False: Receive Cancellation is disabled
      boolean FrTpSafeBswChecks: set at pre-compile, default-value=false  # Selects whether safety checks are used. These checks improve robustness as e.g. invalid parameter values are detected before a function is executed. This attribute has to be enabled for safety projects where this component is mapped to an ASIL partition.
    container FrTpMultipleConfig  # This container includes one or several multiple configuration sets.
      container FrTpConnection [1..254]: post-build-changeable=true  # This container contains the connection specific parameters to transfer N-PDUs via FlexRay TP.
        boolean FrTpBandwidthLimitation [0..1]: set at link in variant link-time / post-build in variant post-build-loadable+post-build-selectable / pre-compile in variant pre-compile, default-value=false  # This parameter defines whether the connection requires a bandwidth limitation or not. If (FrTpBandwidthLimitation == true) the sender shall send a StartFrame always on the first PDU of a PDU-Pool.
        integer FrTpLa: 0..65535, set at link in variant link-time / post-build in variant post-build-loadable+post-build-selectable / pre-compile in variant pre-compile, default-value=0  # This parameter specifies the Local Address for the respective connection. When the local instance is the sender, this is the Source Address within the TP frame. When the local instance is the receiver, this is the Target Address within the TP frame.
        boolean FrTpMultipleReceiverCon: set at link in variant link-time / post-build in variant post-build-loadable+post-build-selectable / pre-compile in variant pre-compile, default-value=false  # This parameter defines, whether this connection is an 1:1 ('false') or an 1:n ('true') connection. If data segmentation is required this parameter is used to check whether segmentation is possible or not. If the connection is 1:n segmentation is not possible and an error will occur.
        integer FrTpRa: 0..65535, set at link in variant link-time / post-build in variant post-build-loadable+post-build-selectable / pre-compile in variant pre-compile, default-value=0  # This value specifies the Remote Address for the respective connection. When the local instance is the sender, this is the Target Address within the TP frame. When the local instance is the receiver, this is the Source Address within the TP frame.
        reference FrTpConCtrlRef: set at pre-compile in variant link-time+pre-compile / post-build in variant post-build-loadable+post-build-selectable, destination=FrTpConnectionControl  # Reference to a Connection Control within this module. | This parameter defines a reference to a connection control container.
        reference FrTpRxPduPoolRef [0..1]: set at pre-compile in variant link-time+pre-compile / post-build in variant post-build-loadable+post-build-selectable, destination=FrTpRxPduPool  # Reference to a RxPduPool within this module.
        reference FrTpTxPduPoolRef [0..1]: set at pre-compile in variant link-time+pre-compile / post-build in variant post-build-loadable+post-build-selectable, destination=FrTpTxPduPool  # Reference to a TxPduPool within this module.
        container FrTpRxSdu [0..1]  # This container includes the Rx Service Data Unit Identifier (Sdu Id) which uniquely identifies a data transfer (inter-module communication) between FrTp and PDUR.
          integer FrTpRxSduId: 0..65535, set at pre-compile in variant link-time+pre-compile / post-build in variant post-build-loadable+post-build-selectable, symbolic-name-value=true, default-value=0  # This value specifies the identifier which is used for change parameter request or receive cancellation from PduR to FrTp. | ImplementationType: PduIdType
          reference FrTpRxSduRef: set at pre-compile in variant link-time+pre-compile / post-build in variant post-build-loadable+post-build-selectable, destination=Pdu  # Reference to a PDU in the global PDU collection.
        container FrTpTxSdu [0..1]  # This container includes the Tx Service Data Unit Identifier (Sdu Id) which uniquely identifies a data transfer (inter-module communication) between FrTp and PDUR.
          integer FrTpTxSduId: 0..254, set at pre-compile, symbolic-name-value=true, default-value=0  # This value specifies the identifier for the transmitt message request from the PduR to the FrTp. | ImplementationType: PduIdType
          reference FrTpTxSduRef: set at pre-compile, destination=Pdu  # Reference to a PDU in the global PDU collection.
      container FrTpConnectionControl [1..254]: post-build-changeable=true  # This container includes the configuration parameters to control a FlexRay TP connection.
        enumeration FrTpAckType: {FRTP_ACK_WITH_RT, FRTP_NO}, configuration-class-affection=affection-kind=PC-AFFECTS-PB, set at pre-compile in variant link-time+pre-compile / post-build in variant post-build-loadable+post-build-selectable, default-value=FRTP_NO  # This parameter defines the type of acknowledgement which is used for the specific channel. RESTRICTIONS: The value of this parameter is irrelevant as the FrTp does not support the feature "Acknowledge and Retry".
        integer FrTpMaxAr: 0..255, configuration-class-affection=affection-kind=PC-AFFECTS-PB, set at pre-compile in variant link-time+pre-compile / post-build in variant post-build-loadable+post-build-selectable, default-value=0  # This value specifies the maximum number of trying to send a frame before a TIMEOUT AR occurs. RESTRICTIONS: This parameter is not used by the FrIsoTp. In the equations used by validators of FrTpConnectionControl-structures a factor '1' is used to multiply the related TimeoutA-value.
        integer FrTpMaxAs: 0..255, configuration-class-affection=affection-kind=PC-AFFECTS-PB, set at pre-compile in variant link-time+pre-compile / post-build in variant post-build-loadable+post-build-selectable, default-value=0  # This value specifies the maximum number of trying to send a frame before a TIMEOUT AS occurs. RESTRICTIONS: This parameter is not used by the FrIsoTp. In the equations used by validators of FrTpConnectionControl-structures a factor '1' is used to multiply the related TimeoutA-value.
        integer FrTpMaxBufferSize: 0..65535, configuration-class-affection=affection-kind=PC-AFFECTS-PB, set at pre-compile in variant link-time+pre-compile / post-build in variant post-build-loadable+post-build-selectable, default-value=65535  # This value specifies the maximal buffer size the FrTp can choose in order to limit the amount of Tx buffer that will be requested at the sender side in a segmented transfer.
        integer FrTpMaxFCWait: 0..255, configuration-class-affection=affection-kind=PC-AFFECTS-PB, set at pre-compile in variant link-time+pre-compile / post-build in variant post-build-loadable+post-build-selectable, default-value=19  # This value specifies the maximum number of FlowControl N-PDUs with FlowState "WAIT".
        integer FrTpMaxFrIf: 0..255, configuration-class-affection=affection-kind=PC-AFFECTS-PB, set at pre-compile in variant link-time+pre-compile / post-build in variant post-build-loadable+post-build-selectable, default-value=0  # This value specifies the maximum number of trying to send a frame when the FrIf returns an error. RESTRICTIONS: The value of this parameter is irrelevant as the FrTp does not support the repetition of failing FrIf_Transmit-calls or the repetition of FrIf_Transmit after timeouts of FrTp_TxConfirmation.
        integer FrTpMaxNbrOfNPduPerCycle: 0..31, configuration-class-affection=affection-kind=PC-AFFECTS-PB, set at pre-compile in variant link-time+pre-compile / post-build in variant post-build-loadable+post-build-selectable, default-value=0  # This value specifies the number of N-Pdus the sender is allowed to transmit within a FlexRay cycle. It is part of the ISO 10681-2 protocol's FlowControl parameter "Bandwidth Control (BC)".
        integer FrTpMaxRn: 0..255, configuration-class-affection=affection-kind=PC-AFFECTS-PB, set at pre-compile in variant link-time+pre-compile / post-build in variant post-build-loadable+post-build-selectable, default-value=5  # This value specifies the maximum number of retries (if retry is configured). RESTRICTIONS: The value of this parameter is irrelevant as the FrTp does not support the feature "Acknowledge and Retry".
        integer FrTpSCexp: 0..7, configuration-class-affection=affection-kind=PC-AFFECTS-PB, set at pre-compile in variant link-time+pre-compile / post-build in variant post-build-loadable+post-build-selectable, default-value=0  # This parameter is part of the ISO 10681-2 protocol's FlowControl parameter "Bandwidth Control (BC)". This value specifies the exponent to calculate the minimum number of "Separation Cycles" the sender has to wait for the next transmission of an FrTp N-Pdu.
        float FrTpTimeBr: 0..0.255, configuration-class-affection=affection-kind=PC-AFFECTS-PB, set at pre-compile in variant link-time+pre-compile / post-build in variant post-build-loadable+post-build-selectable, default-value=0.05  # This value specifies the time the FrTp requires to transmit a corresponding FlowControl Frame. According to ISO 10681-2 this parameter is a performance requirement. RESTRICTIONS: In this implementation this is the time the FrIsoTp asks the PduR for rx-buffer.
        float FrTpTimeBuffer: 0..65.535, configuration-class-affection=affection-kind=PC-AFFECTS-PB, set at pre-compile in variant link-time+pre-compile / post-build in variant post-build-loadable+post-build-selectable, default-value=0.02  # This value specifies the of waiting for the next try to get a Tx or Rx buffer. RESTRICTIONS: This parameter is not used by the FrIsoTp. It is a legacy parameter. Please use Time Br and Time Cs to specify the duration of buffer-requests.
        float FrTpTimeFrIf: 0..0.255, configuration-class-affection=affection-kind=PC-AFFECTS-PB, set at pre-compile in variant link-time+pre-compile / post-build in variant post-build-loadable+post-build-selectable, default-value=0.02  # This value specifies the time of waiting for the next try (if retry is activated) to send via FrIf_Transmit. RESTRICTIONS: The value of this parameter is irrelevant as the FrTp does not support the repetition of failing FrIf_Transmit()-calls or the repetition of FrIf_Transmit() after timeouts of FrTp_TxConfirmation().
        float FrTpTimeoutAr: 0..65.535, configuration-class-affection=affection-kind=PC-AFFECTS-PB, set at pre-compile in variant link-time+pre-compile / post-build in variant post-build-loadable+post-build-selectable, default-value=0.15  # This value specifies the timeout between the PDU transmit request of the Transport Layer to the FlexRay Interface and the corresponding confirmation of the FlexRay Interface on the receiver side (for FC or AF).
        float FrTpTimeoutAs: 0..65.535, configuration-class-affection=affection-kind=PC-AFFECTS-PB, set at pre-compile in variant link-time+pre-compile / post-build in variant post-build-loadable+post-build-selectable, default-value=0.15  # This value specifies the timeout the FrIf shall confirm a transmitted Pdu to the FrTp.
        float FrTpTimeoutBs: 0..65.535, configuration-class-affection=affection-kind=PC-AFFECTS-PB, set at pre-compile in variant link-time+pre-compile / post-build in variant post-build-loadable+post-build-selectable, default-value=0.5  # This value specifies the timeout for waiting for an FC or AF on the sender side in a 1:1 connection.
        float FrTpTimeoutCr: 0..65.535, configuration-class-affection=affection-kind=PC-AFFECTS-PB, set at pre-compile in variant link-time+pre-compile / post-build in variant post-build-loadable+post-build-selectable, default-value=0.6  # This value specifies the timeout value a receiver is waiting for a CF or a LF.
        float FrTpTimeCs: 0..65535, configuration-class-affection=affection-kind=PC-AFFECTS-PB, set at pre-compile in variant link-time+pre-compile / post-build in variant post-build-loadable+post-build-selectable, default-value=0.05  # This value specifies the time the FrTp has to wait until the next possible Consecutive Frame or Last Frame could be send. According to ISO 10681-2 this parameter is a performance requirement. NOTE: In this implementation this is the time the FrIsoTp asks the PduR for tx-data.
        float FrTpTimeoutCs [0..1]: 0..65535, configuration-class-affection=affection-kind=PC-AFFECTS-PB, set at pre-compile in variant link-time+pre-compile / post-build in variant post-build-loadable+post-build-selectable, default-value=0.16  # This value specifies the timeout value a receiver is waiting for a CF or a LF. RESTRICTIONS: This parameter is equivalent to TimeCs + TimeoutAs. Its introduction in SWS FrIsoTp 4.2.1 is an error. Please adjust TimeCs and TimeoutAs in a suitble way to achieve the desired FrTp_TimeoutCs behavior!
        float FrTpTimeoutBr [0..1]: 0..65535, configuration-class-affection=affection-kind=PC-AFFECTS-PB, set at pre-compile, default-value=0.16  # This value specifies the timeout value a receiver is waiting for a CF or a LF. RESTRICTIONS: This parameter is equivalent to TimeBs + TimeoutAr. Its introduction in SWS FrIsoTp 4.2.1 is an error. Please adjust TimeBr and TimeoutAr in a suitble way to achieve the desired FrTp_TimeoutBr behavior!
      container FrTpRxPduPool [0..254]: post-build-changeable=true  # This container contains all Pdus that are assigned to that Pdu Pool.
        container FrTpRxPdu [1..254]  # This container includes the PDU parameters. | ImplementationType: PduInfoType
          integer FrTpRxPduId: 0..65535, set at link in variant link-time / post-build in variant post-build-loadable+post-build-selectable / pre-compile in variant pre-compile, symbolic-name-value=true, default-value=0  # This value specifies a unique identifier for a received message which is forwarded from the FrIf to the FrTp. | ImplementationType: PduIdType
          reference FrTpRxPduRef: set at pre-compile in variant link-time+pre-compile / post-build in variant post-build-loadable+post-build-selectable, destination=Pdu  # Reference to a PDU in the global PDU collection.
      container FrTpTxPduPool [0..254]: post-build-changeable=true  # This container contains all Pdus that are assigned to that Pdu Pool.
        container FrTpTxPdu [1..254]  # This container includes the PDU parameters. | ImplementationType: PduInfoType
          integer FrTpTxConfirmationPduId: 0..65535, configuration-class-affection=affection-kind=NO-AFFECT, set at pre-compile, symbolic-name-value=true, default-value=0  # This value specifies the handle Id to be used by the FrIf to confirm the transmission of the FrTpTxPdu to the FrTp module.
          reference FrTpTxPduRef: set at pre-compile in variant link-time+pre-compile / post-build in variant post-build-loadable+post-build-selectable, destination=Pdu  # Reference to a PDU in the global PDU structure.
  bsw implementation FrTp_Impl: programming-language=C, sw-version=2.04.03, used-code-generator=cMSR, vendor-id=30, ar-release-version=4.00.03, behavior=FrTpBehavior, preconfigured-configuration=FrTp_Pre, recommended-configuration=FrTp_Rec, vendor-specific-module-def=FrTp
  module config FrTp_Pre: definition=FrTp
  module config FrTp_Rec: definition=FrTp
