AUTOSAR XML (schema 4-3-0)
package /ActiveEcuC
  module config ExcpnHndlg: implementation-config-variant=VARIANT-PRE-COMPILE
    ExcpnHndlgCfg: WdgMCfgStr=WdgMConfig_Mode0_core0
