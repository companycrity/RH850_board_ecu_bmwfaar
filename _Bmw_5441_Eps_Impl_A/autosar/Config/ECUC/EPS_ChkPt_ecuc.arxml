AUTOSAR XML (schema 4-3-0)
package /ActiveEcuC
  module config ChkPt: implementation-config-variant=VARIANT-PRE-COMPILE, module-description=ChkPt_Impl
