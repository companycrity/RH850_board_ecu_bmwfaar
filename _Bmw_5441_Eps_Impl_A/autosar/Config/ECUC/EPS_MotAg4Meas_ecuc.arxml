AUTOSAR XML (schema 4-3-0)
package /ActiveEcuC
  module config MotAg4Meas: implementation-config-variant=VARIANT-PRE-COMPILE
    MotAg4MeasCfg: MotAg4SnsrRlvBitWidthExp=4
