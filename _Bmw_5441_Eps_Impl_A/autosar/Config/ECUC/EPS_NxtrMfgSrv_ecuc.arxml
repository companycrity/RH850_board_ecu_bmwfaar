AUTOSAR XML (schema 4-3-0)
package /ActiveEcuC
  module config NxtrMfgSrv: implementation-config-variant=VARIANT-PRE-COMPILE
    278 x CommonService:
      SrvSessionDflt: ServiceType=Session - 0x10, RequestLength=0, ResponseLength=4, SubFunction=1, Enabled=false, Application=Appl10
        AccessControls: NexteerSession=false, SecurityAccess=false
      SrvSessionNxtr: ServiceType=Session - 0x10, RequestLength=0, ResponseLength=4, SubFunction=126, Enabled=false, Application=Appl10
        AccessControls: NexteerSession=false, SecurityAccess=false
      SrvRstSoft: ServiceType=Reset - 0x11, RequestLength=0, ResponseLength=0, SubFunction=96, Enabled=false, Application=Appl10
        AccessControls: NexteerSession=false, SecurityAccess=true
      SrvRstHard: ServiceType=Reset - 0x11, RequestLength=0, ResponseLength=0, SubFunction=97, Enabled=false, Application=Appl10
        AccessControls: NexteerSession=false, SecurityAccess=true
      SrvSecuSeed: ServiceType=Security - 0x27, RequestLength=0, ResponseLength=4, SubFunction=97, Enabled=false, Application=Appl10
        AccessControls: NexteerSession=false, SecurityAccess=false
      SrvSecuKey: ServiceType=Security - 0x27, RequestLength=4, ResponseLength=0, SubFunction=98, Enabled=false, Application=Appl10
        AccessControls: NexteerSession=false, SecurityAccess=false
      SrvTesterPresent_Send: ServiceType=TesterPresent - 0x3E, RequestLength=0, ResponseLength=0, SubFunction=0, Enabled=false, Application=Appl10
        AccessControls: NexteerSession=false, SecurityAccess=false
      SrvF194Rd: ServiceType=Read - 0x22, RequestLength=0, ResponseLength=16, ServiceId=61844, Enabled=true, Application=Appl10
        AccessControls: NexteerSession=false, SecurityAccess=false
      SrvF195Rd: ServiceType=Read - 0x22, RequestLength=0, ResponseLength=16, ServiceId=61845, Enabled=true, Application=Appl10
        AccessControls: NexteerSession=false, SecurityAccess=false
      SrvF1F0Rd: ServiceType=Read - 0x22, RequestLength=0, ResponseLength=16, ServiceId=61936, Enabled=false, Application=Appl10
        AccessControls: NexteerSession=false, SecurityAccess=false
      SrvF1F1Rd: ServiceType=Read - 0x22, RequestLength=0, ResponseLength=16, ServiceId=61937, Enabled=false, Application=Appl10
        AccessControls: NexteerSession=false, SecurityAccess=false
      SrvF1F2Rd: ServiceType=Read - 0x22, RequestLength=0, ResponseLength=5, ServiceId=61938, Enabled=true, Application=Appl10
        AccessControls: NexteerSession=false, SecurityAccess=false
      SrvF1F3Rd: ServiceType=Read - 0x22, RequestLength=0, ResponseLength=5, ServiceId=61939, Enabled=true, Application=Appl10
        AccessControls: NexteerSession=false, SecurityAccess=false
      SrvF1F4Rd: ServiceType=Read - 0x22, RequestLength=0, ResponseLength=5, ServiceId=61940, Enabled=true, Application=Appl10
        AccessControls: NexteerSession=false, SecurityAccess=false
      SrvF1F7Rd: ServiceType=Read - 0x22, RequestLength=0, ResponseLength=59, ServiceId=61943, Enabled=true, Application=Appl10
        AccessControls: NexteerSession=false, SecurityAccess=false
      SrvF1F8Rd: ServiceType=Read - 0x22, RequestLength=0, ResponseLength=59, ServiceId=61944, Enabled=true, Application=Appl10
        AccessControls: NexteerSession=false, SecurityAccess=false
      SrvF1F9Rd: ServiceType=Read - 0x22, RequestLength=0, ResponseLength=59, ServiceId=61945, Enabled=true, Application=Appl10
        AccessControls: NexteerSession=false, SecurityAccess=false
      SrvF1FDRd: ServiceType=Read - 0x22, RequestLength=0, ResponseLength=9, ServiceId=61949, Enabled=true, Application=Appl10
        AccessControls: NexteerSession=false, SecurityAccess=false
      SrvF1FERd: ServiceType=Read - 0x22, RequestLength=0, ResponseLength=5, ServiceId=61950, Enabled=true, Application=Appl10
        AccessControls: NexteerSession=false, SecurityAccess=false
      SrvF1FFRd: ServiceType=Read - 0x22, RequestLength=0, ResponseLength=20, ServiceId=61951, Enabled=true, Application=Appl10
        AccessControls: NexteerSession=false, SecurityAccess=false
      SrvFD00Rd: ServiceType=Read - 0x22, RequestLength=0, ResponseLength=1, ServiceId=64768, Enabled=true, Application=Appl10
        AccessControls: NexteerSession=false, SecurityAccess=false
      SrvFD01Rd: ServiceType=Read - 0x22, RequestLength=0, ResponseLength=4, ServiceId=64769, Enabled=true, Application=Appl10
        AccessControls: NexteerSession=false, SecurityAccess=false
      SrvFD02Rd: ServiceType=Read - 0x22, RequestLength=0, ResponseLength=1, ServiceId=64770, Enabled=true, Application=Appl10
        AccessControls: NexteerSession=false, SecurityAccess=false
      SrvFD02Wr: ServiceType=Write - 0x2E, RequestLength=1, ResponseLength=0, ServiceId=64770, Enabled=true, Application=Appl10
        AccessControls: NexteerSession=false, SecurityAccess=true
      SrvFD03Rd: ServiceType=Read - 0x22, RequestLength=0, ResponseLength=4, ServiceId=64771, Enabled=true, Application=Appl10
        AccessControls: NexteerSession=false, SecurityAccess=false
      SrvFD03Wr: ServiceType=Write - 0x2E, RequestLength=4, ResponseLength=0, ServiceId=64771, Enabled=true, Application=Appl10
        AccessControls: NexteerSession=false, SecurityAccess=true
      SrvFD05Rd: ServiceType=Read - 0x22, RequestLength=0, ResponseLength=8, ServiceId=64773, Enabled=true, Application=Appl10
        AccessControls: NexteerSession=false, SecurityAccess=false
      SrvFD05Wr: ServiceType=Write - 0x2E, RequestLength=8, ResponseLength=0, ServiceId=64773, Enabled=true, Application=Appl10
        AccessControls: NexteerSession=false, SecurityAccess=true
      SrvFD06Rd: ServiceType=Read - 0x22, RequestLength=0, ResponseLength=1, ServiceId=64774, Enabled=true, Application=Appl10
        AccessControls: NexteerSession=false, SecurityAccess=false
      SrvFD30Rd: ServiceType=Read - 0x22, RequestLength=0, ResponseLength=20, ServiceId=64816, Enabled=true, Application=Appl10
        AccessControls: NexteerSession=false, SecurityAccess=false
      SrvFD30Wr: ServiceType=Write - 0x2E, RequestLength=20, ResponseLength=0, ServiceId=64816, Enabled=true, Application=Appl10
        AccessControls: NexteerSession=false, SecurityAccess=true
      SrvFD31Rd: ServiceType=Read - 0x22, RequestLength=0, ResponseLength=20, ServiceId=64817, Enabled=true, Application=Appl10
        AccessControls: NexteerSession=false, SecurityAccess=false
      SrvFD31Wr: ServiceType=Write - 0x2E, RequestLength=20, ResponseLength=0, ServiceId=64817, Enabled=true, Application=Appl10
        AccessControls: NexteerSession=false, SecurityAccess=true
      SrvFD32Rd: ServiceType=Read - 0x22, RequestLength=0, ResponseLength=20, ServiceId=64818, Enabled=true, Application=Appl10
        AccessControls: NexteerSession=false, SecurityAccess=false
      SrvFD32Wr: ServiceType=Write - 0x2E, RequestLength=20, ResponseLength=0, ServiceId=64818, Enabled=true, Application=Appl10
        AccessControls: NexteerSession=false, SecurityAccess=true
      SrvFD38Rd: ServiceType=Read - 0x22, RequestLength=0, ResponseLength=16, ServiceId=64824, Enabled=true, Application=Appl10
        AccessControls: NexteerSession=false, SecurityAccess=false
      SrvFD38Wr: ServiceType=Write - 0x2E, RequestLength=16, ResponseLength=0, ServiceId=64824, Enabled=true, Application=Appl10
        AccessControls: NexteerSession=false, SecurityAccess=true
      SrvFD39Rd: ServiceType=Read - 0x22, RequestLength=0, ResponseLength=16, ServiceId=64825, Enabled=true, Application=Appl10
        AccessControls: NexteerSession=false, SecurityAccess=false
      SrvFD39Wr: ServiceType=Write - 0x2E, RequestLength=16, ResponseLength=0, ServiceId=64825, Enabled=true, Application=Appl10
        AccessControls: NexteerSession=false, SecurityAccess=true
      SrvFD3ARd: ServiceType=Read - 0x22, RequestLength=0, ResponseLength=16, ServiceId=64826, Enabled=true, Application=Appl10
        AccessControls: NexteerSession=false, SecurityAccess=false
      SrvFD3AWr: ServiceType=Write - 0x2E, RequestLength=16, ResponseLength=0, ServiceId=64826, Enabled=true, Application=Appl10
        AccessControls: NexteerSession=false, SecurityAccess=true
      SrvFD3BRd: ServiceType=Read - 0x22, RequestLength=0, ResponseLength=16, ServiceId=64827, Enabled=true, Application=Appl10
        AccessControls: NexteerSession=false, SecurityAccess=false
      SrvFD3BWr: ServiceType=Write - 0x2E, RequestLength=16, ResponseLength=0, ServiceId=64827, Enabled=true, Application=Appl10
        AccessControls: NexteerSession=false, SecurityAccess=true
      SrvFD3CRd: ServiceType=Read - 0x22, RequestLength=0, ResponseLength=16, ServiceId=64828, Enabled=true, Application=Appl10
        AccessControls: NexteerSession=false, SecurityAccess=false
      SrvFD3CWr: ServiceType=Write - 0x2E, RequestLength=16, ResponseLength=0, ServiceId=64828, Enabled=true, Application=Appl10
        AccessControls: NexteerSession=false, SecurityAccess=true
      SrvFD60Rd: ServiceType=Read - 0x22, RequestLength=0, ResponseLength=100, ServiceId=64864, Enabled=true, Application=Appl10
        AccessControls: NexteerSession=false, SecurityAccess=false
      SrvFD61Rd: ServiceType=Read - 0x22, RequestLength=0, ResponseLength=176, ServiceId=64865, Enabled=false, Application=Appl10
        AccessControls: NexteerSession=false, SecurityAccess=false
      SrvFD88Rd: ServiceType=Read - 0x22, RequestLength=0, ResponseLength=4, ServiceId=64904, Enabled=false, Application=Appl10
        AccessControls: NexteerSession=false, SecurityAccess=false
      SrvFD88Wr: ServiceType=Write - 0x2E, RequestLength=4, ResponseLength=0, ServiceId=64904, Enabled=false, Application=Appl10
        AccessControls: NexteerSession=false, SecurityAccess=true
      SrvFD89Rd: ServiceType=Read - 0x22, RequestLength=0, ResponseLength=4, ServiceId=64905, Enabled=false, Application=Appl10
        AccessControls: NexteerSession=false, SecurityAccess=false
      SrvFD89Wr: ServiceType=Write - 0x2E, RequestLength=4, ResponseLength=0, ServiceId=64905, Enabled=false, Application=Appl10
        AccessControls: NexteerSession=false, SecurityAccess=true
      SrvFD8CRd: ServiceType=Read - 0x22, RequestLength=0, ResponseLength=1, ServiceId=64908, Enabled=false, Application=Appl10
        AccessControls: NexteerSession=false, SecurityAccess=false
      SrvFD8DRd: ServiceType=Read - 0x22, RequestLength=0, ResponseLength=1, ServiceId=64909, Enabled=false, Application=Appl10
        AccessControls: NexteerSession=false, SecurityAccess=false
      SrvFDB0Rd: ServiceType=Read - 0x22, RequestLength=0, ResponseLength=4, ServiceId=64944, Enabled=false, Application=Appl10
        AccessControls: NexteerSession=false, SecurityAccess=false
      SrvFDB0Wr: ServiceType=Write - 0x2E, RequestLength=4, ResponseLength=0, ServiceId=64944, Enabled=false, Application=Appl10
        AccessControls: NexteerSession=false, SecurityAccess=true
      SrvFDB1Rd: ServiceType=Read - 0x22, RequestLength=0, ResponseLength=4, ServiceId=64945, Enabled=false, Application=Appl10
        AccessControls: NexteerSession=false, SecurityAccess=false
      SrvFDB1Wr: ServiceType=Write - 0x2E, RequestLength=4, ResponseLength=0, ServiceId=64945, Enabled=false, Application=Appl10
        AccessControls: NexteerSession=false, SecurityAccess=true
      SrvFDB2Rd: ServiceType=Read - 0x22, RequestLength=0, ResponseLength=4, ServiceId=64946, Enabled=false, Application=Appl10
        AccessControls: NexteerSession=false, SecurityAccess=false
      SrvFDB2Wr: ServiceType=Write - 0x2E, RequestLength=4, ResponseLength=0, ServiceId=64946, Enabled=false, Application=Appl10
        AccessControls: NexteerSession=false, SecurityAccess=true
      SrvFDB3Rd: ServiceType=Read - 0x22, RequestLength=0, ResponseLength=4, ServiceId=64947, Enabled=false, Application=Appl10
        AccessControls: NexteerSession=false, SecurityAccess=false
      SrvFDB3Wr: ServiceType=Write - 0x2E, RequestLength=4, ResponseLength=0, ServiceId=64947, Enabled=false, Application=Appl10
        AccessControls: NexteerSession=false, SecurityAccess=true
      SrvFDB4Rd: ServiceType=Read - 0x22, RequestLength=0, ResponseLength=4, ServiceId=64948, Enabled=true, Application=Appl10
        AccessControls: NexteerSession=false, SecurityAccess=false
      SrvFDB4Wr: ServiceType=Write - 0x2E, RequestLength=4, ResponseLength=0, ServiceId=64948, Enabled=true, Application=Appl10
        AccessControls: NexteerSession=false, SecurityAccess=true
      SrvFDB5Rd: ServiceType=Read - 0x22, RequestLength=0, ResponseLength=4, ServiceId=64949, Enabled=true, Application=Appl10
        AccessControls: NexteerSession=false, SecurityAccess=false
      SrvFDB5Wr: ServiceType=Write - 0x2E, RequestLength=4, ResponseLength=0, ServiceId=64949, Enabled=true, Application=Appl10
        AccessControls: NexteerSession=false, SecurityAccess=true
      SrvFDB6Rd: ServiceType=Read - 0x22, RequestLength=0, ResponseLength=4, ServiceId=64950, Enabled=true, Application=Appl10
        AccessControls: NexteerSession=false, SecurityAccess=false
      SrvFDB6Wr: ServiceType=Write - 0x2E, RequestLength=4, ResponseLength=0, ServiceId=64950, Enabled=true, Application=Appl10
        AccessControls: NexteerSession=false, SecurityAccess=true
      SrvFDB7Rd: ServiceType=Read - 0x22, RequestLength=0, ResponseLength=4, ServiceId=64951, Enabled=true, Application=Appl10
        AccessControls: NexteerSession=false, SecurityAccess=false
      SrvFDB7Wr: ServiceType=Write - 0x2E, RequestLength=4, ResponseLength=0, ServiceId=64951, Enabled=true, Application=Appl10
        AccessControls: NexteerSession=false, SecurityAccess=true
      SrvFDB8Rd: ServiceType=Read - 0x22, RequestLength=0, ResponseLength=1, ServiceId=64952, Enabled=false, Application=Appl10
        AccessControls: NexteerSession=false, SecurityAccess=false
      SrvFDB9Rd: ServiceType=Read - 0x22, RequestLength=0, ResponseLength=1, ServiceId=64953, Enabled=false, Application=Appl10
        AccessControls: NexteerSession=false, SecurityAccess=false
      SrvFDBARd: ServiceType=Read - 0x22, RequestLength=0, ResponseLength=1, ServiceId=64954, Enabled=false, Application=Appl10
        AccessControls: NexteerSession=false, SecurityAccess=false
      SrvFDBBRd: ServiceType=Read - 0x22, RequestLength=0, ResponseLength=1, ServiceId=64955, Enabled=false, Application=Appl10
        AccessControls: NexteerSession=false, SecurityAccess=false
      SrvFDBCRd: ServiceType=Read - 0x22, RequestLength=0, ResponseLength=1, ServiceId=64956, Enabled=true, Application=Appl10
        AccessControls: NexteerSession=false, SecurityAccess=false
      SrvFDBDRd: ServiceType=Read - 0x22, RequestLength=0, ResponseLength=1, ServiceId=64957, Enabled=true, Application=Appl10
        AccessControls: NexteerSession=false, SecurityAccess=false
      SrvFDBERd: ServiceType=Read - 0x22, RequestLength=0, ResponseLength=1, ServiceId=64958, Enabled=true, Application=Appl10
        AccessControls: NexteerSession=false, SecurityAccess=false
      SrvFDBFRd: ServiceType=Read - 0x22, RequestLength=0, ResponseLength=1, ServiceId=64959, Enabled=true, Application=Appl10
        AccessControls: NexteerSession=false, SecurityAccess=false
      SrvFDC0Rd: ServiceType=Read - 0x22, RequestLength=0, ResponseLength=2, ServiceId=64960, Enabled=true, Application=Appl10
        AccessControls: NexteerSession=false, SecurityAccess=false
      SrvFDC0Wr: ServiceType=Write - 0x2E, RequestLength=2, ResponseLength=0, ServiceId=64960, Enabled=true, Application=Appl10
        AccessControls: NexteerSession=false, SecurityAccess=true
      SrvFDC8Rd: ServiceType=Read - 0x22, RequestLength=0, ResponseLength=22, ServiceId=64968, Enabled=false, Application=Appl10
        AccessControls: NexteerSession=false, SecurityAccess=false
      SrvFDC8Wr: ServiceType=Write - 0x2E, RequestLength=22, ResponseLength=0, ServiceId=64968, Enabled=false, Application=Appl10
        AccessControls: NexteerSession=false, SecurityAccess=true
      SrvFDD1Rd: ServiceType=Read - 0x22, RequestLength=0, ResponseLength=258, ServiceId=64977, Enabled=false, Application=Appl10
        AccessControls: NexteerSession=true, SecurityAccess=false
      SrvFDD1Wr: ServiceType=Write - 0x2E, RequestLength=258, ResponseLength=0, ServiceId=64977, Enabled=false, Application=Appl10
        AccessControls: NexteerSession=false, SecurityAccess=true
      SrvFDD2Rd: ServiceType=Read - 0x22, RequestLength=0, ResponseLength=258, ServiceId=64978, Enabled=false, Application=Appl10
        AccessControls: NexteerSession=false, SecurityAccess=false
      SrvFDD2Wr: ServiceType=Write - 0x2E, RequestLength=258, ResponseLength=0, ServiceId=64978, Enabled=false, Application=Appl10
        AccessControls: NexteerSession=false, SecurityAccess=true
      SrvFDD3Rd: ServiceType=Read - 0x22, RequestLength=0, ResponseLength=258, ServiceId=64979, Enabled=false, Application=Appl10
        AccessControls: NexteerSession=false, SecurityAccess=false
      SrvFDD3Wr: ServiceType=Write - 0x2E, RequestLength=258, ResponseLength=0, ServiceId=64979, Enabled=false, Application=Appl10
        AccessControls: NexteerSession=false, SecurityAccess=true
      SrvFDD4Rd: ServiceType=Read - 0x22, RequestLength=0, ResponseLength=258, ServiceId=64980, Enabled=false, Application=Appl10
        AccessControls: NexteerSession=false, SecurityAccess=false
      SrvFDD4Wr: ServiceType=Write - 0x2E, RequestLength=258, ResponseLength=0, ServiceId=64980, Enabled=false, Application=Appl10
        AccessControls: NexteerSession=false, SecurityAccess=true
      SrvFDD5Rd: ServiceType=Read - 0x22, RequestLength=0, ResponseLength=2, ServiceId=64981, Enabled=false, Application=Appl10
        AccessControls: NexteerSession=false, SecurityAccess=false
      SrvFDD5Wr: ServiceType=Write - 0x2E, RequestLength=2, ResponseLength=0, ServiceId=64981, Enabled=false, Application=Appl10
        AccessControls: NexteerSession=false, SecurityAccess=true
      SrvFDD7Rd: ServiceType=Read - 0x22, RequestLength=0, ResponseLength=106, ServiceId=64983, Enabled=true, Application=Appl10
        AccessControls: NexteerSession=false, SecurityAccess=false
      SrvFDD7Wr: ServiceType=Write - 0x2E, RequestLength=106, ResponseLength=0, ServiceId=64983, Enabled=true, Application=Appl10
        AccessControls: NexteerSession=false, SecurityAccess=true
      SrvFDD9Rd: ServiceType=Read - 0x22, RequestLength=0, ResponseLength=258, ServiceId=64985, Enabled=false, Application=Appl10
        AccessControls: NexteerSession=false, SecurityAccess=false
      SrvFDD9Wr: ServiceType=Write - 0x2E, RequestLength=258, ResponseLength=0, ServiceId=64985, Enabled=false, Application=Appl10
        AccessControls: NexteerSession=false, SecurityAccess=true
      SrvFDDARd: ServiceType=Read - 0x22, RequestLength=0, ResponseLength=258, ServiceId=64986, Enabled=false, Application=Appl10
        AccessControls: NexteerSession=false, SecurityAccess=false
      SrvFDDAWr: ServiceType=Write - 0x2E, RequestLength=258, ResponseLength=0, ServiceId=64986, Enabled=false, Application=Appl10
        AccessControls: NexteerSession=false, SecurityAccess=true
      SrvFDDBRd: ServiceType=Read - 0x22, RequestLength=0, ResponseLength=258, ServiceId=64987, Enabled=false, Application=Appl10
        AccessControls: NexteerSession=false, SecurityAccess=false
      SrvFDDBWr: ServiceType=Write - 0x2E, RequestLength=258, ResponseLength=0, ServiceId=64987, Enabled=false, Application=Appl10
        AccessControls: NexteerSession=false, SecurityAccess=true
      SrvFDDCRd: ServiceType=Read - 0x22, RequestLength=0, ResponseLength=258, ServiceId=64988, Enabled=false, Application=Appl10
        AccessControls: NexteerSession=false, SecurityAccess=false
      SrvFDDCWr: ServiceType=Write - 0x2E, RequestLength=258, ResponseLength=0, ServiceId=64988, Enabled=false, Application=Appl10
        AccessControls: NexteerSession=false, SecurityAccess=true
      SrvFDDDRd: ServiceType=Read - 0x22, RequestLength=0, ResponseLength=2, ServiceId=64989, Enabled=false, Application=Appl10
        AccessControls: NexteerSession=false, SecurityAccess=false
      SrvFDDDWr: ServiceType=Write - 0x2E, RequestLength=2, ResponseLength=0, ServiceId=64989, Enabled=false, Application=Appl10
        AccessControls: NexteerSession=false, SecurityAccess=true
      SrvFDDFRd: ServiceType=Read - 0x22, RequestLength=0, ResponseLength=106, ServiceId=64991, Enabled=true, Application=Appl10
        AccessControls: NexteerSession=false, SecurityAccess=false
      SrvFDDFWr: ServiceType=Write - 0x2E, RequestLength=106, ResponseLength=0, ServiceId=64991, Enabled=true, Application=Appl10
        AccessControls: NexteerSession=false, SecurityAccess=true
      SrvFDF4Rd: ServiceType=Read - 0x22, RequestLength=0, ResponseLength=12, ServiceId=65012, Enabled=false, Application=Appl10
        AccessControls: NexteerSession=false, SecurityAccess=false
      SrvFDF4Wr: ServiceType=Write - 0x2E, RequestLength=12, ResponseLength=0, ServiceId=65012, Enabled=false, Application=Appl10
        AccessControls: NexteerSession=false, SecurityAccess=true
      SrvFDF5Rd: ServiceType=Read - 0x22, RequestLength=0, ResponseLength=28, ServiceId=65013, Enabled=false, Application=Appl10
        AccessControls: NexteerSession=false, SecurityAccess=false
      SrvFDF5Wr: ServiceType=Write - 0x2E, RequestLength=28, ResponseLength=0, ServiceId=65013, Enabled=false, Application=Appl10
        AccessControls: NexteerSession=false, SecurityAccess=true
      SrvFDF8Rd: ServiceType=Read - 0x22, RequestLength=0, ResponseLength=8, ServiceId=65016, Enabled=true, Application=Appl10
        AccessControls: NexteerSession=false, SecurityAccess=false
      SrvFDF8Wr: ServiceType=Write - 0x2E, RequestLength=8, ResponseLength=0, ServiceId=65016, Enabled=true, Application=Appl10
        AccessControls: NexteerSession=false, SecurityAccess=true
      SrvFE00Rd: ServiceType=Read - 0x22, RequestLength=0, ResponseLength=256, ServiceId=65024, Enabled=false, Application=Appl10
        AccessControls: NexteerSession=false, SecurityAccess=false
      SrvFE00Wr: ServiceType=Write - 0x2E, RequestLength=256, ResponseLength=0, ServiceId=65024, Enabled=false, Application=Appl10
        AccessControls: NexteerSession=false, SecurityAccess=true
      SrvFE01Rd: ServiceType=Read - 0x22, RequestLength=0, ResponseLength=256, ServiceId=65025, Enabled=false, Application=Appl10
        AccessControls: NexteerSession=true, SecurityAccess=false
      SrvFE01Wr: ServiceType=Write - 0x2E, RequestLength=256, ResponseLength=0, ServiceId=65025, Enabled=false, Application=Appl10
        AccessControls: NexteerSession=false, SecurityAccess=true
      SrvFE02Rd: ServiceType=Read - 0x22, RequestLength=0, ResponseLength=256, ServiceId=65026, Enabled=false, Application=Appl10
        AccessControls: NexteerSession=false, SecurityAccess=false
      SrvFE02Wr: ServiceType=Write - 0x2E, RequestLength=256, ResponseLength=0, ServiceId=65026, Enabled=false, Application=Appl10
        AccessControls: NexteerSession=false, SecurityAccess=true
      SrvFE03Rd: ServiceType=Read - 0x22, RequestLength=0, ResponseLength=256, ServiceId=65027, Enabled=false, Application=Appl10
        AccessControls: NexteerSession=false, SecurityAccess=false
      SrvFE03Wr: ServiceType=Write - 0x2E, RequestLength=256, ResponseLength=0, ServiceId=65027, Enabled=false, Application=Appl10
        AccessControls: NexteerSession=false, SecurityAccess=true
      SrvFE08Rd: ServiceType=Read - 0x22, RequestLength=0, ResponseLength=18, ServiceId=65032, Enabled=false, Application=Appl10
        AccessControls: NexteerSession=false, SecurityAccess=false
      SrvFE08Wr: ServiceType=Write - 0x2E, RequestLength=18, ResponseLength=0, ServiceId=65032, Enabled=false, Application=Appl10
        AccessControls: NexteerSession=false, SecurityAccess=true
      SrvFE21Rd: ServiceType=Read - 0x22, RequestLength=0, ResponseLength=28, ServiceId=65057, Enabled=true, Application=Appl10
        AccessControls: NexteerSession=false, SecurityAccess=false
      SrvFE21Wr: ServiceType=Write - 0x2E, RequestLength=28, ResponseLength=0, ServiceId=65057, Enabled=true, Application=Appl10
        AccessControls: NexteerSession=false, SecurityAccess=true
      SrvFE81Rd: ServiceType=Read - 0x22, RequestLength=0, ResponseLength=13, ServiceId=65153, Enabled=true, Application=Appl10
        AccessControls: NexteerSession=false, SecurityAccess=false
      SrvFE82Wr: ServiceType=Write - 0x2E, RequestLength=4, ResponseLength=0, ServiceId=65154, Enabled=true, Application=Appl10
        AccessControls: NexteerSession=false, SecurityAccess=true
      SrvFE83Wr: ServiceType=Write - 0x2E, RequestLength=4, ResponseLength=0, ServiceId=65155, Enabled=true, Application=Appl10
        AccessControls: NexteerSession=false, SecurityAccess=true
      SrvFE8ARd: ServiceType=Read - 0x22, RequestLength=0, ResponseLength=7, ServiceId=65162, Enabled=true, Application=Appl7
        AccessControls: NexteerSession=false, SecurityAccess=false
      SrvFE8AWr: ServiceType=Write - 0x2E, RequestLength=7, ResponseLength=0, ServiceId=65162, Enabled=true, Application=Appl10
        AccessControls: NexteerSession=false, SecurityAccess=true
      SrvFE8BRd: ServiceType=Read - 0x22, RequestLength=0, ResponseLength=1, ServiceId=65163, Enabled=true, Application=Appl10
        AccessControls: NexteerSession=false, SecurityAccess=false
      SrvFE8BWr: ServiceType=Write - 0x2E, RequestLength=1, ResponseLength=0, ServiceId=65163, Enabled=true, Application=Appl10
        AccessControls: NexteerSession=false, SecurityAccess=true
      SrvFE8CRd: ServiceType=Read - 0x22, RequestLength=0, ResponseLength=212, ServiceId=65164, Enabled=true, Application=Appl10
        AccessControls: NexteerSession=false, SecurityAccess=false
      SrvFE8CWr: ServiceType=Write - 0x2E, RequestLength=212, ResponseLength=0, ServiceId=65164, Enabled=true, Application=Appl10
        AccessControls: NexteerSession=false, SecurityAccess=true
      SrvFE90Rd: ServiceType=Read - 0x22, RequestLength=0, ResponseLength=4, ServiceId=65168, Enabled=true, Application=Appl10
        AccessControls: NexteerSession=false, SecurityAccess=false
      SrvFE90Wr: ServiceType=Write - 0x2E, RequestLength=4, ResponseLength=0, ServiceId=65168, Enabled=true, Application=Appl10
        AccessControls: NexteerSession=false, SecurityAccess=true
      SrvFE9CRd: ServiceType=Read - 0x22, RequestLength=0, ResponseLength=5, ServiceId=65180, Enabled=false, Application=Appl10
        AccessControls: NexteerSession=false, SecurityAccess=false
      SrvFE9CWr: ServiceType=Write - 0x2E, RequestLength=5, ResponseLength=0, ServiceId=65180, Enabled=false, Application=Appl10
        AccessControls: NexteerSession=false, SecurityAccess=true
      SrvFE9DRd: ServiceType=Read - 0x22, RequestLength=0, ResponseLength=5, ServiceId=65181, Enabled=false, Application=Appl10
        AccessControls: NexteerSession=false, SecurityAccess=false
      SrvFE9DWr: ServiceType=Write - 0x2E, RequestLength=5, ResponseLength=0, ServiceId=65181, Enabled=false, Application=Appl10
        AccessControls: NexteerSession=false, SecurityAccess=true
      SrvFE9ERd: ServiceType=Read - 0x22, RequestLength=0, ResponseLength=5, ServiceId=65182, Enabled=false, Application=Appl10
        AccessControls: NexteerSession=false, SecurityAccess=false
      SrvFE9EWr: ServiceType=Write - 0x2E, RequestLength=5, ResponseLength=0, ServiceId=65182, Enabled=false, Application=Appl10
        AccessControls: NexteerSession=false, SecurityAccess=true
      SrvFEA2Rd: ServiceType=Read - 0x22, RequestLength=0, ResponseLength=5, ServiceId=65186, Enabled=false, Application=Appl10
        AccessControls: NexteerSession=false, SecurityAccess=false
      SrvFEA2Wr: ServiceType=Write - 0x2E, RequestLength=5, ResponseLength=0, ServiceId=65186, Enabled=false, Application=Appl10
        AccessControls: NexteerSession=false, SecurityAccess=true
      SrvFEA4Rd: ServiceType=Read - 0x22, RequestLength=0, ResponseLength=1, ServiceId=65188, Enabled=false, Application=Appl10
        AccessControls: NexteerSession=false, SecurityAccess=false
      SrvFEA9Rd: ServiceType=Read - 0x22, RequestLength=0, ResponseLength=8, ServiceId=65193, Enabled=false, Application=Appl10
        AccessControls: NexteerSession=false, SecurityAccess=false
      SrvFEABRd: ServiceType=Read - 0x22, RequestLength=0, ResponseLength=1, ServiceId=65195, Enabled=false, Application=Appl10
        AccessControls: NexteerSession=false, SecurityAccess=false
      SrvFEABWr: ServiceType=Write - 0x2E, RequestLength=1, ResponseLength=0, ServiceId=65195, Enabled=false, Application=Appl10
        AccessControls: NexteerSession=false, SecurityAccess=true
      SrvF201Rd: ServiceType=Read - 0x22, RequestLength=0, ResponseLength=4, ServiceId=61953, Enabled=true, Application=Appl10
        AccessControls: NexteerSession=false, SecurityAccess=false
      SrvF202Rd: ServiceType=Read - 0x22, RequestLength=0, ResponseLength=1, ServiceId=61954, Enabled=true, Application=Appl10
        AccessControls: NexteerSession=false, SecurityAccess=false
      SrvF203Rd: ServiceType=Read - 0x22, RequestLength=0, ResponseLength=4, ServiceId=61955, Enabled=true, Application=Appl10
        AccessControls: NexteerSession=false, SecurityAccess=false
      SrvF204Rd: ServiceType=Read - 0x22, RequestLength=0, ResponseLength=4, ServiceId=61956, Enabled=true, Application=Appl10
        AccessControls: NexteerSession=false, SecurityAccess=false
      SrvF205Rd: ServiceType=Read - 0x22, RequestLength=0, ResponseLength=4, ServiceId=61957, Enabled=true, Application=Appl10
        AccessControls: NexteerSession=false, SecurityAccess=false
      SrvF206Rd: ServiceType=Read - 0x22, RequestLength=0, ResponseLength=4, ServiceId=61958, Enabled=true, Application=Appl10
        AccessControls: NexteerSession=false, SecurityAccess=false
      SrvF207Rd: ServiceType=Read - 0x22, RequestLength=0, ResponseLength=4, ServiceId=61959, Enabled=true, Application=Appl10
        AccessControls: NexteerSession=false, SecurityAccess=false
      SrvF210Rd: ServiceType=Read - 0x22, RequestLength=0, ResponseLength=4, ServiceId=61968, Enabled=false, Application=Appl10
        AccessControls: NexteerSession=false, SecurityAccess=false
      SrvF211Rd: ServiceType=Read - 0x22, RequestLength=0, ResponseLength=4, ServiceId=61969, Enabled=false, Application=Appl10
        AccessControls: NexteerSession=false, SecurityAccess=false
      SrvF212Rd: ServiceType=Read - 0x22, RequestLength=0, ResponseLength=4, ServiceId=61970, Enabled=false, Application=Appl10
        AccessControls: NexteerSession=false, SecurityAccess=false
      SrvF213Rd: ServiceType=Read - 0x22, RequestLength=0, ResponseLength=4, ServiceId=61971, Enabled=false, Application=Appl10
        AccessControls: NexteerSession=false, SecurityAccess=false
      SrvF21FRd: ServiceType=Read - 0x22, RequestLength=0, ResponseLength=4, ServiceId=61983, Enabled=false, Application=Appl10
        AccessControls: NexteerSession=false, SecurityAccess=false
      SrvF220Rd: ServiceType=Read - 0x22, RequestLength=0, ResponseLength=4, ServiceId=61984, Enabled=false, Application=Appl10
        AccessControls: NexteerSession=false, SecurityAccess=false
      SrvF221Rd: ServiceType=Read - 0x22, RequestLength=0, ResponseLength=4, ServiceId=61985, Enabled=false, Application=Appl10
        AccessControls: NexteerSession=false, SecurityAccess=false
      SrvF22ERd: ServiceType=Read - 0x22, RequestLength=0, ResponseLength=4, ServiceId=61998, Enabled=false, Application=Appl10
        AccessControls: NexteerSession=false, SecurityAccess=false
      SrvF22FRd: ServiceType=Read - 0x22, RequestLength=0, ResponseLength=4, ServiceId=61999, Enabled=true, Application=Appl10
        AccessControls: NexteerSession=false, SecurityAccess=false
      SrvF230Rd: ServiceType=Read - 0x22, RequestLength=0, ResponseLength=2, ServiceId=62000, Enabled=true, Application=Appl10
        AccessControls: NexteerSession=false, SecurityAccess=false
      SrvF231Rd: ServiceType=Read - 0x22, RequestLength=0, ResponseLength=2, ServiceId=62001, Enabled=true, Application=Appl10
        AccessControls: NexteerSession=false, SecurityAccess=false
      SrvF232Rd: ServiceType=Read - 0x22, RequestLength=0, ResponseLength=2, ServiceId=62002, Enabled=false, Application=Appl10
        AccessControls: NexteerSession=false, SecurityAccess=false
      SrvF23ERd: ServiceType=Read - 0x22, RequestLength=0, ResponseLength=2, ServiceId=62014, Enabled=true, Application=Appl10
        AccessControls: NexteerSession=false, SecurityAccess=false
      SrvF23FRd: ServiceType=Read - 0x22, RequestLength=0, ResponseLength=4, ServiceId=62015, Enabled=true, Application=Appl10
        AccessControls: NexteerSession=false, SecurityAccess=false
      SrvFD40Rd: ServiceType=Read - 0x22, RequestLength=0, ResponseLength=4, ServiceId=64832, Enabled=true, Application=Appl10
        AccessControls: NexteerSession=false, SecurityAccess=false
      SrvFD40CtrlRtn: ServiceType=Control - 0x2F, RequestLength=0, ResponseLength=4, ServiceId=64832, SubFunction=0, Enabled=true, Application=Appl10
        AccessControls: NexteerSession=false, SecurityAccess=false
      SrvFD40CtrlAdj: ServiceType=Control - 0x2F, RequestLength=4, ResponseLength=4, ServiceId=64832, SubFunction=3, Enabled=true, Application=Appl10
        AccessControls: NexteerSession=false, SecurityAccess=true
      SrvFD41Rd: ServiceType=Read - 0x22, RequestLength=0, ResponseLength=4, ServiceId=64833, Enabled=true, Application=Appl10
        AccessControls: NexteerSession=false, SecurityAccess=false
      SrvFD41CtrlRtn: ServiceType=Control - 0x2F, RequestLength=0, ResponseLength=4, ServiceId=64833, SubFunction=0, Enabled=true, Application=Appl10
        AccessControls: NexteerSession=false, SecurityAccess=false
      SrvFD41CtrlAdj: ServiceType=Control - 0x2F, RequestLength=4, ResponseLength=4, ServiceId=64833, SubFunction=3, Enabled=true, Application=Appl10
        AccessControls: NexteerSession=false, SecurityAccess=true
      SrvFD42Rd: ServiceType=Read - 0x22, RequestLength=0, ResponseLength=4, ServiceId=64834, Enabled=true, Application=Appl10
        AccessControls: NexteerSession=false, SecurityAccess=false
      SrvFD42CtrlRtn: ServiceType=Control - 0x2F, RequestLength=0, ResponseLength=4, ServiceId=64834, SubFunction=0, Enabled=true, Application=Appl10
        AccessControls: NexteerSession=false, SecurityAccess=false
      SrvFD42CtrlAdj: ServiceType=Control - 0x2F, RequestLength=4, ResponseLength=4, ServiceId=64834, SubFunction=3, Enabled=true, Application=Appl10
        AccessControls: NexteerSession=false, SecurityAccess=true
      SrvF100RoutineStrt: ServiceType=Routine - 0x31, RequestLength=0, ResponseLength=0, ServiceId=61696, SubFunction=1, Enabled=true, Application=Appl10
        AccessControls: NexteerSession=false, SecurityAccess=true
      SrvF100RoutineStop: ServiceType=Routine - 0x31, RequestLength=0, ResponseLength=0, ServiceId=61696, SubFunction=2, Enabled=true, Application=Appl10
        AccessControls: NexteerSession=false, SecurityAccess=true
      SrvF100RoutineSts: ServiceType=Routine - 0x31, RequestLength=0, ResponseLength=1, ServiceId=61696, SubFunction=3, Enabled=true, Application=Appl10
        AccessControls: NexteerSession=false, SecurityAccess=false
      SrvF101RoutineStrt: ServiceType=Routine - 0x31, RequestLength=0, ResponseLength=0, ServiceId=61697, SubFunction=1, Enabled=true, Application=Appl10
        AccessControls: NexteerSession=false, SecurityAccess=true
      SrvF101RoutineStop: ServiceType=Routine - 0x31, RequestLength=0, ResponseLength=0, ServiceId=61697, SubFunction=2, Enabled=true, Application=Appl10
        AccessControls: NexteerSession=false, SecurityAccess=true
      SrvF101RoutineSts: ServiceType=Routine - 0x31, RequestLength=0, ResponseLength=1, ServiceId=61697, SubFunction=3, Enabled=true, Application=Appl10
        AccessControls: NexteerSession=false, SecurityAccess=false
      SrvF110RoutineStrt: ServiceType=Routine - 0x31, RequestLength=0, ResponseLength=0, ServiceId=61712, SubFunction=1, Enabled=true, Application=Appl10
        AccessControls: NexteerSession=false, SecurityAccess=true
      SrvF110RoutineStop: ServiceType=Routine - 0x31, RequestLength=0, ResponseLength=0, ServiceId=61712, SubFunction=2, Enabled=true, Application=Appl10
        AccessControls: NexteerSession=false, SecurityAccess=true
      SrvF110RoutineSts: ServiceType=Routine - 0x31, RequestLength=0, ResponseLength=1, ServiceId=61712, SubFunction=3, Enabled=true, Application=Appl10
        AccessControls: NexteerSession=false, SecurityAccess=false
      SrvF111RoutineStrt: ServiceType=Routine - 0x31, RequestLength=0, ResponseLength=0, ServiceId=61713, SubFunction=1, Enabled=true, Application=Appl10
        AccessControls: NexteerSession=false, SecurityAccess=true
      SrvF111RoutineStop: ServiceType=Routine - 0x31, RequestLength=0, ResponseLength=0, ServiceId=61713, SubFunction=2, Enabled=true, Application=Appl10
        AccessControls: NexteerSession=false, SecurityAccess=true
      SrvF111RoutineSts: ServiceType=Routine - 0x31, RequestLength=0, ResponseLength=1, ServiceId=61713, SubFunction=3, Enabled=true, Application=Appl10
        AccessControls: NexteerSession=false, SecurityAccess=false
      SrvF112RoutineStrt: ServiceType=Routine - 0x31, RequestLength=0, ResponseLength=0, ServiceId=61714, SubFunction=1, Enabled=true, Application=Appl10
        AccessControls: NexteerSession=false, SecurityAccess=true
      SrvF112RoutineStop: ServiceType=Routine - 0x31, RequestLength=0, ResponseLength=0, ServiceId=61714, SubFunction=2, Enabled=true, Application=Appl10
        AccessControls: NexteerSession=false, SecurityAccess=true
      SrvF112RoutineSts: ServiceType=Routine - 0x31, RequestLength=0, ResponseLength=1, ServiceId=61714, SubFunction=3, Enabled=true, Application=Appl10
        AccessControls: NexteerSession=false, SecurityAccess=false
      SrvF113RoutineStrt: ServiceType=Routine - 0x31, RequestLength=0, ResponseLength=0, ServiceId=61715, SubFunction=1, Enabled=true, Application=Appl10
        AccessControls: NexteerSession=false, SecurityAccess=true
      SrvF113RoutineStop: ServiceType=Routine - 0x31, RequestLength=0, ResponseLength=0, ServiceId=61715, SubFunction=2, Enabled=true, Application=Appl10
        AccessControls: NexteerSession=false, SecurityAccess=true
      SrvF113RoutineSts: ServiceType=Routine - 0x31, RequestLength=0, ResponseLength=1, ServiceId=61715, SubFunction=3, Enabled=true, Application=Appl10
        AccessControls: NexteerSession=false, SecurityAccess=false
      SrvF114RoutineStrt: ServiceType=Routine - 0x31, RequestLength=0, ResponseLength=0, ServiceId=61716, SubFunction=1, Enabled=true, Application=Appl10
        AccessControls: NexteerSession=false, SecurityAccess=true
      SrvF114RoutineStop: ServiceType=Routine - 0x31, RequestLength=0, ResponseLength=0, ServiceId=61716, SubFunction=2, Enabled=true, Application=Appl10
        AccessControls: NexteerSession=false, SecurityAccess=true
      SrvF114RoutineSts: ServiceType=Routine - 0x31, RequestLength=0, ResponseLength=1, ServiceId=61716, SubFunction=3, Enabled=true, Application=Appl10
        AccessControls: NexteerSession=false, SecurityAccess=false
      SrvF115RoutineStrt: ServiceType=Routine - 0x31, RequestLength=0, ResponseLength=0, ServiceId=61717, SubFunction=1, Enabled=true, Application=Appl10
        AccessControls: NexteerSession=false, SecurityAccess=true
      SrvF115RoutineStop: ServiceType=Routine - 0x31, RequestLength=0, ResponseLength=0, ServiceId=61717, SubFunction=2, Enabled=true, Application=Appl10
        AccessControls: NexteerSession=false, SecurityAccess=true
      SrvF115RoutineSts: ServiceType=Routine - 0x31, RequestLength=0, ResponseLength=1, ServiceId=61717, SubFunction=3, Enabled=true, Application=Appl10
        AccessControls: NexteerSession=false, SecurityAccess=false
      SrvF116RoutineStrt: ServiceType=Routine - 0x31, RequestLength=0, ResponseLength=0, ServiceId=61718, SubFunction=1, Enabled=true, Application=Appl10
        AccessControls: NexteerSession=false, SecurityAccess=true
      SrvF116RoutineStop: ServiceType=Routine - 0x31, RequestLength=0, ResponseLength=0, ServiceId=61718, SubFunction=2, Enabled=true, Application=Appl10
        AccessControls: NexteerSession=false, SecurityAccess=true
      SrvF116RoutineSts: ServiceType=Routine - 0x31, RequestLength=0, ResponseLength=1, ServiceId=61718, SubFunction=3, Enabled=true, Application=Appl10
        AccessControls: NexteerSession=false, SecurityAccess=false
      SrvF117RoutineStrt: ServiceType=Routine - 0x31, RequestLength=0, ResponseLength=0, ServiceId=61719, SubFunction=1, Enabled=true, Application=Appl10
        AccessControls: NexteerSession=false, SecurityAccess=true
      SrvF117RoutineStop: ServiceType=Routine - 0x31, RequestLength=0, ResponseLength=0, ServiceId=61719, SubFunction=2, Enabled=true, Application=Appl10
        AccessControls: NexteerSession=false, SecurityAccess=true
      SrvF117RoutineSts: ServiceType=Routine - 0x31, RequestLength=0, ResponseLength=1, ServiceId=61719, SubFunction=3, Enabled=true, Application=Appl10
        AccessControls: NexteerSession=false, SecurityAccess=false
      SrvF118RoutineStrt: ServiceType=Routine - 0x31, RequestLength=0, ResponseLength=0, ServiceId=61720, SubFunction=1, Enabled=true, Application=Appl10
        AccessControls: NexteerSession=false, SecurityAccess=true
      SrvF118RoutineStop: ServiceType=Routine - 0x31, RequestLength=0, ResponseLength=0, ServiceId=61720, SubFunction=2, Enabled=true, Application=Appl10
        AccessControls: NexteerSession=false, SecurityAccess=true
      SrvF118RoutineSts: ServiceType=Routine - 0x31, RequestLength=0, ResponseLength=1, ServiceId=61720, SubFunction=3, Enabled=true, Application=Appl10
        AccessControls: NexteerSession=false, SecurityAccess=false
      SrvF119RoutineStrt: ServiceType=Routine - 0x31, RequestLength=0, ResponseLength=0, ServiceId=61721, SubFunction=1, Enabled=true, Application=Appl10
        AccessControls: NexteerSession=false, SecurityAccess=true
      SrvF119RoutineStop: ServiceType=Routine - 0x31, RequestLength=0, ResponseLength=0, ServiceId=61721, SubFunction=2, Enabled=true, Application=Appl10
        AccessControls: NexteerSession=false, SecurityAccess=true
      SrvF119RoutineSts: ServiceType=Routine - 0x31, RequestLength=0, ResponseLength=1, ServiceId=61721, SubFunction=3, Enabled=true, Application=Appl10
        AccessControls: NexteerSession=false, SecurityAccess=false
      SrvF11ARoutineStrt: ServiceType=Routine - 0x31, RequestLength=0, ResponseLength=0, ServiceId=61722, SubFunction=1, Enabled=true, Application=Appl10
        AccessControls: NexteerSession=false, SecurityAccess=true
      SrvF11ARoutineStop: ServiceType=Routine - 0x31, RequestLength=0, ResponseLength=0, ServiceId=61722, SubFunction=2, Enabled=true, Application=Appl10
        AccessControls: NexteerSession=false, SecurityAccess=true
      SrvF11ARoutineSts: ServiceType=Routine - 0x31, RequestLength=0, ResponseLength=1, ServiceId=61722, SubFunction=3, Enabled=true, Application=Appl10
        AccessControls: NexteerSession=false, SecurityAccess=false
      SrvF140RoutineStrt: ServiceType=Routine - 0x31, RequestLength=0, ResponseLength=0, ServiceId=61760, SubFunction=1, Enabled=true, Application=Appl10
        AccessControls: NexteerSession=false, SecurityAccess=true
      SrvF140RoutineStop: ServiceType=Routine - 0x31, RequestLength=0, ResponseLength=0, ServiceId=61760, SubFunction=2, Enabled=true, Application=Appl10
        AccessControls: NexteerSession=false, SecurityAccess=true
      SrvF140RoutineSts: ServiceType=Routine - 0x31, RequestLength=0, ResponseLength=8, ServiceId=61760, SubFunction=3, Enabled=true, Application=Appl10
        AccessControls: NexteerSession=false, SecurityAccess=false
      SrvF141RoutineStrt: ServiceType=Routine - 0x31, RequestLength=0, ResponseLength=0, ServiceId=61761, SubFunction=1, Enabled=true, Application=Appl10
        AccessControls: NexteerSession=false, SecurityAccess=true
      SrvF141RoutineStop: ServiceType=Routine - 0x31, RequestLength=0, ResponseLength=0, ServiceId=61761, SubFunction=2, Enabled=true, Application=Appl10
        AccessControls: NexteerSession=false, SecurityAccess=true
      SrvF141RoutineSts: ServiceType=Routine - 0x31, RequestLength=0, ResponseLength=8, ServiceId=61761, SubFunction=3, Enabled=true, Application=Appl10
        AccessControls: NexteerSession=false, SecurityAccess=false
      SrvF150RoutineStrt: ServiceType=Routine - 0x31, RequestLength=0, ResponseLength=0, ServiceId=61776, SubFunction=1, Enabled=true, Application=Appl10
        AccessControls: NexteerSession=false, SecurityAccess=true
      SrvF150RoutineStop: ServiceType=Routine - 0x31, RequestLength=0, ResponseLength=0, ServiceId=61776, SubFunction=2, Enabled=true, Application=Appl10
        AccessControls: NexteerSession=false, SecurityAccess=true
      SrvF150RoutineSts: ServiceType=Routine - 0x31, RequestLength=0, ResponseLength=1, ServiceId=61776, SubFunction=3, Enabled=true, Application=Appl10
        AccessControls: NexteerSession=false, SecurityAccess=false
      SrvF151RoutineStrt: ServiceType=Routine - 0x31, RequestLength=0, ResponseLength=0, ServiceId=61777, SubFunction=1, Enabled=true, Application=Appl10
        AccessControls: NexteerSession=false, SecurityAccess=true
      SrvF151RoutineStop: ServiceType=Routine - 0x31, RequestLength=0, ResponseLength=0, ServiceId=61777, SubFunction=2, Enabled=true, Application=Appl10
        AccessControls: NexteerSession=false, SecurityAccess=true
      SrvF151RoutineSts: ServiceType=Routine - 0x31, RequestLength=0, ResponseLength=1, ServiceId=61777, SubFunction=3, Enabled=true, Application=Appl10
        AccessControls: NexteerSession=false, SecurityAccess=false
      SrvFDF0RoutineStrt: ServiceType=Routine - 0x31, RequestLength=0, ResponseLength=0, ServiceId=65008, SubFunction=1, Enabled=true, Application=Appl10
        AccessControls: NexteerSession=false, SecurityAccess=true
      SrvFDF0RoutineSts: ServiceType=Routine - 0x31, RequestLength=0, ResponseLength=1, ServiceId=65008, SubFunction=3, Enabled=true, Application=Appl10
        AccessControls: NexteerSession=false, SecurityAccess=false
      SrvFDF1RoutineStrt: ServiceType=Routine - 0x31, RequestLength=0, ResponseLength=0, ServiceId=65009, SubFunction=1, Enabled=true, Application=Appl10
        AccessControls: NexteerSession=false, SecurityAccess=true
      SrvFDF1RoutineSts: ServiceType=Routine - 0x31, RequestLength=0, ResponseLength=1, ServiceId=65009, SubFunction=3, Enabled=true, Application=Appl10
        AccessControls: NexteerSession=false, SecurityAccess=false
      SrvFE20RoutineStrt: ServiceType=Routine - 0x31, RequestLength=8, ResponseLength=0, ServiceId=65056, SubFunction=1, Enabled=true, Application=Appl10
        AccessControls: NexteerSession=false, SecurityAccess=true
      SrvFE20RoutineStop: ServiceType=Routine - 0x31, RequestLength=4, ResponseLength=0, ServiceId=65056, SubFunction=2, Enabled=true, Application=Appl10
        AccessControls: NexteerSession=false, SecurityAccess=false
      SrvF000RoutineStrt: ServiceType=Routine - 0x31, RequestLength=0, ResponseLength=0, ServiceId=61440, SubFunction=1, Enabled=true, Application=Appl10
        AccessControls: NexteerSession=false, SecurityAccess=true
      SrvF001RoutineStrt: ServiceType=Routine - 0x31, RequestLength=0, ResponseLength=0, ServiceId=61441, SubFunction=1, Enabled=true, Application=Appl10
        AccessControls: NexteerSession=false, SecurityAccess=true
      SrvF002RoutineStrt: ServiceType=Routine - 0x31, RequestLength=0, ResponseLength=0, ServiceId=61442, SubFunction=1, Enabled=true, Application=Appl10
        AccessControls: NexteerSession=false, SecurityAccess=true
      SrvF010RoutineStrt: ServiceType=Routine - 0x31, RequestLength=0, ResponseLength=0, ServiceId=61456, SubFunction=1, Enabled=false, Application=Appl10
        AccessControls: NexteerSession=false, SecurityAccess=true
      SrvF200RoutineStrt: ServiceType=Routine - 0x31, RequestLength=4, ResponseLength=0, ServiceId=61952, SubFunction=1, Enabled=true, Application=Appl10
        AccessControls: NexteerSession=false, SecurityAccess=true
      SrvFD68RoutineStrt: ServiceType=Routine - 0x31, RequestLength=2, ResponseLength=5, ServiceId=64872, SubFunction=1, Enabled=true, Application=Appl10
        AccessControls: NexteerSession=false, SecurityAccess=false
      SrvFD70RoutineStrt: ServiceType=Routine - 0x31, RequestLength=0, ResponseLength=0, ServiceId=64880, SubFunction=1, Enabled=true, Application=Appl10
        AccessControls: NexteerSession=false, SecurityAccess=true
      SrvFD71RoutineStrt: ServiceType=Routine - 0x31, RequestLength=0, ResponseLength=0, ServiceId=64881, SubFunction=1, Enabled=true, Application=Appl10
        AccessControls: NexteerSession=false, SecurityAccess=true
      SrvFD80RoutineStrt: ServiceType=Routine - 0x31, RequestLength=0, ResponseLength=0, ServiceId=64896, SubFunction=1, Enabled=false, Application=Appl10
        AccessControls: NexteerSession=false, SecurityAccess=true
      SrvFD81RoutineStrt: ServiceType=Routine - 0x31, RequestLength=0, ResponseLength=0, ServiceId=64897, SubFunction=1, Enabled=false, Application=Appl10
        AccessControls: NexteerSession=false, SecurityAccess=true
      SrvFD84RoutineStrt: ServiceType=Routine - 0x31, RequestLength=0, ResponseLength=0, ServiceId=64900, SubFunction=1, Enabled=false, Application=Appl10
        AccessControls: NexteerSession=false, SecurityAccess=true
      SrvFD85RoutineStrt: ServiceType=Routine - 0x31, RequestLength=0, ResponseLength=0, ServiceId=64901, SubFunction=1, Enabled=false, Application=Appl10
        AccessControls: NexteerSession=false, SecurityAccess=true
      SrvFD90RoutineStrt: ServiceType=Routine - 0x31, RequestLength=0, ResponseLength=0, ServiceId=64912, SubFunction=1, Enabled=false, Application=Appl10
        AccessControls: NexteerSession=false, SecurityAccess=true
      SrvFD91RoutineStrt: ServiceType=Routine - 0x31, RequestLength=0, ResponseLength=0, ServiceId=64913, SubFunction=1, Enabled=false, Application=Appl10
        AccessControls: NexteerSession=false, SecurityAccess=true
      SrvFDA0RoutineStrt: ServiceType=Routine - 0x31, RequestLength=0, ResponseLength=0, ServiceId=64928, SubFunction=1, Enabled=false, Application=Appl10
        AccessControls: NexteerSession=false, SecurityAccess=true
      SrvFDA1RoutineStrt: ServiceType=Routine - 0x31, RequestLength=0, ResponseLength=0, ServiceId=64929, SubFunction=1, Enabled=false, Application=Appl10
        AccessControls: NexteerSession=false, SecurityAccess=true
      SrvFDA2RoutineStrt: ServiceType=Routine - 0x31, RequestLength=0, ResponseLength=0, ServiceId=64930, SubFunction=1, Enabled=false, Application=Appl10
        AccessControls: NexteerSession=false, SecurityAccess=true
      SrvFDA3RoutineStrt: ServiceType=Routine - 0x31, RequestLength=0, ResponseLength=0, ServiceId=64931, SubFunction=1, Enabled=false, Application=Appl10
        AccessControls: NexteerSession=false, SecurityAccess=true
      SrvFDA4RoutineStrt: ServiceType=Routine - 0x31, RequestLength=0, ResponseLength=0, ServiceId=64932, SubFunction=1, Enabled=true, Application=Appl10
        AccessControls: NexteerSession=false, SecurityAccess=true
      SrvFDA5RoutineStrt: ServiceType=Routine - 0x31, RequestLength=0, ResponseLength=0, ServiceId=64933, SubFunction=1, Enabled=true, Application=Appl10
        AccessControls: NexteerSession=false, SecurityAccess=true
      SrvFDA8RoutineStrt: ServiceType=Routine - 0x31, RequestLength=0, ResponseLength=0, ServiceId=64936, SubFunction=1, Enabled=false, Application=Appl10
        AccessControls: NexteerSession=false, SecurityAccess=true
      SrvFDA9RoutineStrt: ServiceType=Routine - 0x31, RequestLength=0, ResponseLength=0, ServiceId=64937, SubFunction=1, Enabled=false, Application=Appl10
        AccessControls: NexteerSession=false, SecurityAccess=true
      SrvFDAARoutineStrt: ServiceType=Routine - 0x31, RequestLength=0, ResponseLength=0, ServiceId=64938, SubFunction=1, Enabled=false, Application=Appl10
        AccessControls: NexteerSession=false, SecurityAccess=true
      SrvFDABRoutineStrt: ServiceType=Routine - 0x31, RequestLength=0, ResponseLength=0, ServiceId=64939, SubFunction=1, Enabled=false, Application=Appl10
        AccessControls: NexteerSession=false, SecurityAccess=true
      SrvFDACRoutineStrt: ServiceType=Routine - 0x31, RequestLength=0, ResponseLength=0, ServiceId=64940, SubFunction=1, Enabled=true, Application=Appl10
        AccessControls: NexteerSession=false, SecurityAccess=true
      SrvFDADRoutineStrt: ServiceType=Routine - 0x31, RequestLength=0, ResponseLength=0, ServiceId=64941, SubFunction=1, Enabled=true, Application=Appl10
        AccessControls: NexteerSession=false, SecurityAccess=true
      SrvFDAERoutineStrt: ServiceType=Routine - 0x31, RequestLength=0, ResponseLength=0, ServiceId=64942, SubFunction=1, Enabled=true, Application=Appl10
        AccessControls: NexteerSession=false, SecurityAccess=true
      SrvFDAFRoutineStrt: ServiceType=Routine - 0x31, RequestLength=0, ResponseLength=0, ServiceId=64943, SubFunction=1, Enabled=true, Application=Appl10
        AccessControls: NexteerSession=false, SecurityAccess=true
      SrvFDD0RoutineStrt: ServiceType=Routine - 0x31, RequestLength=0, ResponseLength=0, ServiceId=64976, SubFunction=1, Enabled=false, Application=Appl10
        AccessControls: NexteerSession=false, SecurityAccess=true
      SrvFDD8RoutineStrt: ServiceType=Routine - 0x31, RequestLength=0, ResponseLength=0, ServiceId=64984, SubFunction=1, Enabled=false, Application=Appl10
        AccessControls: NexteerSession=false, SecurityAccess=true
      SrvFE80RoutineStrt: ServiceType=Routine - 0x31, RequestLength=0, ResponseLength=0, ServiceId=65152, SubFunction=1, Enabled=true, Application=Appl10
        AccessControls: NexteerSession=false, SecurityAccess=true
      SrvFE88RoutineStrt: ServiceType=Routine - 0x31, RequestLength=0, ResponseLength=0, ServiceId=65160, SubFunction=1, Enabled=true, Application=Appl10
        AccessControls: NexteerSession=false, SecurityAccess=true
      SrvFE89RoutineStrt: ServiceType=Routine - 0x31, RequestLength=0, ResponseLength=0, ServiceId=65161, SubFunction=1, Enabled=true, Application=Appl10
        AccessControls: NexteerSession=false, SecurityAccess=true
      SrvFE98RoutineStrt: ServiceType=Routine - 0x31, RequestLength=0, ResponseLength=0, ServiceId=65176, SubFunction=1, Enabled=false, Application=Appl10
        AccessControls: NexteerSession=false, SecurityAccess=true
      SrvFE99RoutineStrt: ServiceType=Routine - 0x31, RequestLength=0, ResponseLength=0, ServiceId=65177, SubFunction=1, Enabled=false, Application=Appl10
        AccessControls: NexteerSession=false, SecurityAccess=true
      SrvFEA0RoutineStrt: ServiceType=Routine - 0x31, RequestLength=0, ResponseLength=0, ServiceId=65184, SubFunction=1, Enabled=false, Application=Appl10
        AccessControls: NexteerSession=false, SecurityAccess=true
      SrvFEA1RoutineStrt: ServiceType=Routine - 0x31, RequestLength=0, ResponseLength=0, ServiceId=65185, SubFunction=1, Enabled=true, Application=Appl10
        AccessControls: NexteerSession=false, SecurityAccess=true
      SrvFEA8RoutineStrt: ServiceType=Routine - 0x31, RequestLength=0, ResponseLength=0, ServiceId=65192, SubFunction=1, Enabled=false, Application=Appl10
        AccessControls: NexteerSession=false, SecurityAccess=true
      SrvFEAARoutineStrt: ServiceType=Routine - 0x31, RequestLength=0, ResponseLength=0, ServiceId=65194, SubFunction=1, Enabled=false, Application=Appl10
        AccessControls: NexteerSession=false, SecurityAccess=true
      SrvFEB0RoutineStrt: ServiceType=Routine - 0x31, RequestLength=0, ResponseLength=0, ServiceId=65200, SubFunction=1, Enabled=false, Application=Appl10
        AccessControls: NexteerSession=false, SecurityAccess=true
      SrvFEB1RoutineStrt: ServiceType=Routine - 0x31, RequestLength=0, ResponseLength=0, ServiceId=65201, SubFunction=1, Enabled=false, Application=Appl10
        AccessControls: NexteerSession=false, SecurityAccess=true
      SrvPerRdFast: ServiceType=Periodic - 0x2A, RequestLength=65535, ResponseLength=0, SubFunction=1, Enabled=false, Application=Appl10
        AccessControls: NexteerSession=false, SecurityAccess=false
      SrvPerRdMed: ServiceType=Periodic - 0x2A, RequestLength=65535, ResponseLength=0, SubFunction=2, Enabled=false, Application=Appl10
        AccessControls: NexteerSession=false, SecurityAccess=false
      SrvPerRdSlow: ServiceType=Periodic - 0x2A, RequestLength=65535, ResponseLength=0, SubFunction=3, Enabled=false, Application=Appl10
        AccessControls: NexteerSession=false, SecurityAccess=false
      SrvPerRdStop: ServiceType=Periodic - 0x2A, RequestLength=0, ResponseLength=0, SubFunction=4, Enabled=false, Application=Appl10
        AccessControls: NexteerSession=false, SecurityAccess=false
    NxtrMfgSrvGeneral: MfgSrvApplRef=Appl10
    16 x CommonService, all with Application=Appl10:
      SrvFDC2RoutineStop: ServiceType=Routine - 0x31, RequestLength=0, ResponseLength=0, ServiceId=64962, SubFunction=2, Enabled=false
        AccessControls: NexteerSession=true, SecurityAccess=true
      SrvFDF7Rd: ServiceType=Read - 0x22, RequestLength=0, ResponseLength=28, ServiceId=65015, Enabled=true
        AccessControls: NexteerSession=false, SecurityAccess=false
      SrvFD73RoutineStrt: ServiceType=Routine - 0x31, RequestLength=0, ResponseLength=0, ServiceId=64883, SubFunction=1, Enabled=false
        AccessControls: NexteerSession=true, SecurityAccess=true
      SrvFD62Rd: ServiceType=Read - 0x22, RequestLength=0, ResponseLength=256, ServiceId=64866, Enabled=true
        AccessControls: NexteerSession=false, SecurityAccess=false
      SrvFDCAWr: ServiceType=Write - 0x2E, RequestLength=308, ResponseLength=0, ServiceId=64970, Enabled=false
        AccessControls: NexteerSession=true, SecurityAccess=true
      SrvFDC9Wr: ServiceType=Write - 0x2E, RequestLength=308, ResponseLength=0, ServiceId=64969, Enabled=false
        AccessControls: NexteerSession=true, SecurityAccess=true
      SrvFD63Rd: ServiceType=Read - 0x22, RequestLength=0, ResponseLength=20, ServiceId=64867, Enabled=true
        AccessControls: NexteerSession=false, SecurityAccess=false
      SrvFDC1Wr: ServiceType=Write - 0x2E, RequestLength=23, ResponseLength=0, ServiceId=64961, Enabled=false
        AccessControls: NexteerSession=true, SecurityAccess=true
      SrvFDF6Wr: ServiceType=Write - 0x2E, RequestLength=12, ResponseLength=0, ServiceId=65014, Enabled=true
        AccessControls: NexteerSession=false, SecurityAccess=true
      SrvFDC2RoutineStrt: ServiceType=Routine - 0x31, RequestLength=0, ResponseLength=0, ServiceId=64962, SubFunction=1, Enabled=false
        AccessControls: NexteerSession=true, SecurityAccess=true
      SrvFDF7Wr: ServiceType=Write - 0x2E, RequestLength=28, ResponseLength=0, ServiceId=65015, Enabled=true
        AccessControls: NexteerSession=false, SecurityAccess=true
      SrvFDCARd: ServiceType=Read - 0x22, RequestLength=0, ResponseLength=308, ServiceId=64970, Enabled=false
        AccessControls: NexteerSession=true, SecurityAccess=false
      SrvFDC9Rd: ServiceType=Read - 0x22, RequestLength=0, ResponseLength=308, ServiceId=64969, Enabled=false
        AccessControls: NexteerSession=true, SecurityAccess=false
      SrvFDC1Rd: ServiceType=Read - 0x22, RequestLength=0, ResponseLength=23, ServiceId=64961, Enabled=false
        AccessControls: NexteerSession=true, SecurityAccess=false
      SrvFDF6Rd: ServiceType=Read - 0x22, RequestLength=0, ResponseLength=12, ServiceId=65014, Enabled=true
        AccessControls: NexteerSession=false, SecurityAccess=false
      SrvFDC2RoutineSts: ServiceType=Routine - 0x31, RequestLength=0, ResponseLength=27, ServiceId=64962, SubFunction=3, Enabled=false
        AccessControls: NexteerSession=true, SecurityAccess=false
    4 x ProgramSpecificService, all with Enabled=true, Application=Appl10:
      SrvFED0Wr: ServiceType=Write - 0x2E, RequestLength=1, ResponseLength=0, ServiceId=65232
        AccessControls: NexteerSession=false, SecurityAccess=false
      SrvFED0Rd: ServiceType=Read - 0x22, RequestLength=0, ResponseLength=1, ServiceId=65232
        AccessControls: NexteerSession=false, SecurityAccess=false
      SrvFED1Rd: ServiceType=Read - 0x22, RequestLength=0, ResponseLength=1, ServiceId=65233
        AccessControls: NexteerSession=false, SecurityAccess=false
      SrvFED1Wr: ServiceType=Write - 0x2E, RequestLength=1, ResponseLength=0, ServiceId=65233
        AccessControls: NexteerSession=false, SecurityAccess=false
