AUTOSAR XML (schema 4-3-0)
package /ActiveEcuC
  module config ElecGlbPrm: implementation-config-variant=VARIANT-PRE-COMPILE
    ElecGlbPrmCfg:
      InverterCount = 1
      MotCtrlInterTrigSrc = 0
      PwmFreqMax = 18000
      PwmFreqMin = 14000
      PwmPerdMax = 71429
      PwmPerdMin = 55555
      PwmPerdNom = 62.5
      HwTqSnsrTickCnt = 17
      HwAgIfLtchEna = false
      PwmPerdNomX2 = 0.000125
