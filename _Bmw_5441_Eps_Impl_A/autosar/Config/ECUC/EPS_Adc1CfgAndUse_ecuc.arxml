AUTOSAR XML (schema 4-3-0)
package /ActiveEcuC
  module config Adc1CfgAndUse: implementation-config-variant=VARIANT-PRE-COMPILE
    Adc1CfgAndUseGeneral:
      ADCD1VCR00 = 24580
      ADCD1VCR01 = 9
      ADCD1VCR02 = 2
      ADCD1VCR03 = 24588
      ADCD1VCR04 = 24580
      ADCD1VCR05 = 4
      ADCD1VCR06 = 6
      ADCD1VCR07 = 24588
      ADCD1VCR{08..20} = 24584
      ADCD1SGVCSP2 = 4
      ADCD1SGVCSP3 = 0
      ADCD1SGVCEP2 = 7
      ADCD1SGVCEP3 = 3
