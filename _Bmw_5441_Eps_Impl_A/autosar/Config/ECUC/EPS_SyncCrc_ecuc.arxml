AUTOSAR XML (schema 4-3-0)
package /ActiveEcuC
  module config SyncCrc: implementation-config-variant=VARIANT-PRE-COMPILE, module-description=SyncCrc_Impl
    SyncCrcCommon: DeviceType=P1x, ReservedCRCHardwareUnits=0, AutosarWrapperEnable=STD_OFF, CrcOsApplicationReference=Appl10
