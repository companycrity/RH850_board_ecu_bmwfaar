AUTOSAR XML (schema 4-3-0)
package /ActiveEcuC
  module config RvsBattProtn: implementation-config-variant=VARIANT-PRE-COMPILE
    RvsBattProtnGeneral: FAILSTEP=6552, GNDMEASDVLTGHILIMN=1.5, GNDMEASDVLTGLOLIMN=1.1, PASSSTEP=3276, RTNMEASDVLTGHILIMN=1.5, RTNMEASDVLTGLOLIMN=0.12, RVSFLTTHD=0.6
