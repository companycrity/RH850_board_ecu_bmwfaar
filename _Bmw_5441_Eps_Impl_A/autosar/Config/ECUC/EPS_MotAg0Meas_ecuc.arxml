AUTOSAR XML (schema 4-3-0)
package /ActiveEcuC
  module config MotAg0Meas: implementation-config-variant=VARIANT-PRE-COMPILE
    MotAg0MeasGeneral: MOTAG0PRTCLFLTNTCNR=NTCNR_0X083, DIQEPIF=false
