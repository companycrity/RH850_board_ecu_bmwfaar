AUTOSAR XML (schema 4-3-0)
package /ActiveEcuC
  module config TunSelnMngt: implementation-config-variant=VARIANT-PRE-COMPILE
    TunSelnMngtCommon: OnlineCalibrationRamSize=4096
    CalibrationConfiguration
      7 x InitializationSelectableCalibrationConfiguration:
        IninIdx00: InitializationIndex=0, InitializationComponentReference=CalRegn01Inin00, InitializationComponentReference=CalRegn01Inin00GroupA, InitializationComponentReference=CalRegn01Inin00GroupD, InitializationComponentReference=CalRegn01Inin00GroupC
        IninIdx01: InitializationIndex=1, InitializationComponentReference=CalRegn01Inin01, InitializationComponentReference=CalRegn01Inin01GroupA, InitializationComponentReference=CalRegn01Inin01GroupD, InitializationComponentReference=CalRegn01Inin01GroupC
        IninIdx02: InitializationIndex=2, InitializationComponentReference=CalRegn01Inin02, InitializationComponentReference=CalRegn01Inin02GroupA, InitializationComponentReference=CalRegn01Inin02GroupD, InitializationComponentReference=CalRegn01Inin02GroupC
        IninIdx03: InitializationIndex=3, InitializationComponentReference=CalRegn01Inin03, InitializationComponentReference=CalRegn01Inin03GroupA, InitializationComponentReference=CalRegn01Inin03GroupD, InitializationComponentReference=CalRegn01Inin03GroupC
        IninIdx04: InitializationIndex=4, InitializationComponentReference=CalRegn01Inin04, InitializationComponentReference=CalRegn01Inin04GroupA, InitializationComponentReference=CalRegn01Inin04GroupD, InitializationComponentReference=CalRegn01Inin04GroupC
        IninIdx05: InitializationIndex=5, InitializationComponentReference=CalRegn01Inin05, InitializationComponentReference=CalRegn01Inin05GroupA, InitializationComponentReference=CalRegn01Inin05GroupD, InitializationComponentReference=CalRegn01Inin05GroupC
        IninIdx06: InitializationIndex=6, InitializationComponentReference=CalRegn01Inin06, InitializationComponentReference=CalRegn01Inin06GroupA, InitializationComponentReference=CalRegn01Inin06GroupD, InitializationComponentReference=CalRegn01Inin06GroupC
      4 x InitializationOptionalSetASelectableCalibrationConfiguration:
        IninOptSetAIdx00: InitializationOptionalSetAIndex=0, InitializationOptionalSetAComponentReference=CalRegn01IninOptSetA00
        IninOptSetAIdx01: InitializationOptionalSetAIndex=1, InitializationOptionalSetAComponentReference=CalRegn01IninOptSetA01
        IninOptSetAIdx02: InitializationOptionalSetAIndex=2, InitializationOptionalSetAComponentReference=CalRegn01IninOptSetA02
        IninOptSetAIdx03: InitializationOptionalSetAIndex=3, InitializationOptionalSetAComponentReference=CalRegn01IninOptSetA03
      4 x RuntimeSelectableCalibrationConfiguration:
        RtIdx00: RuntimeIndex=0, RuntimeComponentReference=CalRegn02Rt00, RuntimeComponentReference=CalRegn02Rt00GroupA, RuntimeComponentReference=CalRegn02Rt00GroupD, RuntimeComponentReference=CalRegn02Rt00GroupC
        RtIdx01: RuntimeIndex=1, RuntimeComponentReference=CalRegn02Rt01, RuntimeComponentReference=CalRegn02Rt01GroupA, RuntimeComponentReference=CalRegn02Rt01GroupD, RuntimeComponentReference=CalRegn02Rt01GroupC
        RtIdx02: RuntimeIndex=2, RuntimeComponentReference=CalRegn02Rt02, RuntimeComponentReference=CalRegn02Rt02GroupA, RuntimeComponentReference=CalRegn02Rt02GroupD, RuntimeComponentReference=CalRegn02Rt02GroupC
        RtIdx03: RuntimeIndex=3, RuntimeComponentReference=CalRegn02Rt03, RuntimeComponentReference=CalRegn02Rt03GroupA, RuntimeComponentReference=CalRegn02Rt03GroupD, RuntimeComponentReference=CalRegn02Rt03GroupC
    CalRegn01 (CalRegions)
      28 x InitializationComponent:
        CalRegn01Inin00: ComponentPartOfIntegration=true
        CalRegn01Inin{01..06}: ComponentPartOfIntegration=false, InitializationComponentReference=CalRegn01Inin00
        CalRegn01Inin00GroupA: ComponentPartOfIntegration=true
        CalRegn01Inin{01..06}GroupA: ComponentPartOfIntegration=false, InitializationComponentReference=CalRegn01Inin00GroupA
        CalRegn01Inin00GroupD: ComponentPartOfIntegration=true
        CalRegn01Inin{01..06}GroupD: ComponentPartOfIntegration=false, InitializationComponentReference=CalRegn01Inin00GroupD
        CalRegn01Inin00GroupC: ComponentPartOfIntegration=true
        CalRegn01Inin{01..06}GroupC: ComponentPartOfIntegration=false, InitializationComponentReference=CalRegn01Inin00GroupC
      4 x InitializationOptionalSetAComponent:
        CalRegn01IninOptSetA00: ComponentPartOfIntegration=true
        CalRegn01IninOptSetA{01..03}: ComponentPartOfIntegration=false, InitializationOptionalSetAComponentReference=CalRegn01IninOptSetA00
      5 x CommonComponent, all with ComponentPartOfIntegration=true:
        CalRegn01Cmn
        CalRegn01CmnGroupA
        CalRegn01CmnGroupD
        CalRegn01CmnGroupC
        CalRegn01CmnGroupB
    CalRegn02 (CalRegions)
      16 x RuntimeComponent:
        CalRegn02Rt00: ComponentPartOfIntegration=true
        CalRegn02Rt{01..03}: ComponentPartOfIntegration=false, RuntimeComponentReference=CalRegn02Rt00
        CalRegn02Rt00GroupA: ComponentPartOfIntegration=true
        CalRegn02Rt{01..03}GroupA: ComponentPartOfIntegration=false, RuntimeComponentReference=CalRegn02Rt00GroupA
        CalRegn02Rt00GroupD: ComponentPartOfIntegration=true
        CalRegn02Rt{01..03}GroupD: ComponentPartOfIntegration=false, RuntimeComponentReference=CalRegn02Rt00GroupD
        CalRegn02Rt00GroupC: ComponentPartOfIntegration=true
        CalRegn02Rt{01..03}GroupC: ComponentPartOfIntegration=false, RuntimeComponentReference=CalRegn02Rt00GroupC
    3 x OnlineCalibrationGroup:
      GroupA: GroupIndex=0, InitializationComponentReference=CalRegn01Inin00GroupA, InitializationComponentReference=CalRegn01Inin01GroupA, InitializationComponentReference=CalRegn01Inin02GroupA, InitializationComponentReference=CalRegn01Inin03GroupA, InitializationComponentReference=CalRegn01Inin04GroupA, InitializationComponentReference=CalRegn01Inin05GroupA, InitializationComponentReference=CalRegn01Inin06GroupA, CommonComponentReference=CalRegn01CmnGroupA, RuntimeComponentReference=CalRegn02Rt00GroupA, RuntimeComponentReference=CalRegn02Rt01GroupA, RuntimeComponentReference=CalRegn02Rt02GroupA, RuntimeComponentReference=CalRegn02Rt03GroupA
      GroupD: GroupIndex=1, InitializationComponentReference=CalRegn01Inin00GroupD, InitializationComponentReference=CalRegn01Inin01GroupD, InitializationComponentReference=CalRegn01Inin02GroupD, InitializationComponentReference=CalRegn01Inin03GroupD, InitializationComponentReference=CalRegn01Inin04GroupD, InitializationComponentReference=CalRegn01Inin05GroupD, InitializationComponentReference=CalRegn01Inin06GroupD, CommonComponentReference=CalRegn01CmnGroupD, RuntimeComponentReference=CalRegn02Rt00GroupD, RuntimeComponentReference=CalRegn02Rt01GroupD, RuntimeComponentReference=CalRegn02Rt02GroupD, RuntimeComponentReference=CalRegn02Rt03GroupD
      GroupC: GroupIndex=2, InitializationComponentReference=CalRegn01Inin00GroupC, InitializationComponentReference=CalRegn01Inin01GroupC, InitializationComponentReference=CalRegn01Inin02GroupC, InitializationComponentReference=CalRegn01Inin03GroupC, InitializationComponentReference=CalRegn01Inin04GroupC, InitializationComponentReference=CalRegn01Inin05GroupC, InitializationComponentReference=CalRegn01Inin06GroupC, CommonComponentReference=CalRegn01CmnGroupC, RuntimeComponentReference=CalRegn02Rt00GroupC, RuntimeComponentReference=CalRegn02Rt01GroupC, RuntimeComponentReference=CalRegn02Rt02GroupC, RuntimeComponentReference=CalRegn02Rt03GroupC
    XcpWriteAccess: EnableDevelopmentMode=STD_OFF
      XcpWriteAccessAllRAM (XcpWriteAccessRegions):
        StartingAddress = 4273864704
        EndingAddress = 4273995775
        UseSymbolName = false
        EnableForProduction = false
        StartingAddressSymbol = NULL_PTR
        EndingAddressSymbol = NULL_PTR
    GroupB (OnlineCalibrationGroup): GroupIndex=3, CommonComponentReference=CalRegn01CmnGroupB
