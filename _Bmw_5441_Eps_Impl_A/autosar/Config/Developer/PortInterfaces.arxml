[part 2 of 2: packages /Nexteer/PortInterfaces to /Systems/ModeDeclarationGroups/FunctionalPartialNetworks]
AUTOSAR XML (schema 4-2-2)
package /Nexteer/PortInterfaces
  262 x client server interface:
    ActvTunStsReq_PortIf1
      operation Oper
        5 x arg, all with type=uint8, direction=INOUT, server-argument-impl-policy=USE-ARGUMENT-TYPE:
          ActvRtIdx_Arg
          ActvIninIdx_Arg
          CalChgAllwd_Arg
          ActvGroup_Arg
          CalCopyCmpl_Arg
    ActvTunStsReq_PortIf2
      operation Oper
        6 x arg, all with type=uint8, direction=INOUT, server-argument-impl-policy=USE-ARGUMENT-TYPE:
          ActvRtIdx_Arg
          ActvIninIdx_Arg
          ActvIninOptSetAIdx_Arg
          CalChgAllwd_Arg
          ActvGroup_Arg
          CalCopyCmpl_Arg
    Adc1CfgAndUseAdc1EnaCnvn_PortIf1
      operation Oper
    Adc1CfgAndUseAdc1EnaCnvn1  # OBSOLETE
      operation Oper
    Adc1CfgAndUseAdc1EnaCnvn1_PortIf1
      operation Oper
    Adcf1EnaCnvn_PortIf1
      operation Oper
    AdcScanGroupCfg_PortIf1
      operation Oper
        arg StrtPtr_Arg: type=uint8, direction=IN, server-argument-impl-policy=USE-ARGUMENT-TYPE
        arg EndPtr_Arg: type=uint8, direction=IN, server-argument-impl-policy=USE-ARGUMENT-TYPE
    ApplSMBusOffBgn_PortIf1
      operation Oper: possible-error=ApplSMBusOffBgn_PortIf1/E_NOT_OK
        arg CanCh_Arg: type=boolean, direction=IN, server-argument-impl-policy=USE-ARGUMENT-TYPE
        arg ApplSMBusOffBgn_Arg: type=boolean, direction=OUT, server-argument-impl-policy=USE-ARGUMENT-TYPE
      error E_NOT_OK: error-code=1
    ApplSMBusOffEnd_PortIf1
      operation Oper: possible-error=ApplSMBusOffEnd_PortIf1/E_NOT_OK
        arg CanCh_Arg: type=boolean, direction=IN, server-argument-impl-policy=USE-ARGUMENT-TYPE
        arg ApplSMBusOffEnd_Arg: type=boolean, direction=OUT, server-argument-impl-policy=USE-ARGUMENT-TYPE
      error E_NOT_OK: error-code=1
    Calc16BitCrc_u08_PortIf1
      operation Oper: possible-error=Calc16BitCrc_u08_PortIf1/E_NOT_OK
        5 x arg, all with server-argument-impl-policy=USE-ARGUMENT-TYPE:
          DataPtr_Arg: type=uint8, direction=INOUT
          Len_Arg: type=uint32, direction=IN
          StrtVal_Arg: type=uint16, direction=IN
          FirstCall_Arg: type=boolean, direction=IN
          CalcCrcRes_Arg: type=uint16, direction=OUT
      error E_NOT_OK: error-code=1
    Calc16BitCrc_u16_PortIf1
      operation Oper: possible-error=Calc16BitCrc_u16_PortIf1/E_NOT_OK
        5 x arg, all with server-argument-impl-policy=USE-ARGUMENT-TYPE:
          DataPtr_Arg: type=uint16, direction=INOUT
          Len_Arg: type=uint32, direction=IN
          StrtVal_Arg: type=uint16, direction=IN
          FirstCall_Arg: type=boolean, direction=IN
          CalcCrcRes_Arg: type=uint16, direction=OUT
      error E_NOT_OK: error-code=1
    Calc32BitCrc_u08_PortIf1
      operation Oper: possible-error=Calc32BitCrc_u08_PortIf1/E_NOT_OK
        5 x arg, all with server-argument-impl-policy=USE-ARGUMENT-TYPE:
          DataPtr_Arg: type=uint8, direction=INOUT
          Len_Arg: type=uint32, direction=IN
          StrtVal_Arg: type=uint32, direction=IN
          FirstCall_Arg: type=boolean, direction=IN
          CalcCrcRes_Arg: type=uint32, direction=OUT
      error E_NOT_OK: error-code=1
    Calc32BitCrc_u16_PortIf1
      operation Oper: possible-error=Calc32BitCrc_u16_PortIf1/E_NOT_OK
        5 x arg, all with server-argument-impl-policy=USE-ARGUMENT-TYPE:
          DataPtr_Arg: type=uint16, direction=INOUT
          Len_Arg: type=uint32, direction=IN
          StrtVal_Arg: type=uint32, direction=IN
          FirstCall_Arg: type=boolean, direction=IN
          CalcCrcRes_Arg: type=uint32, direction=OUT
      error E_NOT_OK: error-code=1
    Calc32BitCrc_u32_PortIf1
      operation Oper: possible-error=Calc32BitCrc_u32_PortIf1/E_NOT_OK
        5 x arg, all with server-argument-impl-policy=USE-ARGUMENT-TYPE:
          DataPtr_Arg: type=uint32, direction=INOUT
          Len_Arg: type=uint32, direction=IN
          StrtVal_Arg: type=uint32, direction=IN
          FirstCall_Arg: type=boolean, direction=IN
          CalcCrcRes_Arg: type=uint32, direction=OUT
      error E_NOT_OK: error-code=1
    Calc8BitCrc_PortIf1
      operation Oper: possible-error=Calc8BitCrc_PortIf1/E_NOT_OK
        5 x arg, all with server-argument-impl-policy=USE-ARGUMENT-TYPE:
          DataPtr_Arg: type=uint8, direction=INOUT
          Len_Arg: type=uint32, direction=IN
          StrtVal_Arg: type=uint8, direction=IN
          FirstCall_Arg: type=boolean, direction=IN
          CalcCrcRes_Arg: type=uint8, direction=OUT
      error E_NOT_OK: error-code=1
    ChkForStrtUpTest_PortIf1
      operation Oper
        arg ExecStrtUpTest_Arg: type=boolean, direction=OUT, server-argument-impl-policy=USE-ARGUMENT-TYPE
    ClrAllDiagc_PortIf1
      operation Oper
    ClrBmwRackCentrToVehCentrOffs_PortIf1
      operation Oper
    ClrErrInjReg_PortIf1
      operation Oper
    ClrFricLrngOperMod_PortIf1
      operation Oper
    ClrHwAgTrimVal_PortIf1
      operation Oper
    ClrLtchCntrData_PortIf1
      operation Oper
    ClrSigStcHlthData_PortIf1
      operation Oper
        arg ClrTar_Arg: type=boolean, direction=IN, server-argument-impl-policy=USE-ARGUMENT-TYPE
    ClrSnpshtData_PortIf1
      operation Oper
    ClrVehCentrPosn_PortIf1
      operation Oper
    CnvSnpshtData_f32_PortIf1
      operation Oper
        arg SnpshtDataCnvd_Arg: type=uint32, direction=OUT, server-argument-impl-policy=USE-ARGUMENT-TYPE
        arg SnpshtData_Arg: type=float32, direction=IN, server-argument-impl-policy=USE-ARGUMENT-TYPE
    CnvSnpshtData_logl_PortIf1
      operation Oper
        arg SnpshtDataCnvd_Arg: type=uint32, direction=OUT, server-argument-impl-policy=USE-ARGUMENT-TYPE
        arg SnpshtData_Arg: type=boolean, direction=IN, server-argument-impl-policy=USE-ARGUMENT-TYPE
    CnvSnpshtData_s08_PortIf1
      operation Oper
        arg SnpshtDataCnvd_Arg: type=uint32, direction=OUT, server-argument-impl-policy=USE-ARGUMENT-TYPE
        arg SnpshtData_Arg: type=sint8, direction=IN, server-argument-impl-policy=USE-ARGUMENT-TYPE
    CnvSnpshtData_s16_PortIf1
      operation Oper
        arg SnpshtDataCnvd_Arg: type=uint32, direction=OUT, server-argument-impl-policy=USE-ARGUMENT-TYPE
        arg SnpshtData_Arg: type=sint16, direction=IN, server-argument-impl-policy=USE-ARGUMENT-TYPE
    CnvSnpshtData_s32_PortIf1
      operation Oper
        arg SnpshtDataCnvd_Arg: type=uint32, direction=OUT, server-argument-impl-policy=USE-ARGUMENT-TYPE
        arg SnpshtData_Arg: type=sint32, direction=IN, server-argument-impl-policy=USE-ARGUMENT-TYPE
    CnvSnpshtData_u08_PortIf1
      operation Oper
        arg SnpshtDataCnvd_Arg: type=uint32, direction=OUT, server-argument-impl-policy=USE-ARGUMENT-TYPE
        arg SnpshtData_Arg: type=uint8, direction=IN, server-argument-impl-policy=USE-ARGUMENT-TYPE
    CnvSnpshtData_u16_PortIf1
      operation Oper
        arg SnpshtDataCnvd_Arg: type=uint32, direction=OUT, server-argument-impl-policy=USE-ARGUMENT-TYPE
        arg SnpshtData_Arg: type=uint16, direction=IN, server-argument-impl-policy=USE-ARGUMENT-TYPE
    CopyCalPageReq_PortIf1
      operation Oper: possible-error=CopyCalPageReq_PortIf1/E_NOT_OK
        arg Seg_Arg: type=uint8, direction=IN, server-argument-impl-policy=USE-ARGUMENT-TYPE
      error E_NOT_OK: error-code=1
    CtrlErrOut_PortIf1
      operation Oper
        arg PinSt_Arg: type=boolean, direction=IN, server-argument-impl-policy=USE-ARGUMENT-TYPE
        arg TrigReg_Arg: type=TrigReg1, direction=IN, server-argument-impl-policy=USE-ARGUMENT-TYPE
    CurrMeasEolGainReq_PortIf1
      operation Oper
    CurrMeasEolGainStReq_PortIf1
      operation Oper
        arg CurrMeasEolGainSt_Arg: type=uint8, direction=OUT, server-argument-impl-policy=USE-ARGUMENT-TYPE
    CurrMeasEolOffsReq_PortIf1
      operation Oper
    CurrMeasEolOffsStReq_PortIf1
      operation Oper
        arg CurrMeasEolOffsSt_Arg: type=uint8, direction=OUT, server-argument-impl-policy=USE-ARGUMENT-TYPE
    CurrMeasGainReadReq_PortIf1
      operation Oper
        6 x arg, all with type=float32, direction=OUT, server-argument-impl-policy=USE-ARGUMENT-TYPE:
          CurrMeasMotCurrGainA_Arg
          CurrMeasMotCurrGainB_Arg
          CurrMeasMotCurrGainC_Arg
          CurrMeasMotCurrGainD_Arg
          CurrMeasMotCurrGainE_Arg
          CurrMeasMotCurrGainF_Arg
    CurrMeasGainReadReq_PortIf2
      operation Oper
        arg CurrMeasMotCurrGainA_Arg: type=float32, direction=OUT, server-argument-impl-policy=USE-ARGUMENT-TYPE
        arg CurrMeasMotCurrGainB_Arg: type=float32, direction=OUT, server-argument-impl-policy=USE-ARGUMENT-TYPE
        arg CurrMeasMotCurrGainC_Arg: type=float32, direction=OUT, server-argument-impl-policy=USE-ARGUMENT-TYPE
    CurrMeasGainReadReqSngIvtr_PortIf1
      operation Oper
        arg CurrMeasMotCurrGainA_Arg: type=float32, direction=OUT, server-argument-impl-policy=USE-ARGUMENT-TYPE
        arg CurrMeasMotCurrGainB_Arg: type=float32, direction=OUT, server-argument-impl-policy=USE-ARGUMENT-TYPE
        arg CurrMeasMotCurrGainC_Arg: type=float32, direction=OUT, server-argument-impl-policy=USE-ARGUMENT-TYPE
    CurrMeasGainWrReq_PortIf2
      operation Oper
        7 x arg, all with server-argument-impl-policy=USE-ARGUMENT-TYPE:
          CurrMeasMotCurrGainA_Arg: type=float32, direction=IN
          CurrMeasMotCurrGainB_Arg: type=float32, direction=IN
          CurrMeasMotCurrGainC_Arg: type=float32, direction=IN
          CurrMeasMotCurrGainD_Arg: type=float32, direction=IN
          CurrMeasMotCurrGainE_Arg: type=float32, direction=IN
          CurrMeasMotCurrGainF_Arg: type=float32, direction=IN
          CurrMeasGainWrReqSts_Arg: type=uint8, direction=OUT
    CurrMeasGainWrReq_PortIf3
      operation Oper
        4 x arg, all with server-argument-impl-policy=USE-ARGUMENT-TYPE:
          CurrMeasMotCurrGainA_Arg: type=float32, direction=IN
          CurrMeasMotCurrGainB_Arg: type=float32, direction=IN
          CurrMeasMotCurrGainC_Arg: type=float32, direction=IN
          CurrMeasGainWrReqSts_Arg: type=uint8, direction=OUT
    CurrMeasGainWrReqSngIvtr_PortIf1
      operation Oper
        4 x arg, all with server-argument-impl-policy=USE-ARGUMENT-TYPE:
          CurrMeasMotCurrGainA_Arg: type=float32, direction=IN
          CurrMeasMotCurrGainB_Arg: type=float32, direction=IN
          CurrMeasMotCurrGainC_Arg: type=float32, direction=IN
          CurrMeasGainWrReqSts_Arg: type=uint8, direction=OUT
    CurrMeasOffsReadReq_PortIf2
      operation Oper
        13 x arg, all with type=float32, direction=OUT, server-argument-impl-policy=USE-ARGUMENT-TYPE:
          CurrMeasEolOffsHiBrdgVltg_Arg
          CurrMeasMotCurrOffsDifA_Arg
          CurrMeasMotCurrOffsDifB_Arg
          CurrMeasMotCurrOffsDifC_Arg
          CurrMeasMotCurrOffsDifD_Arg
          CurrMeasMotCurrOffsDifE_Arg
          CurrMeasMotCurrOffsDifF_Arg
          CurrMeasMotCurrOffsLoAvrgA_Arg
          CurrMeasMotCurrOffsLoAvrgB_Arg
          CurrMeasMotCurrOffsLoAvrgC_Arg
          CurrMeasMotCurrOffsLoAvrgD_Arg
          CurrMeasMotCurrOffsLoAvrgE_Arg
          CurrMeasMotCurrOffsLoAvrgF_Arg
    CurrMeasOffsReadReq_PortIf3
      operation Oper
        arg MotCurrOffsZeroAvrgA_Arg: type=float32, direction=OUT, server-argument-impl-policy=USE-ARGUMENT-TYPE
        arg MotCurrOffsZeroAvrgB_Arg: type=float32, direction=OUT, server-argument-impl-policy=USE-ARGUMENT-TYPE
        arg MotCurrOffsZeroAvrgC_Arg: type=float32, direction=OUT, server-argument-impl-policy=USE-ARGUMENT-TYPE
    CurrMeasOffsReadReqSngIvtr_PortIf1
      operation Oper
        7 x arg, all with type=float32, direction=OUT, server-argument-impl-policy=USE-ARGUMENT-TYPE:
          CurrMeasEolOffsHiBrdgVltg_Arg
          CurrMeasMotCurrOffsDifA_Arg
          CurrMeasMotCurrOffsDifB_Arg
          CurrMeasMotCurrOffsDifC_Arg
          CurrMeasMotCurrOffsLoAvrgA_Arg
          CurrMeasMotCurrOffsLoAvrgB_Arg
          CurrMeasMotCurrOffsLoAvrgC_Arg
    CurrMeasOffsWrReq_PortIf3
      operation Oper
        14 x arg, all with server-argument-impl-policy=USE-ARGUMENT-TYPE:
          CurrMeasEolOffsHiBrdgVltg_Arg: type=float32, direction=IN
          CurrMeasMotCurrOffsDifA_Arg: type=float32, direction=IN
          CurrMeasMotCurrOffsDifB_Arg: type=float32, direction=IN
          CurrMeasMotCurrOffsDifC_Arg: type=float32, direction=IN
          CurrMeasMotCurrOffsDifD_Arg: type=float32, direction=IN
          CurrMeasMotCurrOffsDifE_Arg: type=float32, direction=IN
          CurrMeasMotCurrOffsDifF_Arg: type=float32, direction=IN
          CurrMeasMotCurrOffsLoAvrgA_Arg: type=float32, direction=IN
          CurrMeasMotCurrOffsLoAvrgB_Arg: type=float32, direction=IN
          CurrMeasMotCurrOffsLoAvrgC_Arg: type=float32, direction=IN
          CurrMeasMotCurrOffsLoAvrgD_Arg: type=float32, direction=IN
          CurrMeasMotCurrOffsLoAvrgE_Arg: type=float32, direction=IN
          CurrMeasMotCurrOffsLoAvrgF_Arg: type=float32, direction=IN
          CurrMeasOffsWrReqSts_Arg: type=uint8, direction=OUT
    CurrMeasOffsWrReq_PortIf4
      operation Oper
        arg MotCurrOffsZeroAvrgA_Arg: type=float32, direction=IN, server-argument-impl-policy=USE-ARGUMENT-TYPE
        arg MotCurrOffsZeroAvrgB_Arg: type=float32, direction=IN, server-argument-impl-policy=USE-ARGUMENT-TYPE
        arg MotCurrOffsZeroAvrgC_Arg: type=float32, direction=IN, server-argument-impl-policy=USE-ARGUMENT-TYPE
    CurrMeasOffsWrReqSngIvtr_PortIf1
      operation Oper
        8 x arg, all with server-argument-impl-policy=USE-ARGUMENT-TYPE:
          CurrMeasEolOffsHiBrdgVltg_Arg: type=float32, direction=IN
          CurrMeasMotCurrOffsDifA_Arg: type=float32, direction=IN
          CurrMeasMotCurrOffsDifB_Arg: type=float32, direction=IN
          CurrMeasMotCurrOffsDifC_Arg: type=float32, direction=IN
          CurrMeasMotCurrOffsLoAvrgA_Arg: type=float32, direction=IN
          CurrMeasMotCurrOffsLoAvrgB_Arg: type=float32, direction=IN
          CurrMeasMotCurrOffsLoAvrgC_Arg: type=float32, direction=IN
          CurrMeasOffsWrReqSts_Arg: type=uint8, direction=OUT
    DiagcMgrIninCore_PortIf3
      operation Oper
        5 x arg, all with server-argument-impl-policy=USE-ARGUMENT-TYPE:
          ApplIdx_Arg: type=uint8, direction=IN
          NtcInfoArySize_Arg: type=uint8, direction=IN
          NtcInfoAry_Arg: type=Ary1D_NtcInfoRec4_DiagcMgr, direction=INOUT
          DiagcData_Arg: type=DiagcDataRec2, direction=OUT
          ProxySetNtcData_Arg: type=DiagcDataRec2, direction=OUT
    DmaEna2MilliSecToMotCtrlTrf_PortIf1
      operation Oper
    DmaEna2MilliSecToMotCtrlTrf1  # OBSOLETE
      operation Oper
    DmaEna2MilliSecToMotCtrlTrf1_PortIf1
      operation Oper
    DmaEna2msToMotCtrlTrf_PortIf1
      operation Oper
    DmaWaitForMotCtrlTo2MilliSecTrf_PortIf1
      operation Oper: possible-error=DmaWaitForMotCtrlTo2MilliSecTrf_PortIf1/E_NOT_OK
      error E_NOT_OK: error-code=1
    DmaWaitForMotCtrlTo2MilliSecTrf1  # OBSOLETE
      operation Oper: possible-error=DmaWaitForMotCtrlTo2MilliSecTrf1/E_NOT_OK
      error E_NOT_OK: error-code=1
    DmaWaitForMotCtrlTo2MilliSecTrf1_PortIf1
      operation Oper: possible-error=DmaWaitForMotCtrlTo2MilliSecTrf1_PortIf1/E_NOT_OK
      error E_NOT_OK: error-code=1
    DmaWaitForMotCtrlTo2msTrf_PortIf1
      operation Oper: possible-error=DmaWaitForMotCtrlTo2msTrf_PortIf1/E_NOT_OK
      error E_NOT_OK: error-code=1
    FltInj_f32_PortIf1
      operation Oper
        arg SigPah_Arg: type=float32, direction=INOUT, server-argument-impl-policy=USE-ARGUMENT-TYPE
        arg LocnKey_Arg: type=uint16, direction=IN, server-argument-impl-policy=USE-ARGUMENT-TYPE
    FltInj_logl_PortIf1
      operation Oper
        arg SigPah_Arg: type=boolean, direction=INOUT, server-argument-impl-policy=USE-ARGUMENT-TYPE
        arg LocnKey_Arg: type=uint16, direction=IN, server-argument-impl-policy=USE-ARGUMENT-TYPE
    FltInj_u08_PortIf1
      operation Oper
        arg SigPah_Arg: type=uint8, direction=INOUT, server-argument-impl-policy=USE-ARGUMENT-TYPE
        arg LocnKey_Arg: type=uint16, direction=IN, server-argument-impl-policy=USE-ARGUMENT-TYPE
    FltInj_u0p16_PortIf1
      operation Oper
        arg SigPah_Arg: type=u0p16, direction=INOUT, server-argument-impl-policy=USE-ARGUMENT-TYPE
        arg LocnKey_Arg: type=uint16, direction=IN, server-argument-impl-policy=USE-ARGUMENT-TYPE
    FSnsrlsHwCentr_PortIf1
      operation Oper
    GetCalPageReq_PortIf1
      operation Oper
        4 x arg, all with type=uint8, server-argument-impl-policy=USE-ARGUMENT-TYPE:
          Seg_Arg: direction=IN
          Mod_Arg: direction=IN
          Page_Arg: direction=INOUT
          Rtn_Arg: direction=OUT
    GetCtrlPrm_PortIf1
      operation Oper
        7 x arg, all with type=float32, direction=OUT, server-argument-impl-policy=USE-ARGUMENT-TYPE:
          MotVelCtrlPropGain_Arg
          MotVelCtrlIntgtrGain_Arg
          MotVelCtrlDerivtvGain_Arg
          MotVelCtrlAntiWdupLim_Arg
          MotVelCtrlAntiWdupGain_Arg
          MotVelCtrlDerivtvLpFilTiCon_Arg
          MotVelCtrlTqCmdLim_Arg
    GetDiagcDataApplX_PortIf2
      operation Oper
        arg DiagcData_Arg: type=DiagcDataRec2, direction=OUT, server-argument-impl-policy=USE-ARGUMENT-TYPE
    GetFricData_PortIf3
      operation Oper
        5 x arg, all with direction=OUT, server-argument-impl-policy=USE-ARGUMENT-TYPE:
          FricOffs_Arg: type=float32
          BasLineFric_Arg: type=Ary1D_f32_4
          VehLrndFric_Arg: type=Ary1D_f32_4
          Hys_Arg: type=Ary2D_f32_8_4
          RngCntr_Arg: type=Ary2D_u16_8_3
    GetFricLrngData_PortIf1
      operation Oper
        4 x arg, all with direction=OUT, server-argument-impl-policy=USE-ARGUMENT-TYPE:
          FricLrngEna_Arg: type=boolean
          FricLrngOffsOutpEna_Arg: type=boolean
          FricLrngOperMod_Arg: type=SysFricLrngOperMod1
          EolFric_Arg: type=float32
    GetFricOffsOutpDi_PortIf1
      operation Oper
        arg FricOffsOutpDi_Arg: type=boolean, direction=OUT, server-argument-impl-policy=USE-ARGUMENT-TYPE
    GetGearIdn_PortIf1
      operation Oper
        arg GearIdn_Arg: type=uint8, direction=OUT, server-argument-impl-policy=USE-ARGUMENT-TYPE
    GetGmLoaIgnCntr_PortIf1
      operation Oper
        arg GmLoaIgnCntr_Arg: type=uint16, direction=OUT, server-argument-impl-policy=USE-ARGUMENT-TYPE
    GetGmSteerAgCtrlDiHist_PortIf1
      operation Oper
        arg GmSteerAgCtrlDiHist_Arg: type=Ary1D_GmSteerAgCtrlDiSt1_7, direction=OUT, server-argument-impl-policy=USE-ARGUMENT-TYPE
    GetGpio_PortIf1
      operation Oper: possible-error=GetGpio_PortIf1/E_NOT_OK
        arg PinSt_Arg: type=boolean, direction=OUT, server-argument-impl-policy=USE-ARGUMENT-TYPE
      error E_NOT_OK: error-code=1
    GetHwAgOffs_PortIf1
      operation Oper
        arg HwAgOffs_Arg: type=float32, direction=OUT, server-argument-impl-policy=USE-ARGUMENT-TYPE
        arg HwAgLrngStRst_Arg: type=boolean, direction=OUT, server-argument-impl-policy=USE-ARGUMENT-TYPE
    GetHwAgOverTrvlCnt_PortIf2
      operation Oper
        arg HwAgOverTrvlCnt_Arg: type=uint8, direction=OUT, server-argument-impl-policy=USE-ARGUMENT-TYPE
    GetHwAgTrimVal_PortIf2
      operation Oper
        arg HwAgTrimVal_Arg: type=float32, direction=OUT, server-argument-impl-policy=USE-ARGUMENT-TYPE
        arg HwAgTrimPrfmd_Arg: type=boolean, direction=OUT, server-argument-impl-policy=USE-ARGUMENT-TYPE
    GetHwTqOffs_PortIf1
      operation Oper
        arg HwTqOffs_Arg: type=float32, direction=OUT, server-argument-impl-policy=USE-ARGUMENT-TYPE
        arg HwTqLrngStRst_Arg: type=boolean, direction=OUT, server-argument-impl-policy=USE-ARGUMENT-TYPE
    GetMcuDiagcSpplData_PortIf1
      operation Oper
        arg McuDiagcData1_Arg: type=uint32, direction=OUT, server-argument-impl-policy=USE-ARGUMENT-TYPE
    GetMotAgMecl_PortIf1
      operation Oper
        arg MotAgMecl_Arg: type=u0p16, direction=OUT, server-argument-impl-policy=USE-ARGUMENT-TYPE
    GetMotCoggCmdPrm_PortIf1
      operation Oper
        arg MotCoggCmdY_Arg: type=Ary1D_s1p14_128, direction=OUT, server-argument-impl-policy=USE-ARGUMENT-TYPE
        arg Idx_Arg: type=uint8, direction=IN, server-argument-impl-policy=USE-ARGUMENT-TYPE
    GetMotPrmNomEol_PortIf1
      operation Oper
        arg MotBackEmfConNom_Arg: type=float32, direction=OUT, server-argument-impl-policy=USE-ARGUMENT-TYPE
        arg MotRNom_Arg: type=float32, direction=OUT, server-argument-impl-policy=USE-ARGUMENT-TYPE
    GetMotPrmNomEol1  # OBSELETE
      operation Oper: possible-error=GetMotPrmNomEol1/E_NOT_OK
        arg MotKeNom: type=MotCon1, direction=OUT, server-argument-impl-policy=USE-ARGUMENT-TYPE
        arg MotRNom: type=R6, direction=OUT, server-argument-impl-policy=USE-ARGUMENT-TYPE
      error E_NOT_OK: error-code=1
    GetMotPrmNomEol2
      operation Oper: possible-error=GetMotPrmNomEol2/E_NOT_OK
        arg MotBackEmfConNom_Arg: type=MotCon1, direction=OUT, server-argument-impl-policy=USE-ARGUMENT-TYPE
        arg MotRNom_Arg: type=R6, direction=OUT, server-argument-impl-policy=USE-ARGUMENT-TYPE
      error E_NOT_OK: error-code=1
    GetMotRplCoggPrm_PortIf1
      operation Oper
        9 x arg, all with direction=OUT, server-argument-impl-policy=USE-ARGUMENT-TYPE:
          CoggOrder1_Arg: type=uint16
          CoggOrder1X_Arg: type=s1p14
          CoggOrder1Y_Arg: type=s1p14
          CoggOrder2_Arg: type=uint16
          CoggOrder2X_Arg: type=s1p14
          CoggOrder2Y_Arg: type=s1p14
          CoggOrder3_Arg: type=uint16
          CoggOrder3X_Arg: type=s1p14
          CoggOrder3Y_Arg: type=s1p14
    GetMotTqCmdSca_PortIf1
      operation Oper
        arg MotTqCmdSca_Arg: type=float32, direction=OUT, server-argument-impl-policy=USE-ARGUMENT-TYPE
    GetNtcActv_PortIf1
      operation Oper: possible-error=GetNtcActv_PortIf1/E_NOT_OK
        arg NtcNr_Arg: type=NtcNr1, direction=IN, server-argument-impl-policy=USE-ARGUMENT-TYPE
        arg NtcActv_Arg: type=boolean, direction=OUT, server-argument-impl-policy=USE-ARGUMENT-TYPE
      error E_NOT_OK: error-code=1
    GetNtcActv1_PortIf1
      operation Oper: possible-error=GetNtcActv1_PortIf1/E_NOT_OK
        arg NtcNr: type=NtcNr1, direction=IN, server-argument-impl-policy=USE-ARGUMENT-TYPE
        arg NtcActv: type=boolean, direction=OUT, server-argument-impl-policy=USE-ARGUMENT-TYPE
      error E_NOT_OK: error-code=1
    GetNtcActvCore_PortIf1
      operation Oper
        arg NtcNr_Arg: type=NtcNr1, direction=IN, server-argument-impl-policy=USE-ARGUMENT-TYPE
        arg NtcActv_Arg: type=boolean, direction=OUT, server-argument-impl-policy=USE-ARGUMENT-TYPE
    GetNtcDebCntrApplX_PortIf1
      operation Oper
        arg DebCntrIdx_Arg: type=uint8, direction=IN, server-argument-impl-policy=USE-ARGUMENT-TYPE
        arg DebCntr_Arg: type=sint16, direction=OUT, server-argument-impl-policy=USE-ARGUMENT-TYPE
    GetNtcInfoApplX_PortIf2
      operation Oper
        arg NtcInfoIdx_Arg: type=uint8, direction=IN, server-argument-impl-policy=USE-ARGUMENT-TYPE
        arg NtcInfo_Arg: type=NtcInfoRec4, direction=OUT, server-argument-impl-policy=USE-ARGUMENT-TYPE
    GetNtcQlfrSts_PortIf1
      operation Oper: possible-error=GetNtcQlfrSts_PortIf1/E_NOT_OK
        arg NtcNr_Arg: type=NtcNr1, direction=IN, server-argument-impl-policy=USE-ARGUMENT-TYPE
        arg NtcQlfr_Arg: type=SigQlfr1, direction=OUT, server-argument-impl-policy=USE-ARGUMENT-TYPE
      error E_NOT_OK: error-code=1
    GetNtcQlfrSts1_PortIf1  # OBSOLETE
      operation Oper: possible-error=GetNtcQlfrSts1_PortIf1/E_NOT_OK
        arg NtcNr: type=NtcNr1, direction=IN, server-argument-impl-policy=USE-ARGUMENT-TYPE
        arg NtcQlfr: type=SigQlfr1, direction=OUT, server-argument-impl-policy=USE-ARGUMENT-TYPE
      error E_NOT_OK: error-code=1
    GetNtcQlfrStsCore_PortIf1
      operation Oper
        arg NtcNr_Arg: type=NtcNr1, direction=IN, server-argument-impl-policy=USE-ARGUMENT-TYPE
        arg NtcQlfr_Arg: type=SigQlfr1, direction=OUT, server-argument-impl-policy=USE-ARGUMENT-TYPE
    GetNtcSts_PortIf1
      operation Oper: possible-error=GetNtcSts_PortIf1/E_NOT_OK
        arg NtcNr_Arg: type=NtcNr1, direction=IN, server-argument-impl-policy=USE-ARGUMENT-TYPE
        arg NtcInfoSts_Arg: type=uint8, direction=OUT, server-argument-impl-policy=USE-ARGUMENT-TYPE
      error E_NOT_OK: error-code=1
    GetNtcSts1_PortIf1
      operation Oper: possible-error=GetNtcSts1_PortIf1/E_NOT_OK
        arg NtcNr: type=NtcNr1, direction=IN, server-argument-impl-policy=USE-ARGUMENT-TYPE
        arg NtcInfoSts: type=uint8, direction=OUT, server-argument-impl-policy=USE-ARGUMENT-TYPE
      error E_NOT_OK: error-code=1
    GetNtcStsCore_PortIf1
      operation Oper
        arg NtcNr_Arg: type=NtcNr1, direction=IN, server-argument-impl-policy=USE-ARGUMENT-TYPE
        arg NtcInfoSts_Arg: type=uint8, direction=OUT, server-argument-impl-policy=USE-ARGUMENT-TYPE
    GetPullCmpPrm_PortIf1
      operation Oper
        4 x arg, all with direction=OUT, server-argument-impl-policy=USE-ARGUMENT-TYPE:
          PullCmpCmdTot_Arg: type=float32
          PullCmpShoTerm_Arg: type=float32
          PullCmpLongTerm_Arg: type=float32
          LrngEnad_Arg: type=boolean
    GetRefTmr100MicroSec32bit_PortIf1
      operation Oper
        arg RefTmr_Arg: type=uint32, direction=OUT, server-argument-impl-policy=USE-ARGUMENT-TYPE
    GetRefTmr100MicroSec32bit1
      operation Oper
        arg RefTmr: type=uint32, direction=OUT, server-argument-impl-policy=USE-ARGUMENT-TYPE
    GetRefTmr1MicroSec32bit_PortIf1
      operation Oper
        arg RefTmr_Arg: type=uint32, direction=OUT, server-argument-impl-policy=USE-ARGUMENT-TYPE
    GetRefTmr1MicroSec32bit1
      operation Oper
        arg RefTmr: type=uint32, direction=OUT, server-argument-impl-policy=USE-ARGUMENT-TYPE
    GetSegInfoReq_PortIf2
      operation Oper
        7 x arg, all with server-argument-impl-policy=USE-ARGUMENT-TYPE:
          Mod_Arg: type=GetSegMod1, direction=IN
          Seg_Arg: type=uint8, direction=IN
          SegInfo_Arg: type=uint8, direction=IN
          MpgIdx_Arg: type=uint8, direction=IN
          Resp_Arg: type=uint8, direction=INOUT
          RespLen_Arg: type=uint8, direction=INOUT
          Rtn_Arg: type=uint8, direction=OUT
    GetTiSpan100MicroSec32bit_PortIf1
      operation Oper
        arg RefTmr_Arg: type=uint32, direction=IN, server-argument-impl-policy=USE-ARGUMENT-TYPE
        arg TiSpan_Arg: type=uint32, direction=OUT, server-argument-impl-policy=USE-ARGUMENT-TYPE
    GetTiSpan100MicroSec32bit1
      operation Oper
        arg RefTmr: type=uint32, direction=IN, server-argument-impl-policy=USE-ARGUMENT-TYPE
        arg TiSpan: type=uint32, direction=OUT, server-argument-impl-policy=USE-ARGUMENT-TYPE
    GetTiSpan1MicroSec32bit_PortIf1
      operation Oper
        arg RefTmr_Arg: type=uint32, direction=IN, server-argument-impl-policy=USE-ARGUMENT-TYPE
        arg TiSpan_Arg: type=uint32, direction=OUT, server-argument-impl-policy=USE-ARGUMENT-TYPE
    GetTiSpan1MicroSec32bit1  # OBSOLETE
      operation Oper
        arg RefTmr: type=uint32, direction=IN, server-argument-impl-policy=USE-ARGUMENT-TYPE
        arg TiSpan: type=uint32, direction=OUT, server-argument-impl-policy=USE-ARGUMENT-TYPE
    GetTxRateGroup_PortIf1
      operation Oper: possible-error=GetTxRateGroup_PortIf1/E_NOT_OK
        arg RateGroup_Arg: type=uint8, direction=IN, server-argument-impl-policy=USE-ARGUMENT-TYPE
        arg Buf_Arg: type=uint8, direction=OUT, server-argument-impl-policy=USE-ARGUMENT-TYPE
      error E_NOT_OK: error-code=1
    GetTxSigGroup_PortIf1
      operation Oper: possible-error=GetTxSigGroup_PortIf1/E_NOT_OK
        arg SigGroupId_Arg: type=uint8, direction=IN, server-argument-impl-policy=USE-ARGUMENT-TYPE
        arg Buf_Arg: type=uint8, direction=OUT, server-argument-impl-policy=USE-ARGUMENT-TYPE
      error E_NOT_OK: error-code=1
    GetYawRateOffs_PortIf1
      operation Oper
        arg VehYawRateOffs_Arg: type=float32, direction=OUT, server-argument-impl-policy=USE-ARGUMENT-TYPE
        arg VehYawRateLrngStRst_Arg: type=boolean, direction=OUT, server-argument-impl-policy=USE-ARGUMENT-TYPE
    GmFctDiReq_PortIf1
      operation Oper
    GtmGetSentData_PortIf1  # OBSOLETE
      operation Oper: possible-error=GtmGetSentData_PortIf1/E_NOT_OK
        arg BufStrtAdr_Arg: type=uint32, direction=INOUT, server-argument-impl-policy=USE-ARGUMENT-TYPE
      error E_NOT_OK: error-code=1
    GtmGetSentData_PortIf2
      operation Oper: possible-error=GtmGetSentData_PortIf2/E_NOT_OK
        arg BufStrt_Arg: type=uint32, direction=OUT, server-argument-impl-policy=USE-ARGUMENT-TYPE
      error E_NOT_OK: error-code=1
    HwAg0ClrLtch_PortIf1
      operation Oper
    HwAg0MeasHwAg0AutoTrim1  # OBSOLETE
      operation Oper
    HwAg0MeasHwAg0ClrTrim1  # OBSOLETE
      operation Oper
    HwAg0MeasHwAg0ReadTrim2  # OBSOLETE
      operation Oper
        arg HwAg0MeasHwAg0WrOffsTrimData: type=Ag19, direction=OUT, server-argument-impl-policy=USE-ARGUMENT-TYPE
    HwAg0MeasHwAg0TrimPrfmdSts2  # OBSOLETE
      operation Oper
        arg HwAg0MeasHwAg0OffsTrimPrfmdStsData: type=Logl1, direction=OUT, server-argument-impl-policy=USE-ARGUMENT-TYPE
    HwAg0MeasHwAg0WrTrim2  # OBSOLETE
      operation Oper
        arg HwAg0MeasHwAg0WrTrimData: type=Ag19, direction=IN, server-argument-impl-policy=USE-ARGUMENT-TYPE
    HwAg1ClrLtch_PortIf1
      operation Oper
    HwAg1MeasHwAg1AutoTrim1  # OBSOLETE
      operation Oper
    HwAg1MeasHwAg1ClrTrim1  # OBSOLETE
      operation Oper
    HwAg1MeasHwAg1ReadTrim2  # OBSOLETE
      operation Oper
        arg HwAg1MeasHwAg1WrOffsTrimData: type=Ag19, direction=OUT, server-argument-impl-policy=USE-ARGUMENT-TYPE
    HwAg1MeasHwAg1TrimPrfmdSts2  # OBSOLETE
      operation Oper
        arg HwAg1MeasHwAg1OffsTrimPrfmdStsData: type=Logl1, direction=OUT, server-argument-impl-policy=USE-ARGUMENT-TYPE
    HwAg1MeasHwAg1WrTrim2  # OBSOLETE
      operation Oper
        arg HwAg1MeasHwAg1WrTrimData: type=Ag19, direction=IN, server-argument-impl-policy=USE-ARGUMENT-TYPE
    HwAgAutTrim_PortIf1
      operation Oper
    HwAgClrLtch_PortIf1
      operation Oper
    HwAgClrTrim_PortIf1
      operation Oper
    HwAgReadTrim_PortIf1
      operation Oper
        arg HwAgReadTrimData_Arg: type=float32, direction=OUT, server-argument-impl-policy=USE-ARGUMENT-TYPE
    HwAgTrimPrfmdSts_PortIf1
      operation Oper
        arg HwAgOffsTrimPrfmdStsData_Arg: type=boolean, direction=OUT, server-argument-impl-policy=USE-ARGUMENT-TYPE
    HwAgWrTrim_PortIf1
      operation Oper
        arg HwAgWrOffsTrimData_Arg: type=float32, direction=IN, server-argument-impl-policy=USE-ARGUMENT-TYPE
    HwTq0MeasHwTq0AutTrim_PortIf1  # OBSOLETE
      operation Oper
    HwTq0MeasHwTq0ClrTrim_PortIf1  # OBSOLETE
      operation Oper
    HwTq0MeasHwTq0ReadTrim_PortIf1  # OBSOLETE
      operation Oper
        arg HwTq0MeasHwTq0ReadTrimData_Arg: type=float32, direction=OUT, server-argument-impl-policy=USE-ARGUMENT-TYPE
    HwTq0MeasHwTq0TrimPrfmdSts_PortIf1  # OBSOLETE
      operation Oper
        arg HwTq0MeasHwTq0OffsTrimPrfmdStsData_Arg: type=boolean, direction=OUT, server-argument-impl-policy=USE-ARGUMENT-TYPE
    HwTq0MeasHwTq0WrTrim_PortIf1  # OBSOLETE
      operation Oper
        arg HwTq0MeasHwTq0WrOffsTrimData_Arg: type=float32, direction=IN, server-argument-impl-policy=USE-ARGUMENT-TYPE
    HwTq1MeasHwTq1AutTrim_PortIf1  # OBSOLETE
      operation Oper
    HwTq1MeasHwTq1ClrTrim_PortIf1  # OBSOLETE
      operation Oper
    HwTq1MeasHwTq1ReadTrim_PortIf1  # OBSOLETE
      operation Oper
        arg HwTq1MeasHwTq1ReadTrimData_Arg: type=float32, direction=OUT, server-argument-impl-policy=USE-ARGUMENT-TYPE
    HwTq1MeasHwTq1TrimPrfmdSts_PortIf1  # OBSOLETE
      operation Oper
        arg HwTq1MeasHwTq1OffsTrimPrfmdStsData_Arg: type=boolean, direction=OUT, server-argument-impl-policy=USE-ARGUMENT-TYPE
    HwTq1MeasHwTq1WrTrim_PortIf1  # OBSOLETE
      operation Oper
        arg HwTq1MeasHwTq1WrOffsTrimData_Arg: type=float32, direction=IN, server-argument-impl-policy=USE-ARGUMENT-TYPE
    HwTq2MeasHwTq2AutTrim_PortIf1  # OBSOLETE
      operation Oper
    HwTq2MeasHwTq2ClrTrim_PortIf1  # OBSOLETE
      operation Oper
    HwTq2MeasHwTq2ReadTrim_PortIf1  # OBSOLETE
      operation Oper
        arg HwTq2MeasHwTq2ReadTrimData_Arg: type=float32, direction=OUT, server-argument-impl-policy=USE-ARGUMENT-TYPE
    HwTq2MeasHwTq2TrimPrfmdSts_PortIf1  # OBSOLETE
      operation Oper
        arg HwTq2MeasHwTq2OffsTrimPrfmdStsData_Arg: type=boolean, direction=OUT, server-argument-impl-policy=USE-ARGUMENT-TYPE
    HwTq2MeasHwTq2WrTrim_PortIf1  # OBSOLETE
      operation Oper
        arg HwTq2MeasHwTq2WrOffsTrimData_Arg: type=float32, direction=IN, server-argument-impl-policy=USE-ARGUMENT-TYPE
    HwTq3MeasHwTq3AutTrim_PortIf1  # OBSOLETE
      operation Oper
    HwTq3MeasHwTq3ClrTrim_PortIf1  # OBSOLETE
      operation Oper
    HwTq3MeasHwTq3ReadTrim_PortIf1  # OBSOLETE
      operation Oper
        arg HwTq3MeasHwTq3ReadTrimData_Arg: type=float32, direction=OUT, server-argument-impl-policy=USE-ARGUMENT-TYPE
    HwTq3MeasHwTq3TrimPrfmdSts_PortIf1  # OBSOLETE
      operation Oper
        arg HwTq3MeasHwTq3OffsTrimPrfmdStsData_Arg: type=boolean, direction=OUT, server-argument-impl-policy=USE-ARGUMENT-TYPE
    HwTq3MeasHwTq3WrTrim_PortIf1  # OBSOLETE
      operation Oper
        arg HwTq3MeasHwTq3WrOffsTrimData_Arg: type=float32, direction=IN, server-argument-impl-policy=USE-ARGUMENT-TYPE
    HwTqClrSnsrSca_PortIf1
      operation Oper
    HwTqMeasHwTqAutTrim_PortIf1
      operation Oper
    HwTqMeasHwTqClrTrim_PortIf1
      operation Oper
    HwTqMeasHwTqReadTrim_PortIf1
      operation Oper
        arg HwTqReadTrimData_Arg: type=float32, direction=OUT, server-argument-impl-policy=USE-ARGUMENT-TYPE
    HwTqMeasHwTqTrimPrfmdSts_PortIf1
      operation Oper
        arg HwTqOffsTrimPrfmdStsData_Arg: type=boolean, direction=OUT, server-argument-impl-policy=USE-ARGUMENT-TYPE
    HwTqMeasHwTqWrTrim_PortIf1
      operation Oper
        arg HwTqWrOffsTrimData_Arg: type=float32, direction=IN, server-argument-impl-policy=USE-ARGUMENT-TYPE
    HwTqReadSnsrSca_PortIf2
      operation Oper
        arg HwTqReadScaData_Arg: type=float32, direction=OUT, server-argument-impl-policy=USE-ARGUMENT-TYPE
    HwTqSnsrScaPrfmdSts_PortIf1
      operation Oper
        arg HwTqScaPrfmdStsData_Arg: type=boolean, direction=OUT, server-argument-impl-policy=USE-ARGUMENT-TYPE
    HwTqWrSnsrSca_PortIf1
      operation Oper
        arg HwTqScaVal_Arg: type=float32, direction=IN, server-argument-impl-policy=USE-ARGUMENT-TYPE
    InitFricLrngTbl_PortIf1
      operation Oper
    MCalReadVrfyFailFltInfo_PortIf1
      operation Oper
        arg PrphlId_Arg: type=uint8, direction=IN, server-argument-impl-policy=USE-ARGUMENT-TYPE
        arg ErrId_Arg: type=uint16, direction=IN, server-argument-impl-policy=USE-ARGUMENT-TYPE
    MeasTrigStrt_PortIf1
      operation Oper
    MotAg0MeasMotAg0CorrnTblClr1_PortIf1
      operation Oper
    MotAg0SnsrCfgDmaStrt_PortIf2
      operation Oper: possible-error=MotAg0SnsrCfgDmaStrt_PortIf2/E_NOT_OK
      error E_NOT_OK: error-code=1
    MotAg1MeasMotAg1CorrnTblClr1_PortIf1
      operation Oper
    MotAgCmpBackEmfRead_PortIf1
      operation Oper
        arg MotAgBackEmfRead_Arg: type=u0p16, direction=OUT, server-argument-impl-policy=USE-ARGUMENT-TYPE
    MotAgCmpBackEmfRead1  # OBSELETE
      operation Oper: possible-error=MotAgCmpBackEmfRead1/E_NOT_OK
        arg MotAgBackEmfRead: type=Ag9, direction=OUT, server-argument-impl-policy=USE-ARGUMENT-TYPE
      error E_NOT_OK: error-code=1
    MotAgCmpBackEmfRead2  # OBSELETE
      operation Oper
        arg MotAgBackEmfRead: type=Ag9, direction=OUT, server-argument-impl-policy=USE-ARGUMENT-TYPE
    MotAgCmpBackEmfWr_PortIf1
      operation Oper
        arg MotAgCmpBackEmfWrData_Arg: type=u0p16, direction=IN, server-argument-impl-policy=USE-ARGUMENT-TYPE
    MotAgCmpBackEmfWr1
      operation Oper: possible-error=MotAgCmpBackEmfWr1/E_NOT_OK
        arg MotAgCmpBackEmfWrData: type=Ag9, direction=IN, server-argument-impl-policy=USE-ARGUMENT-TYPE
      error E_NOT_OK: error-code=1
    MotAgEolPrmRead_PortIf1
      operation Oper
        arg MotAgEolPrmData_Arg: type=MotAgEolPrmRec1, direction=OUT, server-argument-impl-policy=USE-ARGUMENT-TYPE
    MotAgEolPrmWr_PortIf1
      operation Oper
        arg MotAgEolPrmData_Arg: type=MotAgEolPrmRec1, direction=IN, server-argument-impl-policy=USE-ARGUMENT-TYPE
    MotAgMeasEolPrmRead_PortIf2
      operation Oper
        arg MotAgEolPrmRead_Arg: type=MotAgMeasEolPrmRec1, direction=OUT, server-argument-impl-policy=USE-ARGUMENT-TYPE
    MotAgMeasEolPrmWr_PortIf2
      operation Oper
        arg MotAgSinCosEolCalData_Arg: type=MotAgMeasEolPrmRec1, direction=IN, server-argument-impl-policy=USE-ARGUMENT-TYPE
    MotAgMeasMotAgCoeffTblRead_PortIf1
      operation Oper
        arg MotAgCoeffTbl_Arg: type=Ary1D_f32_26, direction=OUT, server-argument-impl-policy=USE-ARGUMENT-TYPE
    MotAgMeasMotAgCoeffTblWr_PortIf1
      operation Oper
        arg MotAgCoeffTbl_Arg: type=Ary1D_f32_26, direction=IN, server-argument-impl-policy=USE-ARGUMENT-TYPE
    MotVrntRead_PortIf1
      operation Oper: possible-error=MotVrntRead_PortIf1/E_NOT_OK
        arg BmwDesIninOptSetAIdx_Arg: type=uint8, direction=OUT, server-argument-impl-policy=USE-ARGUMENT-TYPE
      error E_NOT_OK: error-code=1
    MotVrntWr_PortIf1
      operation Oper: possible-error=MotVrntWr_PortIf1/E_NOT_OK
        arg BmwDesIninOptSetAIdx_Arg: type=uint8, direction=IN, server-argument-impl-policy=USE-ARGUMENT-TYPE
      error E_NOT_OK: error-code=1
    NxtrCalIdsCalDevlpRd_PortIf1
      operation Oper: possible-error=NxtrCalIdsCalDevlpRd_PortIf1/E_NOT_OK
        5 x arg, all with server-argument-impl-policy=USE-ARGUMENT-TYPE:
          CalRegn: type=uint8, direction=IN
          CalAuthor: type=Ary1D_u8_6, direction=OUT
          CalVers: type=uint8, direction=OUT
          CalTiStamp: type=uint32, direction=OUT
          CalDescr: type=Ary1D_u8_48, direction=OUT
      error E_NOT_OK: error-code=1
    NxtrCalIdsCalRelRd_PortIf1
      operation Oper
        arg CalRegn: type=uint8, direction=IN, server-argument-impl-policy=USE-ARGUMENT-TYPE
        arg RelNr: type=uint32, direction=OUT, server-argument-impl-policy=USE-ARGUMENT-TYPE
        arg RelSt: type=uint8, direction=OUT, server-argument-impl-policy=USE-ARGUMENT-TYPE
    NxtrSwIdsPsrInfoRd_PortIf1
      operation Oper: possible-error=NxtrSwIdsPsrInfoRd_PortIf1/E_NOT_OK
        arg PsrId: type=uint32, direction=OUT, server-argument-impl-policy=USE-ARGUMENT-TYPE
        arg PsrRev: type=uint8, direction=OUT, server-argument-impl-policy=USE-ARGUMENT-TYPE
      error E_NOT_OK: error-code=1
    NxtrSwIdsSwBuildDateTiRd_PortIf1
      operation Oper
        arg SwBuildDateTi: type=Ary1D_u8_20, direction=OUT, server-argument-impl-policy=USE-ARGUMENT-TYPE
    NxtrSwIdsSwRelInfoRd_PortIf1
      operation Oper
        arg SwOrigin: type=uint8, direction=OUT, server-argument-impl-policy=USE-ARGUMENT-TYPE
        arg SwAuthor: type=Ary1D_u8_6, direction=OUT, server-argument-impl-policy=USE-ARGUMENT-TYPE
    NxtrSwIdsSwRelNrRd_PortIf1
      operation Oper
        arg SwRelNr: type=Ary1D_u8_16, direction=OUT, server-argument-impl-policy=USE-ARGUMENT-TYPE
    NxtrSwIdsSwRelVerRd_PortIf1
      operation Oper
        arg SwRelVer: type=Ary1D_u8_16, direction=OUT, server-argument-impl-policy=USE-ARGUMENT-TYPE
    OnlineTunRamAdrMpg_PortIf1
      operation Oper: possible-error=OnlineTunRamAdrMpg_PortIf1/E_NOT_OK
        arg ReqAdr_Arg: type=uint32, direction=IN, server-argument-impl-policy=USE-ARGUMENT-TYPE
        arg CorrdAdr_Arg: type=uint32, direction=INOUT, server-argument-impl-policy=USE-ARGUMENT-TYPE
        arg ReqTyp_Arg: type=AdrMpgReqTyp1, direction=IN, server-argument-impl-policy=USE-ARGUMENT-TYPE
      error E_NOT_OK: error-code=1
    PartNrCustMfgEnaCntr_PortIf1
      operation Oper
        arg PartNrCustMfgEnaCnt_Arg: type=uint8, direction=OUT, server-argument-impl-policy=USE-ARGUMENT-TYPE
    PolarityCfgRead_PortIf1
      operation Oper: possible-error=PolarityCfgRead_PortIf1/E_NOT_OK
        arg PolarityCfgSaved_Arg: type=uint32, direction=OUT, server-argument-impl-policy=USE-ARGUMENT-TYPE
      error E_NOT_OK: error-code=1
    PolarityCfgRead1
      operation Oper: possible-error=PolarityCfgRead1/E_NOT_OK
        arg PolarityCfgSaved: type=Cnt15, direction=OUT, server-argument-impl-policy=USE-ARGUMENT-TYPE
      error E_NOT_OK: error-code=1
    PolarityCfgWr_PortIf1
      operation Oper: possible-error=PolarityCfgWr_PortIf1/E_NOT_OK
        arg PolarityCfgSaved_Arg: type=uint32, direction=IN, server-argument-impl-policy=USE-ARGUMENT-TYPE
      error E_NOT_OK: error-code=1
    PolarityCfgWr1
      operation Oper: possible-error=PolarityCfgWr1/E_NOT_OK
        arg PolarityCfgSaved: type=Cnt15, direction=IN, server-argument-impl-policy=USE-ARGUMENT-TYPE
      error E_NOT_OK: error-code=1
    PrphlVltgMonrStrtUpTestFlt_PortIf1
      operation Oper
    PwrTurnOffCtrl_PortIf1
      operation Oper
        arg PinSt_Arg: type=boolean, direction=IN, server-argument-impl-policy=USE-ARGUMENT-TYPE
    ReadErrInjReg_PortIf1
      operation Oper
        arg ErrId_Arg: type=uint32, direction=OUT, server-argument-impl-policy=USE-ARGUMENT-TYPE
    ReadLtchCntrData_PortIf1
      operation Oper
        arg ReadLtchCntrAry_Arg: type=Ary1D_u08_20, direction=OUT, server-argument-impl-policy=USE-ARGUMENT-TYPE
    ReadNtcFltAry_PortIf1
      operation Oper
        arg DiagcMgrReadFltInfo_Arg: type=Ary1D_ReadFltInfoRec1_20, direction=OUT, server-argument-impl-policy=USE-ARGUMENT-TYPE
    ReadNtcInfoAndDebCntr_PortIf1
      operation Oper
        arg NtcNr_Arg: type=NtcNr1, direction=IN, server-argument-impl-policy=USE-ARGUMENT-TYPE
        arg NtcInfo_Arg: type=NtcInfoRec4, direction=OUT, server-argument-impl-policy=USE-ARGUMENT-TYPE
        arg DebCntr_Arg: type=sint16, direction=OUT, server-argument-impl-policy=USE-ARGUMENT-TYPE
    ReadSnpshtData_PortIf1  # OBSOLETE
      operation Oper  # OBSOLETE
        arg ReadSnpshtDataAry_Arg: type=Ary1D_SnpshtDataRec1_8, direction=OUT, server-argument-impl-policy=USE-ARGUMENT-TYPE
    ReadSnpshtData_PortIf2
      operation Oper
        arg ReadSnpshtDataAry_Arg: type=Ary1D_SnpshtDataRec2_8, direction=OUT, server-argument-impl-policy=USE-ARGUMENT-TYPE
    ResvCrcHwUnit_PortIf1  # OBSOLETE
      operation Oper: possible-error=ResvCrcHwUnit_PortIf1/E_NOT_OK
        6 x arg, all with server-argument-impl-policy=USE-ARGUMENT-TYPE:
          Mod_Arg: type=CrcHwResvMod1, direction=IN
          CrcCfg_Arg: type=CrcHwResvCfg1, direction=IN
          CrcHwInRegAdr_Arg: type=uint32, direction=OUT
          CrcHwOutRegAdr_Arg: type=uint32, direction=OUT
          StrtVal_Arg: type=uint32, direction=IN
          ResvKey_Arg: type=uint16, direction=INOUT
      error E_NOT_OK: error-code=1
    ResvCrcHwUnit_PortIf2
      operation Oper: possible-error=ResvCrcHwUnit_PortIf2/E_NOT_OK
        6 x arg, all with server-argument-impl-policy=USE-ARGUMENT-TYPE:
          Mod_Arg: type=CrcHwResvMod1, direction=IN
          CrcCfg_Arg: type=CrcHwResvCfg1, direction=IN
          CrcHwInRegAdr_Arg: type=uint32, direction=OUT
          CrcHwOutRegAdr_Arg: type=uint32, direction=OUT
          StrtVal_Arg: type=uint32, direction=IN
          ResvKey_Arg: type=uint32, direction=INOUT
      error E_NOT_OK: error-code=1
    RstHwAgOverTrvlCnt_PortIf1
      operation Oper
    RstHwTq_PortIf1
      operation Oper
    RstMaxHwAgCwAndCcw_PortIf1
      operation Oper
    RstPullCmp_PortIf1
      operation Oper
    RstRackCentrMotAg_PortIf1
      operation Oper
    RstRackCentrMotRev_PortIf1
      operation Oper
    RstSnsrlsHwCentr_PortIf1
      operation Oper
    RstYawAndAg_PortIf1
      operation Oper
    RtCalChgReq_PortIf1
      operation Oper: possible-error=RtCalChgReq_PortIf1/E_NOT_OK
      error E_NOT_OK: error-code=1
    RtnMaxHwAgCwAndCcw_PortIf1
      operation Oper
        arg HwAgCcwMax_Arg: type=float32, direction=OUT, server-argument-impl-policy=USE-ARGUMENT-TYPE
        arg HwAgCwMax_Arg: type=float32, direction=OUT, server-argument-impl-policy=USE-ARGUMENT-TYPE
    SerlComInpProxyGmLanIdRd_PortIf1
      operation Oper
        arg GmLanId_Arg: type=Ary1D_u08_12, direction=OUT, server-argument-impl-policy=USE-ARGUMENT-TYPE
    SerlComRstEot_PortIf1
      operation Oper
    SetCalPageReq_PortIf1
      operation Oper
        arg Seg_Arg: type=uint8, direction=IN, server-argument-impl-policy=USE-ARGUMENT-TYPE
        arg Mod_Arg: type=uint8, direction=IN, server-argument-impl-policy=USE-ARGUMENT-TYPE
        arg Page_Arg: type=uint8, direction=IN, server-argument-impl-policy=USE-ARGUMENT-TYPE
    SetCtrlPrm_PortIf1
      operation Oper
        7 x arg, all with type=float32, direction=IN, server-argument-impl-policy=USE-ARGUMENT-TYPE:
          MotVelCtrlPropGain_Arg
          MotVelCtrlIntgtrGain_Arg
          MotVelCtrlDerivtvGain_Arg
          MotVelCtrlAntiWdupLim_Arg
          MotVelCtrlAntiWdupGain_Arg
          MotVelCtrlDerivtvLpFilTiCon_Arg
          MotVelCtrlTqCmdLim_Arg
    SetFctGpio_PortIf1
      operation Oper: possible-error=SetFctGpio_PortIf1/E_NOT_OK
      error E_NOT_OK: error-code=1
    SetFctPeriph_PortIf1
      operation Oper: possible-error=SetFctPeriph_PortIf1/E_NOT_OK
      error E_NOT_OK: error-code=1
    SetFricData_PortIf3
      operation Oper
        5 x arg, all with direction=IN, server-argument-impl-policy=USE-ARGUMENT-TYPE:
          FricOffs_Arg: type=float32
          BasLineFric_Arg: type=Ary1D_f32_4
          VehLrndFric_Arg: type=Ary1D_f32_4
          Hys_Arg: type=Ary2D_f32_8_4
          RngCntr_Arg: type=Ary2D_u16_8_3
    SetFricLrngData_PortIf1
      operation Oper
        4 x arg, all with direction=IN, server-argument-impl-policy=USE-ARGUMENT-TYPE:
          FricLrngEna_Arg: type=boolean
          FricLrngOffsOutpEna_Arg: type=boolean
          FricLrngOperMod_Arg: type=SysFricLrngOperMod1
          EolFric_Arg: type=float32
    SetFricOffsOutpDi_PortIf1
      operation Oper
        arg FricOffsOutpDi_Arg: type=boolean, direction=IN, server-argument-impl-policy=USE-ARGUMENT-TYPE
    SetGmLoaIgnCntr_PortIf1
      operation Oper
        arg GmLoaIgnCntr_Arg: type=uint16, direction=IN, server-argument-impl-policy=USE-ARGUMENT-TYPE
    SetGpio_PortIf1
      operation Oper: possible-error=SetGpio_PortIf1/E_NOT_OK
        arg PinSt_Arg: type=boolean, direction=IN, server-argument-impl-policy=USE-ARGUMENT-TYPE
      error E_NOT_OK: error-code=1
    SetHwAgOffs_PortIf1
      operation Oper
        arg HwAgOffs_Arg: type=float32, direction=IN, server-argument-impl-policy=USE-ARGUMENT-TYPE
        arg HwAgLrngStRst_Arg: type=boolean, direction=IN, server-argument-impl-policy=USE-ARGUMENT-TYPE
    SetHwAgOverTrvlCnt_PortIf2
      operation Oper
        arg HwAgOverTrvlCnt_Arg: type=uint8, direction=IN, server-argument-impl-policy=USE-ARGUMENT-TYPE
    SetHwAgTrimVal_PortIf2
      operation Oper
        arg HwAgTrimVal_Arg: type=float32, direction=IN, server-argument-impl-policy=USE-ARGUMENT-TYPE
        arg HwAgTrimPrfmd_Arg: type=boolean, direction=IN, server-argument-impl-policy=USE-ARGUMENT-TYPE
    SetHwTqOffs_PortIf1
      operation Oper
        arg HwTqOffs_Arg: type=float32, direction=IN, server-argument-impl-policy=USE-ARGUMENT-TYPE
        arg HwTqLrngStRst_Arg: type=boolean, direction=IN, server-argument-impl-policy=USE-ARGUMENT-TYPE
    SetInpPrm_PortIf1
      operation Oper
        arg TarVel_Arg: type=float32, direction=IN, server-argument-impl-policy=USE-ARGUMENT-TYPE
        arg TarA_Arg: type=float32, direction=IN, server-argument-impl-policy=USE-ARGUMENT-TYPE
    SetManTqCmd_PortIf1
      operation Oper: possible-error=SetManTqCmd_PortIf1/E_NOT_OK
        arg ManTqCmd_Arg: type=float32, direction=IN, server-argument-impl-policy=USE-ARGUMENT-TYPE
        arg ManTqCmdEna_Arg: type=boolean, direction=IN, server-argument-impl-policy=USE-ARGUMENT-TYPE
      error E_NOT_OK: error-code=1
    SetManTqCmd1
      operation Oper: possible-error=SetManTqCmd1/E_NOT_OK
        arg ManTqCmd: type=Tq1, direction=IN, server-argument-impl-policy=USE-ARGUMENT-TYPE
        arg ManTqCmdEna: type=boolean, direction=IN, server-argument-impl-policy=USE-ARGUMENT-TYPE
      error E_NOT_OK: error-code=1
    SetMotCoggCmdPrm_PortIf1
      operation Oper
        arg MotCoggCmdY_Arg: type=Ary1D_s1p14_128, direction=IN, server-argument-impl-policy=USE-ARGUMENT-TYPE
        arg Idx_Arg: type=uint8, direction=IN, server-argument-impl-policy=USE-ARGUMENT-TYPE
    SetMotPrmNomEol_PortIf1
      operation Oper
        arg MotBackEmfConNom_Arg: type=float32, direction=IN, server-argument-impl-policy=USE-ARGUMENT-TYPE
        arg MotRNom_Arg: type=float32, direction=IN, server-argument-impl-policy=USE-ARGUMENT-TYPE
    SetMotPrmNomEol1  # OBSELETE
      operation Oper: possible-error=SetMotPrmNomEol1/E_NOT_OK
        arg MotKeNom: type=MotCon1, direction=IN, server-argument-impl-policy=USE-ARGUMENT-TYPE
        arg MotRNom: type=R6, direction=IN, server-argument-impl-policy=USE-ARGUMENT-TYPE
      error E_NOT_OK: error-code=1
    SetMotPrmNomEol2
      operation Oper: possible-error=SetMotPrmNomEol2/E_NOT_OK
        arg MotBackEmfConNom_Arg: type=MotCon1, direction=IN, server-argument-impl-policy=USE-ARGUMENT-TYPE
        arg MotRNom_Arg: type=R6, direction=IN, server-argument-impl-policy=USE-ARGUMENT-TYPE
      error E_NOT_OK: error-code=1
    SetMotRplCoggPrm_PortIf1
      operation Oper
        9 x arg, all with direction=IN, server-argument-impl-policy=USE-ARGUMENT-TYPE:
          CoggOrder1_Arg: type=uint16
          CoggOrder1X_Arg: type=s1p14
          CoggOrder1Y_Arg: type=s1p14
          CoggOrder2_Arg: type=uint16
          CoggOrder2X_Arg: type=s1p14
          CoggOrder2Y_Arg: type=s1p14
          CoggOrder3_Arg: type=uint16
          CoggOrder3X_Arg: type=s1p14
          CoggOrder3Y_Arg: type=s1p14
    SetMotTqCmdSca_PortIf1
      operation Oper
        arg MotTqCmdSca_Arg: type=float32, direction=IN, server-argument-impl-policy=USE-ARGUMENT-TYPE
    SetNtcSts_PortIf1
      operation Oper: possible-error=SetNtcSts_PortIf1/E_NOT_OK
        4 x arg, all with direction=IN, server-argument-impl-policy=USE-ARGUMENT-TYPE:
          NtcNr_Arg: type=NtcNr1
          NtcStInfo_Arg: type=uint8
          NtcSts_Arg: type=NtcSts1
          DebStep_Arg: type=uint16
      error E_NOT_OK: error-code=1
    SetNtcStsAndSnpshtData_PortIf1
      operation Oper: possible-error=SetNtcStsAndSnpshtData_PortIf1/E_NOT_OK
        7 x arg, all with direction=IN, server-argument-impl-policy=USE-ARGUMENT-TYPE:
          NtcNr_Arg: type=NtcNr1
          NtcStInfo_Arg: type=uint8
          NtcSts_Arg: type=NtcSts1
          DebStep_Arg: type=uint16
          SpclSnpshtData{0..2}_Arg: type=uint32
      error E_NOT_OK: error-code=1
    SetNtcStsCore_PortIf2
      operation Oper: possible-error=SetNtcStsCore_PortIf2/E_NOT_OK
        12 x arg, all with server-argument-impl-policy=USE-ARGUMENT-TYPE:
          NtcNr_Arg: type=NtcNr1, direction=IN
          NtcStInfo_Arg: type=uint8, direction=IN
          NtcSts_Arg: type=NtcSts1, direction=IN
          DebStep_Arg: type=uint16, direction=IN
          DiagcData_Arg: type=DiagcDataRec2, direction=INOUT
          ProxySetNtcData_Arg: type=DiagcDataRec2, direction=INOUT
          NtcInfo_Arg: type=NtcInfoRec4, direction=INOUT
          NtcInfoDebCntr_Arg: type=sint16, direction=INOUT
          SpclSnpshtData{0..2}_Arg: type=uint32, direction=IN
          SpclSnpshtDataPrsnt_Arg: type=boolean, direction=IN
      error E_NOT_OK: error-code=1
    SetPullCmpLongTerm_PortIf1
      operation Oper
        arg PullCmpLongTerm_Arg: type=float32, direction=IN, server-argument-impl-policy=USE-ARGUMENT-TYPE
    SetPullCmpShoTerm_PortIf1
      operation Oper
        arg PullCmpShoTerm_Arg: type=float32, direction=IN, server-argument-impl-policy=USE-ARGUMENT-TYPE
    SetTrajTarPrm_PortIf1
      operation Oper
        arg HwAgTrajGennHwAgTar_Arg: type=float32, direction=IN, server-argument-impl-policy=USE-ARGUMENT-TYPE
        arg HwAgTrajGennHwVelTar_Arg: type=float32, direction=IN, server-argument-impl-policy=USE-ARGUMENT-TYPE
        arg HwAgTrajGennHwATar_Arg: type=float32, direction=IN, server-argument-impl-policy=USE-ARGUMENT-TYPE
    SetVehCentrPosn_PortIf1
      operation Oper
        arg BmwSetVehCentrOffsSts_Arg: type=BmwSetVehCentrOffsSts1, direction=OUT, server-argument-impl-policy=USE-ARGUMENT-TYPE
    SetYawRateOffs_PortIf1
      operation Oper
        arg VehYawRateOffs_Arg: type=float32, direction=IN, server-argument-impl-policy=USE-ARGUMENT-TYPE
        arg VehYawRateLrngStRst_Arg: type=boolean, direction=IN, server-argument-impl-policy=USE-ARGUMENT-TYPE
    StHlthStcPwrDwn_PortIf1
      operation Oper
    StopCtrl_PortIf1
      operation Oper
        arg MotVelCtrlVelSlewRate_Arg: type=float32, direction=IN, server-argument-impl-policy=USE-ARGUMENT-TYPE
    StrtCtrl_PortIf1
      operation Oper
        arg MotVelCtrlMotVelTar_Arg: type=float32, direction=IN, server-argument-impl-policy=USE-ARGUMENT-TYPE
        arg MotVelCtrlVelSlewRate_Arg: type=float32, direction=IN, server-argument-impl-policy=USE-ARGUMENT-TYPE
    StrtErrInjCntr_PortIf1
      operation Oper
    SwCalGetPrm_PortIf1
      operation Oper
        11 x arg, all with direction=OUT, server-argument-impl-policy=USE-ARGUMENT-TYPE:
          BoostModlnIdx_Arg: type=float32
          HldModlnIdx_Arg: type=float32
          CoolDwnModlnIdx_Arg: type=float32
          Ramp{1..3}Ti_Arg: type=uint8
          BoostTi_Arg: type=uint8
          HldTi_Arg: type=uint16
          CoolDwnTi_Arg: type=uint16
          PosnStepSize_Arg: type=u0p16
          ElecRevCnt_Arg: type=uint8
    SwCalSetPrm_PortIf1
      operation Oper: possible-error=SwCalSetPrm_PortIf1/E_NOT_OK
        11 x arg, all with direction=IN, server-argument-impl-policy=USE-ARGUMENT-TYPE:
          BoostModlnIdx_Arg: type=float32
          HldModlnIdx_Arg: type=float32
          CoolDwnModlnIdx_Arg: type=float32
          Ramp{1..3}Ti_Arg: type=uint8
          BoostTi_Arg: type=uint8
          HldTi_Arg: type=uint16
          CoolDwnTi_Arg: type=uint16
          PosnStepSize_Arg: type=u0p16
          ElecRevCnt_Arg: type=uint8
      error E_NOT_OK: error-code=1
    SwCalStop_PortIf1
      operation Oper
    SwCalStrt_PortIf1
      operation Oper
    SwCalStsCallBack_PortIf1
      operation Oper
        arg ElecRev_Arg: type=uint8, direction=IN, server-argument-impl-policy=USE-ARGUMENT-TYPE
        arg PosIdx_Arg: type=uint16, direction=IN, server-argument-impl-policy=USE-ARGUMENT-TYPE
        arg SnsrData_Arg: type=Ary1D_u16_12, direction=IN, server-argument-impl-policy=USE-ARGUMENT-TYPE
    TrigGmSysDataCollctnEntry_PortIf1
      operation Oper
        arg GmSysDataCollctnEna_Arg: type=GmSysDataCollctnEnaSt1, direction=IN, server-argument-impl-policy=USE-ARGUMENT-TYPE
    TunVrntRead_PortIf1
      operation Oper: possible-error=TunVrntRead_PortIf1/E_NOT_OK
        arg BmwDesIninIdx_Arg: type=uint8, direction=OUT, server-argument-impl-policy=USE-ARGUMENT-TYPE
      error E_NOT_OK: error-code=1
    TunVrntWr_PortIf1
      operation Oper: possible-error=TunVrntWr_PortIf1/E_NOT_OK
        arg BmwDesIninIdx_Arg: type=uint8, direction=IN, server-argument-impl-policy=USE-ARGUMENT-TYPE
      error E_NOT_OK: error-code=1
    UpdErrInjReg_PortIf1
      operation Oper
        arg NtcNr_Arg: type=uint16, direction=IN, server-argument-impl-policy=USE-ARGUMENT-TYPE
        arg NtcStInfo_Arg: type=uint8, direction=IN, server-argument-impl-policy=USE-ARGUMENT-TYPE
        arg ErrInjNr_Arg: type=uint8, direction=IN, server-argument-impl-policy=USE-ARGUMENT-TYPE
    UpdHwAgTrimVal_PortIf1
      operation Oper
        arg UpdHwAgTrimValSrvResp_Arg: type=uint8, direction=OUT, server-argument-impl-policy=USE-ARGUMENT-TYPE
    UpdRawSig_PortIf3
      operation Oper
        arg SigId_Arg: type=StHlthMonSig3, direction=IN, server-argument-impl-policy=USE-ARGUMENT-TYPE
    UpdRawSig_PortIf4
      operation Oper
        arg SigId_Arg: type=StHlthMonSig4, direction=IN, server-argument-impl-policy=USE-ARGUMENT-TYPE
    UpdStHlthStcData_PortIf1
      operation Oper
        arg TaskId_Arg: type=uint8, direction=IN, server-argument-impl-policy=USE-ARGUMENT-TYPE
    XcpCalChgReq_PortIf1
      operation Oper: possible-error=XcpCalChgReq_PortIf1/E_NOT_OK
      error E_NOT_OK: error-code=1
  133 x sender receiver interface:
    ActvGroup_PortIf1: invalidation-policy{data-element=ActvGroup_PortIf1/Val, handle-invalid=DONT-INVALIDATE}
      data Val: type=uint8
    Ag3: invalidation-policy{data-element=Ag3/Val, handle-invalid=DONT-INVALIDATE}
      data Val: sw-calibration-access=READ-ONLY, type=Ag7
    Ag4: invalidation-policy{data-element=Ag4/Val, handle-invalid=DONT-INVALIDATE}
      data Val: sw-calibration-access=READ-ONLY, type=Ag8
    Ag6: invalidation-policy{data-element=Ag6/Val, handle-invalid=DONT-INVALIDATE}
      data Val: sw-calibration-access=READ-ONLY, type=Ag10
    Ary1D_f32_8_PortIf1: invalidation-policy{data-element=Ary1D_f32_8_PortIf1/Ary1D, handle-invalid=DONT-INVALIDATE}
      data Ary1D: sw-calibration-access=READ-ONLY, type=Ary1D_f32_8
    Ary1D_u08_17_PortIf1: invalidation-policy{data-element=Ary1D_u08_17_PortIf1/Ary1D, handle-invalid=DONT-INVALIDATE}
      data Ary1D: sw-calibration-access=READ-ONLY, type=Ary1D_u08_17
    Ary1D_u08_5_PortIf1: invalidation-policy{data-element=Ary1D_u08_5_PortIf1/Ary1D, handle-invalid=DONT-INVALIDATE}
      data Ary1D: sw-calibration-access=READ-ONLY, type=Ary1D_u08_5
    Ary1D_u08_8_PortIf1: invalidation-policy{data-element=Ary1D_u08_8_PortIf1/Ary1D, handle-invalid=DONT-INVALIDATE}
      data Ary1D: sw-calibration-access=READ-ONLY, type=Ary1D_u08_8
    Ary1D_u0p16_8_PortIf1: invalidation-policy{data-element=Ary1D_u0p16_8_PortIf1/Ary1D, handle-invalid=DONT-INVALIDATE}
      data Ary1D: sw-calibration-access=READ-ONLY, type=Ary1D_u0p16_8
    Ary1D_u32_4_PortIf1: invalidation-policy{data-element=Ary1D_u32_4_PortIf1/Ary1D, handle-invalid=DONT-INVALIDATE}
      data Ary1D: sw-calibration-access=READ-ONLY, type=Ary1D_u32_4
    Ary1D_u32_8_PortIf1: invalidation-policy{data-element=Ary1D_u32_8_PortIf1/Ary1D, handle-invalid=DONT-INVALIDATE}
      data Ary1D: sw-calibration-access=READ-ONLY, type=Ary1D_u32_8
    BattRtnCurrAmprQlfr1_PortIf1: invalidation-policy{data-element=BattRtnCurrAmprQlfr1_PortIf1/Val, handle-invalid=DONT-INVALIDATE}
      data Val: sw-calibration-access=READ-ONLY, type=BattRtnCurrAmprQlfr1
    BattSwdVltgCorrlnSts1_PortIf1: invalidation-policy{data-element=BattSwdVltgCorrlnSts1_PortIf1/Val, handle-invalid=DONT-INVALIDATE}
      data Val: sw-calibration-access=READ-ONLY, type=BattSwdVltgCorrlnSts1
    BattVltgSt1_PortIf1: invalidation-policy{data-element=BattVltgSt1_PortIf1/Val, handle-invalid=DONT-INVALIDATE}
      data Val: sw-calibration-access=READ-ONLY, type=BattVltgSt1
    BmwCogVehSpdQlfr_PortIf1: invalidation-policy{data-element=BmwCogVehSpdQlfr_PortIf1/Val, handle-invalid=DONT-INVALIDATE}
      data Val: sw-calibration-access=READ-ONLY, type=BmwCogVehSpdQlfr1
    BmwDiagcSessionId1_PortIf1: invalidation-policy{data-element=BmwDiagcSessionId1_PortIf1/Val, handle-invalid=DONT-INVALIDATE}
      data Val: sw-calibration-access=READ-ONLY, type=BmwDiagcSessionId1
    BmwElecEngDrvSts1_PortIf1: invalidation-policy{data-element=BmwElecEngDrvSts1_PortIf1/Val, handle-invalid=DONT-INVALIDATE}
      data Val: sw-calibration-access=READ-ONLY, type=BmwElecEngDrvSts1
    BmwEngDrvSts1_PortIf1: invalidation-policy{data-element=BmwEngDrvSts1_PortIf1/Val, handle-invalid=DONT-INVALIDATE}
      data Val: sw-calibration-access=READ-ONLY, type=BmwEngDrvSts1
    BmwEngStopCallSts1_PortIf1: invalidation-policy{data-element=BmwEngStopCallSts1_PortIf1/Val, handle-invalid=DONT-INVALIDATE}
      data Val: sw-calibration-access=READ-ONLY, type=BmwEngStopCallSts1
    BmwEpsFctSts1_PortIf1: invalidation-policy{data-element=BmwEpsFctSts1_PortIf1/Val, handle-invalid=DONT-INVALIDATE}
      data Val: sw-calibration-access=READ-ONLY, type=BmwEpsFctSts1
    BmwFltLampFlsgFrq_PortIf1: invalidation-policy{data-element=BmwFltLampFlsgFrq_PortIf1/Val, handle-invalid=DONT-INVALIDATE}
      data Val: sw-calibration-access=READ-ONLY, type=BmwFltLampFlsgFrq1
    BmwFltLampReqSts_PortIf1: invalidation-policy{data-element=BmwFltLampReqSts_PortIf1/Val, handle-invalid=DONT-INVALIDATE}
      data Val: sw-calibration-access=READ-ONLY, type=BmwFltLampReqSts1
    BmwFltLampReqSts1_PortIf1: invalidation-policy{data-element=BmwFltLampReqSts1_PortIf1/Val, handle-invalid=DONT-INVALIDATE}
      data Val: sw-calibration-access=READ-ONLY, type=BmwFltLampReqSts1
    BmwFltLampReqTyp1_PortIf1: invalidation-policy{data-element=BmwFltLampReqTyp1_PortIf1/Val, handle-invalid=DONT-INVALIDATE}
      data Val: sw-calibration-access=READ-ONLY, type=BmwFltLampReqTyp1
    BmwHaptcFbDirNr1_PortIf1: invalidation-policy{data-element=BmwHaptcFbDirNr1_PortIf1/Val, handle-invalid=DONT-INVALIDATE}
      data Val: sw-calibration-access=READ-ONLY, type=BmwHaptcFbDirNr1
    BmwHaptcFbIntenNr1_PortIf1: invalidation-policy{data-element=BmwHaptcFbIntenNr1_PortIf1/Val, handle-invalid=DONT-INVALIDATE}
      data Val: sw-calibration-access=READ-ONLY, type=BmwHaptcFbIntenNr1
    BmwHaptcFbPatNr1_PortIf1: invalidation-policy{data-element=BmwHaptcFbPatNr1_PortIf1/Val, handle-invalid=DONT-INVALIDATE}
      data Val: sw-calibration-access=READ-ONLY, type=BmwHaptcFbPatNr1
    BmwMaxCurrLimrSts1_PortIf1: invalidation-policy{data-element=BmwMaxCurrLimrSts1_PortIf1/Val, handle-invalid=DONT-INVALIDATE}
      data Val: sw-calibration-access=READ-ONLY, type=BmwMaxCurrLimrSts1
    BmwMotAgSelnSt1_PortIf1: invalidation-policy{data-element=BmwMotAgSelnSt1_PortIf1/Val, handle-invalid=DONT-INVALIDATE}
      data Val: sw-calibration-access=READ-ONLY, type=BmwMotAgSelnSt1
    BmwNearStillVehSpdSts1_PortIf1: invalidation-policy{data-element=BmwNearStillVehSpdSts1_PortIf1/Val, handle-invalid=DONT-INVALIDATE}
      data Val: sw-calibration-access=READ-ONLY, type=BmwNearStillVehSpdSts1
    BmwOvrlCmdQlfr1_PortIf1: invalidation-policy{data-element=BmwOvrlCmdQlfr1_PortIf1/Val, handle-invalid=DONT-INVALIDATE}
      data Val: sw-calibration-access=READ-ONLY, type=BmwOvrlCmdQlfr1
    BmwPinionAgOffsSts_PortIf1: invalidation-policy{data-element=BmwPinionAgOffsSts_PortIf1/Val, handle-invalid=DONT-INVALIDATE}
      data Val: sw-calibration-access=READ-ONLY, type=BmwPinionAgOffsSts1
    BmwPinionAgQlfr_PortIf1: invalidation-policy{data-element=BmwPinionAgQlfr_PortIf1/Val, handle-invalid=DONT-INVALIDATE}
      data Val: sw-calibration-access=READ-ONLY, type=BmwPinionAgQlfr1
    BmwPinionAgQlfr1_PortIf1: invalidation-policy{data-element=BmwPinionAgQlfr1_PortIf1/Val, handle-invalid=DONT-INVALIDATE}
      data Val: sw-calibration-access=READ-ONLY, type=BmwPinionAgQlfr1
    BmwPwrSplySts1_PortIf1: invalidation-policy{data-element=BmwPwrSplySts1_PortIf1/Val, handle-invalid=DONT-INVALIDATE}
      data Val: sw-calibration-access=READ-ONLY, type=BmwPwrSplySts1
    BmwQuadOffsSts1_PortIf1: invalidation-policy{data-element=BmwQuadOffsSts1_PortIf1/Val, handle-invalid=DONT-INVALIDATE}
      data Val: sw-calibration-access=READ-ONLY, type=BmwQuadOffsSts1
    BmwRtIdx1_PortIf1: invalidation-policy{data-element=BmwRtIdx1_PortIf1/Val, handle-invalid=DONT-INVALIDATE}
      data Val: sw-calibration-access=READ-ONLY, type=BmwRtIdx1
    BmwSecurVehSpdSts_PortIf1: invalidation-policy{data-element=BmwSecurVehSpdSts_PortIf1/Val, handle-invalid=DONT-INVALIDATE}
      data Val: sw-calibration-access=READ-ONLY, type=BmwSecurVehSpdSts1
    BmwSeldPosnUnit1_PortIf1: invalidation-policy{data-element=BmwSeldPosnUnit1_PortIf1/Val, handle-invalid=DONT-INVALIDATE}
      data Val: sw-calibration-access=READ-ONLY, type=BmwSeldPosnUnit1
    BmwStrtStopMsgCmd1_PortIf1: invalidation-policy{data-element=BmwStrtStopMsgCmd1_PortIf1/Val, handle-invalid=DONT-INVALIDATE}
      data Val: sw-calibration-access=READ-ONLY, type=BmwStrtStopMsgCmd1
    BmwTqSnsrIdx1_Port1: invalidation-policy{data-element=BmwTqSnsrIdx1_Port1/Val, handle-invalid=DONT-INVALIDATE}
      data Val: sw-calibration-access=READ-ONLY, type=BmwTqSnsrIdx1
    BmwTrfcJamAssiDampgStReq1_PortIf1: invalidation-policy{data-element=BmwTrfcJamAssiDampgStReq1_PortIf1/Val, handle-invalid=DONT-INVALIDATE}
      data Val: sw-calibration-access=READ-ONLY, type=BmwTrfcJamAssiDampgStReq1
    BmwTrfcJamAssiSt1_PortIf1: invalidation-policy{data-element=BmwTrfcJamAssiSt1_PortIf1/Val, handle-invalid=DONT-INVALIDATE}
      data Val: sw-calibration-access=READ-ONLY, type=BmwTrfcJamAssiSt1
    BmwVehSpdSts1_PortIf1: invalidation-policy{data-element=BmwVehSpdSts1_PortIf1/Val, handle-invalid=DONT-INVALIDATE}
      data Val: sw-calibration-access=READ-ONLY, type=BmwVehSpdSts1
    BmwVltgDrpSts1_PortIf1: invalidation-policy{data-element=BmwVltgDrpSts1_PortIf1/Val, handle-invalid=DONT-INVALIDATE}
      data Val: sw-calibration-access=READ-ONLY, type=BmwVltgDrpSts1
    boolean_PortIf1: invalidation-policy{data-element=boolean_PortIf1/Logl, handle-invalid=DONT-INVALIDATE}
      data Logl: sw-calibration-access=READ-ONLY, type=boolean
    CalCopySts_PortIf1: invalidation-policy{data-element=CalCopySts_PortIf1/Val, handle-invalid=DONT-INVALIDATE}
      data Val: type=CalCopySts1
    Cnt6: invalidation-policy{data-element=Cnt6/Val, handle-invalid=DONT-INVALIDATE}
      data Val: sw-calibration-access=READ-ONLY, type=uint8
    Curr2: invalidation-policy{data-element=Curr2/Val, handle-invalid=DONT-INVALIDATE}
      data Val: sw-calibration-access=READ-ONLY, type=Curr6
    Curr3: invalidation-policy{data-element=Curr3/Val, handle-invalid=DONT-INVALIDATE}
      data Val: sw-calibration-access=READ-ONLY, type=Curr7
    DrvgDynIfSt1_PortIf1: invalidation-policy{data-element=DrvgDynIfSt1_PortIf1/Val, handle-invalid=DONT-INVALIDATE}
      data Val: sw-calibration-access=READ-ONLY, type=DrvgDynIfSt1
    EgyModSt1_PortIf1: invalidation-policy{data-element=EgyModSt1_PortIf1/Val, handle-invalid=DONT-INVALIDATE}
      data Val: sw-calibration-access=READ-ONLY, type=EgyModSt1
    EotSt1_PortIf1: invalidation-policy{data-element=EotSt1_PortIf1/Val, handle-invalid=DONT-INVALIDATE}
      data Val: sw-calibration-access=READ-ONLY, type=EotSt1
    EpsCurrLimSts1_PortIf1: invalidation-policy{data-element=EpsCurrLimSts1_PortIf1/Val, handle-invalid=DONT-INVALIDATE}
      data Val: sw-calibration-access=READ-ONLY, type=EpsCurrLimSts1
    float32_PortIf1: invalidation-policy{data-element=float32_PortIf1/Val, handle-invalid=DONT-INVALIDATE}
      data Val: sw-calibration-access=READ-ONLY, type=float32
    GmAutnmsDrvgIfFltRespDi_PortIf1: invalidation-policy{data-element=GmAutnmsDrvgIfFltRespDi_PortIf1/Val, handle-invalid=DONT-INVALIDATE}
      data Val: sw-calibration-access=READ-ONLY, type=GmAutnmsDrvgIfFltRespDi1
    GmAutnmsSteerCmdSts_PortIf1: invalidation-policy{data-element=GmAutnmsSteerCmdSts_PortIf1/Val, handle-invalid=DONT-INVALIDATE}
      data Val: sw-calibration-access=READ-ONLY, type=GmAutnmsSteerCmdSts1
    GmBackUpSysPwrModAuthentd1_PortIf1: invalidation-policy{data-element=GmBackUpSysPwrModAuthentd1_PortIf1/Val, handle-invalid=DONT-INVALIDATE}
      data Val: sw-calibration-access=READ-ONLY, type=GmBackUpSysPwrModAuthentd1
    GmDrvrIntvDetnSt_PortIf1: invalidation-policy{data-element=GmDrvrIntvDetnSt_PortIf1/Val, handle-invalid=DONT-INVALIDATE}
      data Val: sw-calibration-access=READ-ONLY, type=GmDrvrIntvDetnSt1
    GmDualEcuOperSts_PortIf1: invalidation-policy{data-element=GmDualEcuOperSts_PortIf1/Val, handle-invalid=DONT-INVALIDATE}
      data Val: sw-calibration-access=READ-ONLY, type=GmDualEcuOperSts1
    GmEscSysStsAuthentdSt1_PortIf1: invalidation-policy{data-element=GmEscSysStsAuthentdSt1_PortIf1/Val, handle-invalid=DONT-INVALIDATE}
      data Val: sw-calibration-access=READ-ONLY, type=GmEscSysStsAuthentdSt1
    GmFctDiArbnSts_PortIf1: invalidation-policy{data-element=GmFctDiArbnSts_PortIf1/Val, handle-invalid=DONT-INVALIDATE}
      data Val: sw-calibration-access=READ-ONLY, type=GmFctDiArbnSts1
    GmOvrlFeatActvSt1_PortIf1: invalidation-policy{data-element=GmOvrlFeatActvSt1_PortIf1/Val, handle-invalid=DONT-INVALIDATE}
      data Val: sw-calibration-access=READ-ONLY, type=GmOvrlFeatActvSt1
    GmOvrlStMgrApaSt1_PortIf1: invalidation-policy{data-element=GmOvrlStMgrApaSt1_PortIf1/Val, handle-invalid=DONT-INVALIDATE}
      data Val: sw-calibration-access=READ-ONLY, type=GmOvrlStMgrApaSt1
    GmOvrlStMgrHandsOnLaneFolwgSt1_PortIf1: invalidation-policy{data-element=GmOvrlStMgrHandsOnLaneFolwgSt1_PortIf1/Val, handle-invalid=DONT-INVALIDATE}
      data Val: sw-calibration-access=READ-ONLY, type=GmOvrlStMgrHandsOnLaneFolwgSt1
    GmOvrlStMgrHaptcSt1_PortIf1: invalidation-policy{data-element=GmOvrlStMgrHaptcSt1_PortIf1/Val, handle-invalid=DONT-INVALIDATE}
      data Val: sw-calibration-access=READ-ONLY, type=GmOvrlStMgrHaptcSt1
    GmOvrlStMgrTrfcJamAssiSt1_PortIf1: invalidation-policy{data-element=GmOvrlStMgrTrfcJamAssiSt1_PortIf1/Val, handle-invalid=DONT-INVALIDATE}
      data Val: sw-calibration-access=READ-ONLY, type=GmOvrlStMgrTrfcJamAssiSt1
    GmRxMonrdSig1_PortIf1: invalidation-policy{data-element=GmRxMonrdSig1_PortIf1/Val, handle-invalid=DONT-INVALIDATE}
      data Val: sw-calibration-access=READ-ONLY, type=GmRxMonrdSig1
    GmSecuAcsFlg1_PortIf1: invalidation-policy{data-element=GmSecuAcsFlg1_PortIf1/Val, handle-invalid=DONT-INVALIDATE}
      data Val: sw-calibration-access=READ-ONLY, type=GmSecuAcsFlg1
    GmSteerCmdLimrSt_PortIf1: invalidation-policy{data-element=GmSteerCmdLimrSt_PortIf1/Val, handle-invalid=DONT-INVALIDATE}
      data Val: sw-calibration-access=READ-ONLY, type=GmSteerCmdLimrSt1
    GmSteerCmdMsgSrc1_PortIf1: invalidation-policy{data-element=GmSteerCmdMsgSrc1_PortIf1/Val, handle-invalid=DONT-INVALIDATE}
      data Val: sw-calibration-access=READ-ONLY, type=GmSteerCmdMsgSrc1
    GmSteerCmdMsgSts_PortIf1: invalidation-policy{data-element=GmSteerCmdMsgSts_PortIf1/Val, handle-invalid=DONT-INVALIDATE}
      data Val: sw-calibration-access=READ-ONLY, type=GmSteerCmdMsgSts1
    GmSteerReqArbdFeatAuthentdSt1_PortIf1: invalidation-policy{data-element=GmSteerReqArbdFeatAuthentdSt1_PortIf1/Val, handle-invalid=DONT-INVALIDATE}
      data Val: sw-calibration-access=READ-ONLY, type=GmSteerReqArbdFeatAuthentdSt1
    GmSteerReqStsAuthentdSt1_PortIf1: invalidation-policy{data-element=GmSteerReqStsAuthentdSt1_PortIf1/Val, handle-invalid=DONT-INVALIDATE}
      data Val: sw-calibration-access=READ-ONLY, type=GmSteerReqStsAuthentdSt1
    GmSysPwrMod1_PortIf1: invalidation-policy{data-element=GmSysPwrMod1_PortIf1/Val, handle-invalid=DONT-INVALIDATE}
      data Val: sw-calibration-access=READ-ONLY, type=GmSysPwrMod1
    GmSysPwrModAuthentd1_PortIf1: invalidation-policy{data-element=GmSysPwrModAuthentd1_PortIf1/Val, handle-invalid=DONT-INVALIDATE}
      data Val: sw-calibration-access=READ-ONLY, type=GmSysPwrModAuthentd1
    GmTqArbnEscSt1_PortIf1: invalidation-policy{data-element=GmTqArbnEscSt1_PortIf1/Val, handle-invalid=DONT-INVALIDATE}
      data Val: sw-calibration-access=READ-ONLY, type=GmTqArbnEscSt1
    GmTqArbnLkaSt1_PortIf1: invalidation-policy{data-element=GmTqArbnLkaSt1_PortIf1/Val, handle-invalid=DONT-INVALIDATE}
      data Val: sw-calibration-access=READ-ONLY, type=GmTqArbnLkaSt1
    GmTqArbnTrfcJamAssiSt1_PortIf1: invalidation-policy{data-element=GmTqArbnTrfcJamAssiSt1_PortIf1/Val, handle-invalid=DONT-INVALIDATE}
      data Val: sw-calibration-access=READ-ONLY, type=GmTqArbnTrfcJamAssiSt1
    GmTrsmShiftLvrPosnAuthentd1_PortIf1: invalidation-policy{data-element=GmTrsmShiftLvrPosnAuthentd1_PortIf1/Val, handle-invalid=DONT-INVALIDATE}
      data Val: sw-calibration-access=READ-ONLY, type=GmTrsmShiftLvrPosnAuthentd1
    GmVehHlthMgrSt1_PortIf1: invalidation-policy{data-element=GmVehHlthMgrSt1_PortIf1/Val, handle-invalid=DONT-INVALIDATE}
      data Val: sw-calibration-access=READ-ONLY, type=GmVehHlthMgrSt1
    GmVehModMgrSt_PortIf1: invalidation-policy{data-element=GmVehModMgrSt_PortIf1/Val, handle-invalid=DONT-INVALIDATE}
      data Val: sw-calibration-access=READ-ONLY, type=GmVehModMgrSt1
    HaptcFbSt1_PortIf1: invalidation-policy{data-element=HaptcFbSt1_PortIf1/Val, handle-invalid=DONT-INVALIDATE}
      data Val: sw-calibration-access=READ-ONLY, type=HaptcFbSt1
    HwAg1SnsrTyp_PortIf1: invalidation-policy{data-element=HwAg1SnsrTyp_PortIf1/Val, handle-invalid=DONT-INVALIDATE}  # OBSOLETE
      data Val: sw-calibration-access=READ-ONLY, type=HwAgSnsrTyp1
    HwAgSnsrTyp1_PortIf1: invalidation-policy{data-element=HwAgSnsrTyp1_PortIf1/Val, handle-invalid=DONT-INVALIDATE}
      data Val: sw-calibration-access=READ-ONLY, type=HwAgSnsrTyp1
    Indu2: invalidation-policy{data-element=Indu2/Val, handle-invalid=DONT-INVALIDATE}
      data Val: sw-calibration-access=READ-ONLY, type=Indu1
    IvtrFetFltPha1_PortIf1: invalidation-policy{data-element=IvtrFetFltPha1_PortIf1/Val, handle-invalid=DONT-INVALIDATE}
      data Val: sw-calibration-access=READ-ONLY, type=IvtrFetFltPha1
    IvtrFetFltTyp1_PortIf1: invalidation-policy{data-element=IvtrFetFltTyp1_PortIf1/Val, handle-invalid=DONT-INVALIDATE}
      data Val: sw-calibration-access=READ-ONLY, type=IvtrFetFltTyp1
    LoaSt1_PortIf1: invalidation-policy{data-element=LoaSt1_PortIf1/Val, handle-invalid=DONT-INVALIDATE}
      data Val: sw-calibration-access=READ-ONLY, type=LoaSt1
    Logl1: invalidation-policy{data-element=Logl1/Logl, handle-invalid=DONT-INVALIDATE}
      data Logl: sw-calibration-access=READ-ONLY, type=boolean
    Logl2: invalidation-policy{data-element=Logl2/Logl, handle-invalid=DONT-INVALIDATE}
      data Logl: sw-calibration-access=READ-ONLY, type=Logl1
    MfgEnaSt1_PortIf1: invalidation-policy{data-element=MfgEnaSt1_PortIf1/Val, handle-invalid=DONT-INVALIDATE}
      data Val: type=MfgEnaSt1
    MotAgSnsrCfgSt1_PortIf1: invalidation-policy{data-element=MotAgSnsrCfgSt1_PortIf1/Val, handle-invalid=DONT-INVALIDATE}
      data Val: sw-calibration-access=READ-ONLY, type=MotAgSnsrCfgSt1
    MotAgSnsrIninSt1_PortIf1: invalidation-policy{data-element=MotAgSnsrIninSt1_PortIf1/Val, handle-invalid=DONT-INVALIDATE}
      data Val: sw-calibration-access=READ-ONLY, type=MotAgSnsrIninSt1
    MotCon1: invalidation-policy{data-element=MotCon1/Val, handle-invalid=DONT-INVALIDATE}
      data Val: sw-calibration-access=READ-ONLY, type=MotCon1
    MotCurrEolCalSt_PortIf1: invalidation-policy{data-element=MotCurrEolCalSt_PortIf1/Val, handle-invalid=DONT-INVALIDATE}
      data Val: sw-calibration-access=READ-ONLY, type=MotCurrEolCalSt2
    MotCurrEolCalSt2_PortIf1: invalidation-policy{data-element=MotCurrEolCalSt2_PortIf1/Val, handle-invalid=DONT-INVALIDATE}
      data Val: sw-calibration-access=READ-ONLY, type=MotCurrEolCalSt2
    MotQuad1: invalidation-policy{data-element=MotQuad1/Val, handle-invalid=DONT-INVALIDATE}
      data Val: sw-calibration-access=READ-ONLY, type=MotQuad1
    MotQuad1_PortIf1: invalidation-policy{data-element=MotQuad1_PortIf1/Val, handle-invalid=DONT-INVALIDATE}
      data Val: sw-calibration-access=READ-ONLY, type=MotQuad1
    PhaDiscnctPwmVect1_PortIf1: invalidation-policy{data-element=PhaDiscnctPwmVect1_PortIf1/Val, handle-invalid=DONT-INVALIDATE}
      data Val: type=PhaDiscnctPwmVect1
    R4: invalidation-policy{data-element=R4/Val, handle-invalid=DONT-INVALIDATE}
      data Val: sw-calibration-access=READ-ONLY, type=R5
    R6: invalidation-policy{data-element=R6/Val, handle-invalid=DONT-INVALIDATE}
      data Val: sw-calibration-access=READ-ONLY, type=R6
    RtIdxChgSts_PortIf1: invalidation-policy{data-element=RtIdxChgSts_PortIf1/Val, handle-invalid=DONT-INVALIDATE}
      data Val: sw-calibration-access=READ-ONLY, type=RtIdxChgSts1
    s15p16_PortIf1: invalidation-policy{data-element=s15p16_PortIf1/Val, handle-invalid=DONT-INVALIDATE}
      data Val: sw-calibration-access=READ-ONLY, type=s15p16
    s18p13_PortIf1: invalidation-policy{data-element=s18p13_PortIf1/Val, handle-invalid=DONT-INVALIDATE}
      data Val: sw-calibration-access=READ-ONLY, type=s18p13
    SelnCaseSt1_PortIf1: invalidation-policy{data-element=SelnCaseSt1_PortIf1/Val, handle-invalid=DONT-INVALIDATE}
      data Val: sw-calibration-access=READ-ONLY, type=SelnCaseSt1
    SigQlfr_PortIf1: invalidation-policy{data-element=SigQlfr_PortIf1/Val, handle-invalid=DONT-INVALIDATE}
      data Val: sw-calibration-access=READ-ONLY, type=SigQlfr1
    SigQlfr1: invalidation-policy{data-element=SigQlfr1/Val, handle-invalid=DONT-INVALIDATE}
      data Val: sw-calibration-access=READ-ONLY, type=SigQlfr1
    SigQlfr1_PortIf1: invalidation-policy{data-element=SigQlfr1_PortIf1/Val, handle-invalid=DONT-INVALIDATE}
      data Val: sw-calibration-access=READ-ONLY, type=SigQlfr1
    sint16_PortIf1: invalidation-policy{data-element=sint16_PortIf1/Val, handle-invalid=DONT-INVALIDATE}
      data Val: sw-calibration-access=READ-ONLY, type=sint16
    sint32_PortIf1: invalidation-policy{data-element=sint32_PortIf1/Val, handle-invalid=DONT-INVALIDATE}
      data Val: sw-calibration-access=READ-ONLY, type=sint32
    sint8_PortIf1: invalidation-policy{data-element=sint8_PortIf1/Val, handle-invalid=DONT-INVALIDATE}
      data Val: sw-calibration-access=READ-ONLY, type=sint8
    SteerMod1_PortIf1: invalidation-policy{data-element=SteerMod1_PortIf1/Val, handle-invalid=DONT-INVALIDATE}
      data Val: sw-calibration-access=READ-ONLY, type=SteerMod1
    SteerPrfmncModReq_PortIf1: invalidation-policy{data-element=SteerPrfmncModReq_PortIf1/Val, handle-invalid=DONT-INVALIDATE}
      data Val: sw-calibration-access=READ-ONLY, type=GmSteerPrfmncModReq1
    StrtUpSt1_PortIf1: invalidation-policy{data-element=StrtUpSt1_PortIf1/Val, handle-invalid=DONT-INVALIDATE}
      data Val: sw-calibration-access=READ-ONLY, type=StrtUpSt1
    StsDrvrActvy1_PortIf1: invalidation-policy{data-element=StsDrvrActvy1_PortIf1/Val, handle-invalid=DONT-INVALIDATE}
      data Val: sw-calibration-access=READ-ONLY, type=StsDrvrActvy1
    StsSteerAssi1_PortIf1: invalidation-policy{data-element=StsSteerAssi1_PortIf1/Val, handle-invalid=DONT-INVALIDATE}
      data Val: sw-calibration-access=READ-ONLY, type=StsSteerAssi1
    SysSt1: invalidation-policy{data-element=SysSt1/Val, handle-invalid=DONT-INVALIDATE}
      data Val: sw-calibration-access=READ-ONLY, type=SysSt1
    SysSt1_PortIf1: invalidation-policy{data-element=SysSt1_PortIf1/Val, handle-invalid=DONT-INVALIDATE}
      data Val: sw-calibration-access=READ-ONLY, type=SysSt1
    T1: invalidation-policy{data-element=T1/Val, handle-invalid=DONT-INVALIDATE}
      data Val: sw-calibration-access=READ-ONLY, type=T1
    T5: invalidation-policy{data-element=T5/Val, handle-invalid=DONT-INVALIDATE}
      data Val: sw-calibration-access=READ-ONLY, type=T2
    T6: invalidation-policy{data-element=T6/Val, handle-invalid=DONT-INVALIDATE}
      data Val: sw-calibration-access=READ-ONLY, type=T3
    TorsBarStEstimdRec1_PortIf1: invalidation-policy{data-element=Rec, handle-invalid=DONT-INVALIDATE}
      data Rec: sw-calibration-access=READ-ONLY, type=TorsBarStEstimdRec1
    Tq1: invalidation-policy{data-element=Tq1/Val, handle-invalid=DONT-INVALIDATE}
      data Val: sw-calibration-access=READ-ONLY, type=Tq1
    u0p16_PortIf1: invalidation-policy{data-element=u0p16_PortIf1/Val, handle-invalid=DONT-INVALIDATE}
      data Val: sw-calibration-access=READ-ONLY, type=u0p16
    u16p0_PortIf1: invalidation-policy{data-element=u16p0_PortIf1/Val, handle-invalid=DONT-INVALIDATE}
      data Val: sw-calibration-access=READ-ONLY, type=u16p0
    uint16_PortIf1: invalidation-policy{data-element=uint16_PortIf1/Val, handle-invalid=DONT-INVALIDATE}
      data Val: sw-calibration-access=READ-ONLY, type=uint16
    uint32_PortIf1: invalidation-policy{data-element=uint32_PortIf1/Val, handle-invalid=DONT-INVALIDATE}
      data Val: sw-calibration-access=READ-ONLY, type=uint32
    uint8_PortIf1: invalidation-policy{data-element=uint8_PortIf1/Val, handle-invalid=DONT-INVALIDATE}
      data Val: sw-calibration-access=READ-ONLY, type=uint8
    Uls3: invalidation-policy{data-element=Uls3/Val, handle-invalid=DONT-INVALIDATE}
      data Val: sw-calibration-access=READ-ONLY, type=Uls3
    Vel1: invalidation-policy{data-element=Vel1/Val, handle-invalid=DONT-INVALIDATE}
      data Val: sw-calibration-access=READ-ONLY, type=Vel1
    Volt1: invalidation-policy{data-element=Volt1/Val, handle-invalid=DONT-INVALIDATE}
      data Val: sw-calibration-access=READ-ONLY, type=Volt1
    Volt6: invalidation-policy{data-element=Volt6/Val, handle-invalid=DONT-INVALIDATE}
      data Val: sw-calibration-access=READ-ONLY, type=Volt17
package /PortInterface
  client server interface WdgM_AliveSupervision: is-service=true
    operation CheckpointReached: possible-error=WdgM_AliveSupervision/E_NOT_OK  # Indicates to the Watchdog Manager that a Checkpoint within a Supervised Entity has been reached.
    error E_NOT_OK: error-code=1
package /PortInterfaces
  10 x client server interface:
    CfgMsgTxReq_PortIf1
      operation Oper
    CmnMfgSrvCmnMfgSrvMaiFct
      operation Oper
        7 x arg, all with server-argument-impl-policy=USE-ARGUMENT-TYPE:
          CmnMfgSrvCmnMfgSrvSrvId: type=uint8, direction=IN
          CmnMfgSrvCmnMfgSrvSubFct: type=uint8, direction=IN
          CmnMfgSrvCmnMfgSrvPrmId: type=uint16, direction=IN
          CmnMfgSrvCmnMfgSrvDataBufferPtr: type=uint8, direction=INOUT
          CmnMfgSrvCmnMfgSrvReqLen: type=uint16, direction=IN
          CmnMfgSrvCmnMfgSrvRespLen: type=uint16, direction=OUT
          CmnMfgSrvCmnMfgSrvRespCod: type=uint8, direction=OUT
    CmnMfgSrvIfCmnMfgSrvIfImdtTx
      operation Oper
        arg CmnMfgSrvCmnMfgSrvDataBufferPtr: type=Ary1D_u8_CmnMfgSrvIf, direction=IN, server-argument-impl-policy=USE-ARGUMENT-TYPE
        arg CmnMfgSrvCmnMfgSrvDataLen: type=uint16, direction=IN, server-argument-impl-policy=USE-ARGUMENT-TYPE
    CmnMfgSrvIfImdtTx_PortIf1
      operation Oper
        arg CmnMfgSrvDataBufPtr_Arg: type=Ary1D_u08_CmnMfgSrvIf, direction=IN, server-argument-impl-policy=USE-ARGUMENT-TYPE
        arg CmnMfgSrvDataLen_Arg: type=uint16, direction=IN, server-argument-impl-policy=USE-ARGUMENT-TYPE
    CmnMfgSrvMaiFct_PortIf1
      operation Oper
        7 x arg, all with server-argument-impl-policy=USE-ARGUMENT-TYPE:
          CmnMfgSrvSrvId_Arg: type=uint8, direction=IN
          CmnMfgSrvSubFct_Arg: type=uint8, direction=IN
          CmnMfgSrvPrmId_Arg: type=uint16, direction=IN
          CmnMfgSrvDataBufPtr_Arg: type=uint8, direction=INOUT
          CmnMfgSrvReqLen_Arg: type=uint16, direction=IN
          CmnMfgSrvRespLen_Arg: type=uint16, direction=OUT
          CmnMfgSrvRespCod_Arg: type=uint8, direction=OUT
    MCalReadVrfyFailFltInfo_PortIf1
      operation Oper
        arg PrphlId_Arg: type=uint8, direction=IN, server-argument-impl-policy=USE-ARGUMENT-TYPE
        arg ErrId_Arg: type=uint16, direction=IN, server-argument-impl-policy=USE-ARGUMENT-TYPE
    PolarityCfgRead_PortIf1
      operation Oper: possible-error=PolarityCfgRead_PortIf1/E_NOT_OK
        arg PolarityCfgSaved_Arg: type=uint32, direction=OUT, server-argument-impl-policy=USE-ARGUMENT-TYPE
      error E_NOT_OK: error-code=1
    PolarityCfgWr_PortIf1
      operation Oper: possible-error=PolarityCfgWr_PortIf1/E_NOT_OK
        arg PolarityCfgSaved_Arg: type=uint32, direction=IN, server-argument-impl-policy=USE-ARGUMENT-TYPE
      error E_NOT_OK: error-code=1
    SetCalPageReq_PortIf1
      operation Oper
        arg Seg_Arg: type=uint8, direction=IN, server-argument-impl-policy=USE-ARGUMENT-TYPE
        arg Mod_Arg: type=uint8, direction=IN, server-argument-impl-policy=USE-ARGUMENT-TYPE
        arg Page_Arg: type=uint8, direction=IN, server-argument-impl-policy=USE-ARGUMENT-TYPE
    XcpCalChgReq_PortIf1
      operation Oper: possible-error=XcpCalChgReq_PortIf1/E_NOT_OK
      error E_NOT_OK: error-code=1
  mode switch interface Coding_DataMode
    mode group Mode: type=Coding_DataMode
  79 x sender receiver interface:
    ALIV_ST_CENG: invalidation-policy{data-element=ALIV_ST_CENG, handle-invalid=DONT-INVALIDATE}
      data ALIV_ST_CENG: type=ALIV_ST_CENG1
    AVL_STEA_PNI_OFFS: invalidation-policy{data-element=AVL_STEA_PNI_OFFS, handle-invalid=DONT-INVALIDATE}
      data AVL_STEA_PNI_OFFS: type=AVL_STEA_PNI_OFFS1
    BATT_VLTG_EPS: invalidation-policy{data-element=BATT_VLTG_EPS, handle-invalid=DONT-INVALIDATE}
      data BATT_VLTG_EPS: type=BATT_VLTG_EPS
    BmwBasPtlNetCtrl_PortIf1: invalidation-policy{data-element=BmwBasPtlNetCtrl_PortIf1/Val, handle-invalid=DONT-INVALIDATE}
      data Val: type=BmwBasPtlNetCtrl1
    BmwCogVehSpdQlfr1_PortIf1: invalidation-policy{data-element=BmwCogVehSpdQlfr1_PortIf1/Val, handle-invalid=DONT-INVALIDATE}
      data Val: type=BmwCogVehSpdQlfr1
    BmwEpsDeactvnCtrl_PortIf1: invalidation-policy{data-element=BmwEpsDeactvnCtrl_PortIf1/Val, handle-invalid=DONT-INVALIDATE}
      data Val: type=BmwEpsDeactvnCtrl1
    BmwFltLampReqTyp1_PortIf1: invalidation-policy{data-element=BmwFltLampReqTyp1_PortIf1/Val, handle-invalid=DONT-INVALIDATE}
      data Val: type=BmwFltLampReqTyp1
    BmwFltLampReqTyp2_PortIf1: invalidation-policy{data-element=BmwFltLampReqTyp2_PortIf1/Val, handle-invalid=DONT-INVALIDATE}
      data Val: type=BmwFltLampReqTyp2
    BmwMaxCurrLimrSts_PortIf1: invalidation-policy{data-element=BmwMaxCurrLimrSts_PortIf1/Val, handle-invalid=DONT-INVALIDATE}
      data Val: type=BmwMaxCurrLimrSts1
    BmwNearStillVehSpdSts1_PortIf1: invalidation-policy{data-element=BmwNearStillVehSpdSts1_PortIf1/Val, handle-invalid=DONT-INVALIDATE}
      data Val: type=BmwNearStillVehSpdSts1
    BmwOvrlCmdQlfr_PortIf1: invalidation-policy{data-element=BmwOvrlCmdQlfr_PortIf1/Val, handle-invalid=DONT-INVALIDATE}
      data Val: type=BmwOvrlCmdQlfr1
    BmwPinionAgOffsSts_PortIf1: invalidation-policy{data-element=BmwPinionAgOffsSts_PortIf1/Val, handle-invalid=DONT-INVALIDATE}
      data Val: type=BmwPinionAgOffsSts1
    BmwQuadOffsSts_PortIf1: invalidation-policy{data-element=BmwQuadOffsSts_PortIf1/Val, handle-invalid=DONT-INVALIDATE}
      data Val: type=BmwQuadOffsSts1
    BmwRqrdCurrLimEpsSfty_PortIf1: invalidation-policy{data-element=BmwRqrdCurrLimEpsSfty_PortIf1/Val, handle-invalid=DONT-INVALIDATE}
      data Val: type=BmwRqrdCurrLimEpsSfty1
    BmwRtIdx_PortIf1: invalidation-policy{data-element=BmwRtIdx_PortIf1/Val, handle-invalid=DONT-INVALIDATE}
      data Val: type=BmwRtIdx1
    BmwSteerMdfnFacSts_PortIf1: invalidation-policy{data-element=BmwSteerMdfnFacSts_PortIf1/Val, handle-invalid=DONT-INVALIDATE}
      data Val: type=BmwSteerMdfnFacSts1
    BmwTrfcJamAssiDampgStReq_PortIf1: invalidation-policy{data-element=BmwTrfcJamAssiDampgStReq_PortIf1/Val, handle-invalid=DONT-INVALIDATE}
      data Val: type=BmwTrfcJamAssiDampgStReq1
    BmwVehCdn_PortIf1: invalidation-policy{data-element=BmwVehCdn_PortIf1/Val, handle-invalid=DONT-INVALIDATE}
      data Val: type=BmwVehCdn1
    BmwVehCdn1_PortIf1: invalidation-policy{data-element=BmwVehCdn1_PortIf1/Val, handle-invalid=DONT-INVALIDATE}
      data Val: type=BmwVehCdn1
    BmwVehCdnQlfr_PortIf1: invalidation-policy{data-element=BmwVehCdnQlfr_PortIf1/Val, handle-invalid=DONT-INVALIDATE}
      data Val: type=BmwVehCdnQlfr1
    BmwVehEgySts_PortIf1: invalidation-policy{data-element=BmwVehEgySts_PortIf1/Val, handle-invalid=DONT-INVALIDATE}
      data Val: type=BmwVehEgySts1
    BmwVehInterlockErrMemSts_PortIf1: invalidation-policy{data-element=BmwVehInterlockErrMemSts_PortIf1/Val, handle-invalid=DONT-INVALIDATE}
      data Val: type=BmwVehInterlockErrMemSts1
    BmwVehLatAQlfr_PortIf1: invalidation-policy{data-element=BmwVehLatAQlfr_PortIf1/Val, handle-invalid=DONT-INVALIDATE}
      data Val: type=BmwVehLatAQlfr1
    BmwVehYawQlfr_PortIf1: invalidation-policy{data-element=BmwVehYawQlfr_PortIf1/Val, handle-invalid=DONT-INVALIDATE}
      data Val: type=BmwVehYawQlfr1
    CTR_WARN_DIR_VIB_EPS: invalidation-policy{data-element=CTR_WARN_DIR_VIB_EPS, handle-invalid=DONT-INVALIDATE}
      data CTR_WARN_DIR_VIB_EPS: type=CTR_WARN_DIR_VIB_EPS1
    CTR_WARN_ILVL_VIB_EPS: invalidation-policy{data-element=CTR_WARN_ILVL_VIB_EPS, handle-invalid=DONT-INVALIDATE}
      data CTR_WARN_ILVL_VIB_EPS: type=CTR_WARN_ILVL_VIB_EPS1
    CTR_WARN_PTRN_VIB_EPS: invalidation-policy{data-element=CTR_WARN_PTRN_VIB_EPS, handle-invalid=DONT-INVALIDATE}
      data CTR_WARN_PTRN_VIB_EPS: type=CTR_WARN_PTRN_VIB_EPS1
    DBG_EPS_BS_MOD_58_BYTE_ID2: invalidation-policy{data-element=DBG_EPS_BS_MOD_58_BYTE_ID2, handle-invalid=DONT-INVALIDATE}
      data DBG_EPS_BS_MOD_58_BYTE_ID2: type=DBG_EPS_BS_MOD_58_BYTE_ID2
    DBG_EPS_MOD_EXT_120_BYTE: invalidation-policy{data-element=DBG_EPS_MOD_EXT_120_BYTE, handle-invalid=DONT-INVALIDATE}
      data DBG_EPS_MOD_EXT_120_BYTE: type=DBG_EPS_MOD_EXT_120_BYTE
    DBG_EPS_MOD_EXT_120_BYTE_ID2: invalidation-policy{data-element=DBG_EPS_MOD_EXT_120_BYTE_ID2, handle-invalid=DONT-INVALIDATE}
      data DBG_EPS_MOD_EXT_120_BYTE_ID2: type=DBG_EPS_MOD_EXT_120_BYTE_ID2
    DrvgDynIfSt_PortIf1: invalidation-policy{data-element=DrvgDynIfSt_PortIf1/Val, handle-invalid=DONT-INVALIDATE}
      data Val: type=DrvgDynIfSt1
    ECU_TEMP_EPS: invalidation-policy{data-element=ECU_TEMP_EPS, handle-invalid=DONT-INVALIDATE}
      data ECU_TEMP_EPS: type=ECU_TEMP_EPS
    ESTIMD_PEAK_MOT_CURR_EPS: invalidation-policy{data-element=ESTIMD_PEAK_MOT_CURR_EPS, handle-invalid=DONT-INVALIDATE}
      data ESTIMD_PEAK_MOT_CURR_EPS: type=ESTIMD_PEAK_MOT_CURR_EPS
    FACT_MO_STE_SO_DXP: invalidation-policy{data-element=FACT_MO_STE_SO_DXP, handle-invalid=DONT-INVALIDATE}
      data FACT_MO_STE_SO_DXP: type=FACT_MO_STE_SO_DXP1
    HaptcFbSt_PortIf1: invalidation-policy{data-element=HaptcFbSt_PortIf1/Val, handle-invalid=DONT-INVALIDATE}
      data Val: type=HaptcFbSt1
    MILE_KM: invalidation-policy{data-element=MILE_KM, handle-invalid=DONT-INVALIDATE}
      data MILE_KM: type=MILE_KM1
    MOT_FET_TEMP_EPS: invalidation-policy{data-element=MOT_FET_TEMP_EPS, handle-invalid=DONT-INVALIDATE}
      data MOT_FET_TEMP_EPS: type=MOT_FET_TEMP_EPS
    MOT_MAG_TEMP_EPS: invalidation-policy{data-element=MOT_MAG_TEMP_EPS, handle-invalid=DONT-INVALIDATE}
      data MOT_MAG_TEMP_EPS: type=MOT_MAG_TEMP_EPS
    MOT_TQ_CMD_EPS: invalidation-policy{data-element=MOT_TQ_CMD_EPS, handle-invalid=DONT-INVALIDATE}
      data MOT_TQ_CMD_EPS: type=MOT_TQ_CMD_EPS
    MOT_TQ_CMD_LIMD_EPS: invalidation-policy{data-element=MOT_TQ_CMD_LIMD_EPS, handle-invalid=DONT-INVALIDATE}
      data MOT_TQ_CMD_LIMD_EPS: type=MOT_TQ_CMD_LIMD_EPS
    MOT_VEL_EPS: invalidation-policy{data-element=MOT_VEL_EPS, handle-invalid=DONT-INVALIDATE}
      data MOT_VEL_EPS: type=MOT_VEL_EPS
    MOT_WIDG_TEMP_EPS: invalidation-policy{data-element=MOT_WIDG_TEMP_EPS, handle-invalid=DONT-INVALIDATE}
      data MOT_WIDG_TEMP_EPS: type=MOT_WIDG_TEMP_EPS
    NO_VECH_1: invalidation-policy{data-element=NO_VECH_1, handle-invalid=DONT-INVALIDATE}
      data NO_VECH_1: type=NO_VECH_1
    NO_VECH_2: invalidation-policy{data-element=NO_VECH_2, handle-invalid=DONT-INVALIDATE}
      data NO_VECH_2: type=NO_VECH_2
    NO_VECH_3: invalidation-policy{data-element=NO_VECH_3, handle-invalid=DONT-INVALIDATE}
      data NO_VECH_3: type=NO_VECH_3
    NO_VECH_4: invalidation-policy{data-element=NO_VECH_4, handle-invalid=DONT-INVALIDATE}
      data NO_VECH_4: type=NO_VECH_4
    NO_VECH_5: invalidation-policy{data-element=NO_VECH_5, handle-invalid=DONT-INVALIDATE}
      data NO_VECH_5: type=NO_VECH_5
    NO_VECH_6: invalidation-policy{data-element=NO_VECH_6, handle-invalid=DONT-INVALIDATE}
      data NO_VECH_6: type=NO_VECH_6
    NO_VECH_7: invalidation-policy{data-element=NO_VECH_7, handle-invalid=DONT-INVALIDATE}
      data NO_VECH_7: type=NO_VECH_7
    PRIM_HW_TQ_SNSR_VLTG_EPS: invalidation-policy{data-element=PRIM_HW_TQ_SNSR_VLTG_EPS, handle-invalid=DONT-INVALIDATE}
      data PRIM_HW_TQ_SNSR_VLTG_EPS: type=PRIM_HW_TQ_SNSR_VLTG_EPS
    SECDRY_HW_TQ_SNSR_VLTG_EPS: invalidation-policy{data-element=SECDRY_HW_TQ_SNSR_VLTG_EPS, handle-invalid=DONT-INVALIDATE}
      data SECDRY_HW_TQ_SNSR_VLTG_EPS: type=SECDRY_HW_TQ_SNSR_VLTG_EPS
    sigGroup_ACLNY_MASSCNTR: invalidation-policy{data-element=sigGroup_ACLNY_MASSCNTR, handle-invalid=DONT-INVALIDATE}
      data sigGroup_ACLNY_MASSCNTR: type=sigGroup_ACLNY_MASSCNTR1
    sigGroup_AVL_FORC_GRD: invalidation-policy{data-element=sigGroup_AVL_FORC_GRD, handle-invalid=DONT-INVALIDATE}
      data sigGroup_AVL_FORC_GRD: type=sigGroup_AVL_FORC_GRD1
    sigGroup_AVL_PO_EPS: invalidation-policy{data-element=sigGroup_AVL_PO_EPS, handle-invalid=KEEP}
      data sigGroup_AVL_PO_EPS: type=sigGroup_AVL_PO_EPS1
    sigGroup_AVL_STMOM_DV_ACT: invalidation-policy{data-element=sigGroup_AVL_STMOM_DV_ACT, handle-invalid=DONT-INVALIDATE}
      data sigGroup_AVL_STMOM_DV_ACT: type=sigGroup_AVL_STMOM_DV_ACT1
    sigGroup_CON_VEH: invalidation-policy{data-element=sigGroup_CON_VEH, handle-invalid=DONT-INVALIDATE}
      data sigGroup_CON_VEH: type=sigGroup_CON_VEH1
    sigGroup_DISP_CC_EPS: invalidation-policy{data-element=sigGroup_DISP_CC_EPS, handle-invalid=KEEP}
      data sigGroup_DISP_CC_EPS: type=sigGroup_DISP_CC_EPS1
    sigGroup_DT_EST: invalidation-policy{data-element=sigGroup_DT_EST, handle-invalid=DONT-INVALIDATE}
      data sigGroup_DT_EST: type=sigGroup_DT_EST1
    sigGroup_ENERG_DGR_DRDY: invalidation-policy{data-element=sigGroup_ENERG_DGR_DRDY, handle-invalid=DONT-INVALIDATE}
      data sigGroup_ENERG_DGR_DRDY: type=sigGroup_ENERG_DGR_DRDY1
    sigGroup_OFFS_QUAD_EPS: invalidation-policy{data-element=sigGroup_OFFS_QUAD_EPS, handle-invalid=DONT-INVALIDATE}
      data sigGroup_OFFS_QUAD_EPS: type=sigGroup_OFFS_QUAD_EPS1
    sigGroup_ST_EST: invalidation-policy{data-element=sigGroup_ST_EST, handle-invalid=DONT-INVALIDATE}
      data sigGroup_ST_EST: type=sigGroup_ST_EST1
    sigGroup_SU_EPS: invalidation-policy{data-element=sigGroup_SU_EPS, handle-invalid=DONT-INVALIDATE}
      data sigGroup_SU_EPS: type=sigGroup_SU_EPS1
    sigGroup_TAR_QTA_STRMOM_DV: invalidation-policy{data-element=sigGroup_TAR_QTA_STRMOM_DV, handle-invalid=DONT-INVALIDATE}
      data sigGroup_TAR_QTA_STRMOM_DV: type=sigGroup_TAR_QTA_STRMOM_DV1
    sigGroup_TAR_STMOM_DV_ACT: invalidation-policy{data-element=sigGroup_TAR_STMOM_DV_ACT, handle-invalid=DONT-INVALIDATE}
      data sigGroup_TAR_STMOM_DV_ACT: type=sigGroup_TAR_STMOM_DV_ACT1
    sigGroup_V_VEH: invalidation-policy{data-element=sigGroup_V_VEH, handle-invalid=DONT-INVALIDATE}
      data sigGroup_V_VEH: type=sigGroup_V_VEH1
    sigGroup_VYAW_VEH: invalidation-policy{data-element=sigGroup_VYAW_VEH, handle-invalid=DONT-INVALIDATE}
      data sigGroup_VYAW_VEH: type=sigGroup_VYAW_VEH1
    ST_ANO_MSA_ENG_STOP: invalidation-policy{data-element=ST_ANO_MSA_ENG_STOP, handle-invalid=DONT-INVALIDATE}
      data ST_ANO_MSA_ENG_STOP: type=ST_ANO_MSA_ENG_STOP1
    ST_CENG_DRV: invalidation-policy{data-element=ST_CENG_DRV, handle-invalid=DONT-INVALIDATE}
      data ST_CENG_DRV: type=ST_CENG_DRV1
    ST_CON_VEH_EPS: invalidation-policy{data-element=ST_CON_VEH_EPS, handle-invalid=DONT-INVALIDATE}
      data ST_CON_VEH_EPS: type=ST_CON_VEH_EPS
    ST_ENERG_FZM: invalidation-policy{data-element=ST_ENERG_FZM, handle-invalid=DONT-INVALIDATE}
      data ST_ENERG_FZM: type=ST_ENERG_FZM1
    ST_ENERG_SUPY: invalidation-policy{data-element=ST_ENERG_SUPY, handle-invalid=DONT-INVALIDATE}
      data ST_ENERG_SUPY: type=ST_ENERG_SUPY1
    ST_ILK_ERRM_FZM: invalidation-policy{data-element=ST_ILK_ERRM_FZM, handle-invalid=DONT-INVALIDATE}
      data ST_ILK_ERRM_FZM: type=ST_ILK_ERRM_FZM1
    ST_MOT_DRV: invalidation-policy{data-element=ST_MOT_DRV, handle-invalid=DONT-INVALIDATE}
      data ST_MOT_DRV: type=ST_MOT_DRV1
    ST_UDP: invalidation-policy{data-element=ST_UDP, handle-invalid=DONT-INVALIDATE}
      data ST_UDP: type=ST_UDP1
    SU_CLU_STMOM_SFE_DXP: invalidation-policy{data-element=SU_CLU_STMOM_SFE_DXP, handle-invalid=DONT-INVALIDATE}
      data SU_CLU_STMOM_SFE_DXP: type=SU_CLU_STMOM_SFE_DXP1
    SYS_ST_EPS: invalidation-policy{data-element=SYS_ST_EPS, handle-invalid=DONT-INVALIDATE}
      data SYS_ST_EPS: type=SYS_ST_EPS
    T_SEC_COU_REL_PortIf1: invalidation-policy{data-element=T_SEC_COU_REL, handle-invalid=DONT-INVALIDATE}
      data T_SEC_COU_REL: data-constr=T_SEC_COU_REL_DataConstr, type=uint32
    TRGG_ENGTORQ_EPS: invalidation-policy{data-element=TRGG_ENGTORQ_EPS, handle-invalid=DONT-INVALIDATE}
      data TRGG_ENGTORQ_EPS: type=TRGG_ENGTORQ_EPS1
    VEH_SPD_EPS: invalidation-policy{data-element=VEH_SPD_EPS, handle-invalid=DONT-INVALIDATE}
      data VEH_SPD_EPS: type=VEH_SPD_EPS
package /Predefined_DEV/PortInterfaces
  42 x client server interface:
    NvMAdministration: is-service=true
      operation SetBlockProtection: possible-error=NvMAdministration/E_NOT_OK
        arg ProtectionEnabled: type=boolean, direction=IN, server-argument-impl-policy=USE-ARGUMENT-TYPE
      error E_NOT_OK: error-code=1
    NvMNotifyInitBlock: is-service=true
      operation InitBlock
    NvMNotifyJobFinished: is-service=true
      operation JobFinished
        arg ServiceId: type=NvM_ServiceIdType, direction=IN, server-argument-impl-policy=USE-ARGUMENT-TYPE
        arg JobResult: type=NvM_RequestResultType, direction=IN, server-argument-impl-policy=USE-ARGUMENT-TYPE
    NvMService: is-service=true
      operation GetErrorStatus: possible-error=NvMService/E_NOT_OK
        arg ErrorStatus: type=NvM_RequestResultType, direction=OUT, server-argument-impl-policy=USE-ARGUMENT-TYPE
      error E_NOT_OK: error-code=1
    NvMService_AC2: is-service=true
      operation GetErrorStatus: possible-error=NvMService_AC2/E_NOT_OK
        arg ErrorStatus: type=NvM_RequestResultType, direction=OUT, server-argument-impl-policy=USE-ARGUMENT-TYPE
      operation ReadBlock: possible-error=NvMService_AC2/E_NOT_OK
        arg DstPtr: type=dtRef_VOID, direction=IN, server-argument-impl-policy=USE-ARGUMENT-TYPE
      operation WriteBlock: possible-error=NvMService_AC2/E_NOT_OK
        arg SrcPtr: type=dtRef_const_VOID, direction=IN, server-argument-impl-policy=USE-ARGUMENT-TYPE
      error E_NOT_OK: error-code=1
    NvMService_AC2_Defs: is-service=true
      4 x operation, all with possible-error=NvMService_AC2_Defs/E_NOT_OK:
        GetErrorStatus
          arg ErrorStatus: type=NvM_RequestResultType, direction=OUT, server-argument-impl-policy=USE-ARGUMENT-TYPE
        ReadBlock
          arg DstPtr: type=dtRef_VOID, direction=IN, server-argument-impl-policy=USE-ARGUMENT-TYPE
        RestoreBlockDefaults
          arg DstPtr: type=dtRef_VOID, direction=IN, server-argument-impl-policy=USE-ARGUMENT-TYPE
        WriteBlock
          arg SrcPtr: type=dtRef_const_VOID, direction=IN, server-argument-impl-policy=USE-ARGUMENT-TYPE
      error E_NOT_OK: error-code=1
    NvMService_AC2_DS: is-service=true
      5 x operation, all with possible-error=NvMService_AC2_DS/E_NOT_OK:
        GetDataIndex
          arg DataIndex: type=uint8, direction=OUT, server-argument-impl-policy=USE-ARGUMENT-TYPE
        GetErrorStatus
          arg ErrorStatus: type=NvM_RequestResultType, direction=OUT, server-argument-impl-policy=USE-ARGUMENT-TYPE
        ReadBlock
          arg DstPtr: type=dtRef_VOID, direction=IN, server-argument-impl-policy=USE-ARGUMENT-TYPE
        SetDataIndex
          arg DataIndex: type=uint8, direction=IN, server-argument-impl-policy=USE-ARGUMENT-TYPE
        WriteBlock
          arg SrcPtr: type=dtRef_const_VOID, direction=IN, server-argument-impl-policy=USE-ARGUMENT-TYPE
      error E_NOT_OK: error-code=1
    NvMService_AC2_DS_Defs: is-service=true
      6 x operation, all with possible-error=NvMService_AC2_DS_Defs/E_NOT_OK:
        GetDataIndex
          arg DataIndex: type=uint8, direction=OUT, server-argument-impl-policy=USE-ARGUMENT-TYPE
        GetErrorStatus
          arg ErrorStatus: type=NvM_RequestResultType, direction=OUT, server-argument-impl-policy=USE-ARGUMENT-TYPE
        ReadBlock
          arg DstPtr: type=dtRef_VOID, direction=IN, server-argument-impl-policy=USE-ARGUMENT-TYPE
        RestoreBlockDefaults
          arg DstPtr: type=dtRef_VOID, direction=IN, server-argument-impl-policy=USE-ARGUMENT-TYPE
        SetDataIndex
          arg DataIndex: type=uint8, direction=IN, server-argument-impl-policy=USE-ARGUMENT-TYPE
        WriteBlock
          arg SrcPtr: type=dtRef_const_VOID, direction=IN, server-argument-impl-policy=USE-ARGUMENT-TYPE
      error E_NOT_OK: error-code=1
    NvMService_AC2_SRBS: is-service=true
      4 x operation, all with possible-error=NvMService_AC2_SRBS/E_NOT_OK:
        GetErrorStatus
          arg ErrorStatus: type=NvM_RequestResultType, direction=OUT, server-argument-impl-policy=USE-ARGUMENT-TYPE
        ReadBlock
          arg DstPtr: type=dtRef_VOID, direction=IN, server-argument-impl-policy=USE-ARGUMENT-TYPE
        SetRamBlockStatus
          arg RamBlockStatus: type=boolean, direction=IN, server-argument-impl-policy=USE-ARGUMENT-TYPE
        WriteBlock
          arg SrcPtr: type=dtRef_const_VOID, direction=IN, server-argument-impl-policy=USE-ARGUMENT-TYPE
      error E_NOT_OK: error-code=1
    NvMService_AC2_SRBS_Defs: is-service=true
      5 x operation, all with possible-error=NvMService_AC2_SRBS_Defs/E_NOT_OK:
        GetErrorStatus
          arg ErrorStatus: type=NvM_RequestResultType, direction=OUT, server-argument-impl-policy=USE-ARGUMENT-TYPE
        ReadBlock
          arg DstPtr: type=dtRef_VOID, direction=IN, server-argument-impl-policy=USE-ARGUMENT-TYPE
        RestoreBlockDefaults
          arg DstPtr: type=dtRef_VOID, direction=IN, server-argument-impl-policy=USE-ARGUMENT-TYPE
        SetRamBlockStatus
          arg RamBlockStatus: type=boolean, direction=IN, server-argument-impl-policy=USE-ARGUMENT-TYPE
        WriteBlock
          arg SrcPtr: type=dtRef_const_VOID, direction=IN, server-argument-impl-policy=USE-ARGUMENT-TYPE
      error E_NOT_OK: error-code=1
    NvMService_AC2_SRBS_DS: is-service=true
      6 x operation, all with possible-error=NvMService_AC2_SRBS_DS/E_NOT_OK:
        GetDataIndex
          arg DataIndex: type=uint8, direction=OUT, server-argument-impl-policy=USE-ARGUMENT-TYPE
        GetErrorStatus
          arg ErrorStatus: type=NvM_RequestResultType, direction=OUT, server-argument-impl-policy=USE-ARGUMENT-TYPE
        ReadBlock
          arg DstPtr: type=dtRef_VOID, direction=IN, server-argument-impl-policy=USE-ARGUMENT-TYPE
        SetDataIndex
          arg DataIndex: type=uint8, direction=IN, server-argument-impl-policy=USE-ARGUMENT-TYPE
        SetRamBlockStatus
          arg RamBlockStatus: type=boolean, direction=IN, server-argument-impl-policy=USE-ARGUMENT-TYPE
        WriteBlock
          arg SrcPtr: type=dtRef_const_VOID, direction=IN, server-argument-impl-policy=USE-ARGUMENT-TYPE
      error E_NOT_OK: error-code=1
    NvMService_AC2_SRBS_DS_Defs: is-service=true
      7 x operation, all with possible-error=NvMService_AC2_SRBS_DS_Defs/E_NOT_OK:
        GetDataIndex
          arg DataIndex: type=uint8, direction=OUT, server-argument-impl-policy=USE-ARGUMENT-TYPE
        GetErrorStatus
          arg ErrorStatus: type=NvM_RequestResultType, direction=OUT, server-argument-impl-policy=USE-ARGUMENT-TYPE
        ReadBlock
          arg DstPtr: type=dtRef_VOID, direction=IN, server-argument-impl-policy=USE-ARGUMENT-TYPE
        RestoreBlockDefaults
          arg DstPtr: type=dtRef_VOID, direction=IN, server-argument-impl-policy=USE-ARGUMENT-TYPE
        SetDataIndex
          arg DataIndex: type=uint8, direction=IN, server-argument-impl-policy=USE-ARGUMENT-TYPE
        SetRamBlockStatus
          arg RamBlockStatus: type=boolean, direction=IN, server-argument-impl-policy=USE-ARGUMENT-TYPE
        WriteBlock
          arg SrcPtr: type=dtRef_const_VOID, direction=IN, server-argument-impl-policy=USE-ARGUMENT-TYPE
      error E_NOT_OK: error-code=1
    NvMService_AC3: is-service=true
      5 x operation, all with possible-error=NvMService_AC3/E_NOT_OK:
        EraseBlock
        GetErrorStatus
          arg ErrorStatus: type=NvM_RequestResultType, direction=OUT, server-argument-impl-policy=USE-ARGUMENT-TYPE
        InvalidateNvBlock
        ReadBlock
          arg DstPtr: type=dtRef_VOID, direction=IN, server-argument-impl-policy=USE-ARGUMENT-TYPE
        WriteBlock
          arg SrcPtr: type=dtRef_const_VOID, direction=IN, server-argument-impl-policy=USE-ARGUMENT-TYPE
      error E_NOT_OK: error-code=1
    NvMService_AC3_Defs: is-service=true
      6 x operation, all with possible-error=NvMService_AC3_Defs/E_NOT_OK:
        EraseBlock
        GetErrorStatus
          arg ErrorStatus: type=NvM_RequestResultType, direction=OUT, server-argument-impl-policy=USE-ARGUMENT-TYPE
        InvalidateNvBlock
        ReadBlock
          arg DstPtr: type=dtRef_VOID, direction=IN, server-argument-impl-policy=USE-ARGUMENT-TYPE
        RestoreBlockDefaults
          arg DstPtr: type=dtRef_VOID, direction=IN, server-argument-impl-policy=USE-ARGUMENT-TYPE
        WriteBlock
          arg SrcPtr: type=dtRef_const_VOID, direction=IN, server-argument-impl-policy=USE-ARGUMENT-TYPE
      error E_NOT_OK: error-code=1
    NvMService_AC3_DS: is-service=true
      7 x operation, all with possible-error=NvMService_AC3_DS/E_NOT_OK:
        EraseBlock
        GetDataIndex
          arg DataIndex: type=uint8, direction=OUT, server-argument-impl-policy=USE-ARGUMENT-TYPE
        GetErrorStatus
          arg ErrorStatus: type=NvM_RequestResultType, direction=OUT, server-argument-impl-policy=USE-ARGUMENT-TYPE
        InvalidateNvBlock
        ReadBlock
          arg DstPtr: type=dtRef_VOID, direction=IN, server-argument-impl-policy=USE-ARGUMENT-TYPE
        SetDataIndex
          arg DataIndex: type=uint8, direction=IN, server-argument-impl-policy=USE-ARGUMENT-TYPE
        WriteBlock
          arg SrcPtr: type=dtRef_const_VOID, direction=IN, server-argument-impl-policy=USE-ARGUMENT-TYPE
      error E_NOT_OK: error-code=1
    NvMService_AC3_DS_Defs: is-service=true
      8 x operation, all with possible-error=NvMService_AC3_DS_Defs/E_NOT_OK:
        EraseBlock
        GetDataIndex
          arg DataIndex: type=uint8, direction=OUT, server-argument-impl-policy=USE-ARGUMENT-TYPE
        GetErrorStatus
          arg ErrorStatus: type=NvM_RequestResultType, direction=OUT, server-argument-impl-policy=USE-ARGUMENT-TYPE
        InvalidateNvBlock
        ReadBlock
          arg DstPtr: type=dtRef_VOID, direction=IN, server-argument-impl-policy=USE-ARGUMENT-TYPE
        RestoreBlockDefaults
          arg DstPtr: type=dtRef_VOID, direction=IN, server-argument-impl-policy=USE-ARGUMENT-TYPE
        SetDataIndex
          arg DataIndex: type=uint8, direction=IN, server-argument-impl-policy=USE-ARGUMENT-TYPE
        WriteBlock
          arg SrcPtr: type=dtRef_const_VOID, direction=IN, server-argument-impl-policy=USE-ARGUMENT-TYPE
      error E_NOT_OK: error-code=1
    NvMService_AC3_SRBS: is-service=true
      6 x operation, all with possible-error=NvMService_AC3_SRBS/E_NOT_OK:
        EraseBlock
        GetErrorStatus
          arg ErrorStatus: type=NvM_RequestResultType, direction=OUT, server-argument-impl-policy=USE-ARGUMENT-TYPE
        InvalidateNvBlock
        ReadBlock
          arg DstPtr: type=dtRef_VOID, direction=IN, server-argument-impl-policy=USE-ARGUMENT-TYPE
        SetRamBlockStatus
          arg RamBlockStatus: type=boolean, direction=IN, server-argument-impl-policy=USE-ARGUMENT-TYPE
        WriteBlock
          arg SrcPtr: type=dtRef_const_VOID, direction=IN, server-argument-impl-policy=USE-ARGUMENT-TYPE
      error E_NOT_OK: error-code=1
    NvMService_AC3_SRBS_Defs: is-service=true
      7 x operation, all with possible-error=NvMService_AC3_SRBS_Defs/E_NOT_OK:
        EraseBlock
        GetErrorStatus
          arg ErrorStatus: type=NvM_RequestResultType, direction=OUT, server-argument-impl-policy=USE-ARGUMENT-TYPE
        InvalidateNvBlock
        ReadBlock
          arg DstPtr: type=dtRef_VOID, direction=IN, server-argument-impl-policy=USE-ARGUMENT-TYPE
        RestoreBlockDefaults
          arg DstPtr: type=dtRef_VOID, direction=IN, server-argument-impl-policy=USE-ARGUMENT-TYPE
        SetRamBlockStatus
          arg RamBlockStatus: type=boolean, direction=IN, server-argument-impl-policy=USE-ARGUMENT-TYPE
        WriteBlock
          arg SrcPtr: type=dtRef_const_VOID, direction=IN, server-argument-impl-policy=USE-ARGUMENT-TYPE
      error E_NOT_OK: error-code=1
    NvMService_AC3_SRBS_DS: is-service=true
      8 x operation, all with possible-error=NvMService_AC3_SRBS_DS/E_NOT_OK:
        EraseBlock
        GetDataIndex
          arg DataIndex: type=uint8, direction=OUT, server-argument-impl-policy=USE-ARGUMENT-TYPE
        GetErrorStatus
          arg ErrorStatus: type=NvM_RequestResultType, direction=OUT, server-argument-impl-policy=USE-ARGUMENT-TYPE
        InvalidateNvBlock
        ReadBlock
          arg DstPtr: type=dtRef_VOID, direction=IN, server-argument-impl-policy=USE-ARGUMENT-TYPE
        SetDataIndex
          arg DataIndex: type=uint8, direction=IN, server-argument-impl-policy=USE-ARGUMENT-TYPE
        SetRamBlockStatus
          arg RamBlockStatus: type=boolean, direction=IN, server-argument-impl-policy=USE-ARGUMENT-TYPE
        WriteBlock
          arg SrcPtr: type=dtRef_const_VOID, direction=IN, server-argument-impl-policy=USE-ARGUMENT-TYPE
      error E_NOT_OK: error-code=1
    NvMService_AC3_SRBS_DS_Defs: is-service=true
      9 x operation, all with possible-error=NvMService_AC3_SRBS_DS_Defs/E_NOT_OK:
        EraseBlock
        GetDataIndex
          arg DataIndex: type=uint8, direction=OUT, server-argument-impl-policy=USE-ARGUMENT-TYPE
        GetErrorStatus
          arg ErrorStatus: type=NvM_RequestResultType, direction=OUT, server-argument-impl-policy=USE-ARGUMENT-TYPE
        InvalidateNvBlock
        ReadBlock
          arg DstPtr: type=dtRef_VOID, direction=IN, server-argument-impl-policy=USE-ARGUMENT-TYPE
        RestoreBlockDefaults
          arg DstPtr: type=dtRef_VOID, direction=IN, server-argument-impl-policy=USE-ARGUMENT-TYPE
        SetDataIndex
          arg DataIndex: type=uint8, direction=IN, server-argument-impl-policy=USE-ARGUMENT-TYPE
        SetRamBlockStatus
          arg RamBlockStatus: type=boolean, direction=IN, server-argument-impl-policy=USE-ARGUMENT-TYPE
        WriteBlock
          arg SrcPtr: type=dtRef_const_VOID, direction=IN, server-argument-impl-policy=USE-ARGUMENT-TYPE
      error E_NOT_OK: error-code=1
    NvMService_SRBS: is-service=true
      operation GetErrorStatus: possible-error=NvMService_SRBS/E_NOT_OK
        arg ErrorStatus: type=NvM_RequestResultType, direction=OUT, server-argument-impl-policy=USE-ARGUMENT-TYPE
      operation SetRamBlockStatus: possible-error=NvMService_SRBS/E_NOT_OK
        arg RamBlockStatus: type=boolean, direction=IN, server-argument-impl-policy=USE-ARGUMENT-TYPE
      error E_NOT_OK: error-code=1
    NvSWC_NvMAdministration
      operation SetBlockProtection: possible-error=NvSWC_NvMAdministration/E_NOT_OK
        arg ProtectionEnabled: type=boolean, direction=IN, server-argument-impl-policy=USE-ARGUMENT-TYPE
      error E_NOT_OK: error-code=1
    NvSWC_NvMNotifyInitBlock
      operation InitBlock
    NvSWC_NvMNotifyJobFinished
      operation JobFinished
        arg ServiceId: type=NvM_ServiceIdType, direction=IN, server-argument-impl-policy=USE-ARGUMENT-TYPE
        arg JobResult: type=NvM_RequestResultType, direction=IN, server-argument-impl-policy=USE-ARGUMENT-TYPE
    NvSWC_NvMService
      operation GetErrorStatus: possible-error=NvSWC_NvMService/E_NOT_OK
        arg ErrorStatus: type=NvM_RequestResultType, direction=OUT, server-argument-impl-policy=USE-ARGUMENT-TYPE
      error E_NOT_OK: error-code=1
    NvSWC_NvMService_AC2
      operation GetErrorStatus: possible-error=NvSWC_NvMService_AC2/E_NOT_OK
        arg ErrorStatus: type=NvM_RequestResultType, direction=OUT, server-argument-impl-policy=USE-ARGUMENT-TYPE
      operation ReadBlock: possible-error=NvSWC_NvMService_AC2/E_NOT_OK
        arg DstPtr: type=dtRef_VOID, direction=IN, server-argument-impl-policy=USE-ARGUMENT-TYPE
      operation WriteBlock: possible-error=NvSWC_NvMService_AC2/E_NOT_OK
        arg SrcPtr: type=dtRef_const_VOID, direction=IN, server-argument-impl-policy=USE-ARGUMENT-TYPE
      error E_NOT_OK: error-code=1
    NvSWC_NvMService_AC2_Defs
      4 x operation, all with possible-error=NvSWC_NvMService_AC2_Defs/E_NOT_OK:
        GetErrorStatus
          arg ErrorStatus: type=NvM_RequestResultType, direction=OUT, server-argument-impl-policy=USE-ARGUMENT-TYPE
        ReadBlock
          arg DstPtr: type=dtRef_VOID, direction=IN, server-argument-impl-policy=USE-ARGUMENT-TYPE
        RestoreBlockDefaults
          arg DstPtr: type=dtRef_VOID, direction=IN, server-argument-impl-policy=USE-ARGUMENT-TYPE
        WriteBlock
          arg SrcPtr: type=dtRef_const_VOID, direction=IN, server-argument-impl-policy=USE-ARGUMENT-TYPE
      error E_NOT_OK: error-code=1
    NvSWC_NvMService_AC2_DS
      5 x operation, all with possible-error=NvSWC_NvMService_AC2_DS/E_NOT_OK:
        GetDataIndex
          arg DataIndex: type=uint8, direction=OUT, server-argument-impl-policy=USE-ARGUMENT-TYPE
        GetErrorStatus
          arg ErrorStatus: type=NvM_RequestResultType, direction=OUT, server-argument-impl-policy=USE-ARGUMENT-TYPE
        ReadBlock
          arg DstPtr: type=dtRef_VOID, direction=IN, server-argument-impl-policy=USE-ARGUMENT-TYPE
        SetDataIndex
          arg DataIndex: type=uint8, direction=IN, server-argument-impl-policy=USE-ARGUMENT-TYPE
        WriteBlock
          arg SrcPtr: type=dtRef_const_VOID, direction=IN, server-argument-impl-policy=USE-ARGUMENT-TYPE
      error E_NOT_OK: error-code=1
    NvSWC_NvMService_AC2_DS_Defs
      6 x operation, all with possible-error=NvSWC_NvMService_AC2_DS_Defs/E_NOT_OK:
        GetDataIndex
          arg DataIndex: type=uint8, direction=OUT, server-argument-impl-policy=USE-ARGUMENT-TYPE
        GetErrorStatus
          arg ErrorStatus: type=NvM_RequestResultType, direction=OUT, server-argument-impl-policy=USE-ARGUMENT-TYPE
        ReadBlock
          arg DstPtr: type=dtRef_VOID, direction=IN, server-argument-impl-policy=USE-ARGUMENT-TYPE
        RestoreBlockDefaults
          arg DstPtr: type=dtRef_VOID, direction=IN, server-argument-impl-policy=USE-ARGUMENT-TYPE
        SetDataIndex
          arg DataIndex: type=uint8, direction=IN, server-argument-impl-policy=USE-ARGUMENT-TYPE
        WriteBlock
          arg SrcPtr: type=dtRef_const_VOID, direction=IN, server-argument-impl-policy=USE-ARGUMENT-TYPE
      error E_NOT_OK: error-code=1
    NvSWC_NvMService_AC2_SRBS
      4 x operation, all with possible-error=NvSWC_NvMService_AC2_SRBS/E_NOT_OK:
        GetErrorStatus
          arg ErrorStatus: type=NvM_RequestResultType, direction=OUT, server-argument-impl-policy=USE-ARGUMENT-TYPE
        ReadBlock
          arg DstPtr: type=dtRef_VOID, direction=IN, server-argument-impl-policy=USE-ARGUMENT-TYPE
        SetRamBlockStatus
          arg RamBlockStatus: type=boolean, direction=IN, server-argument-impl-policy=USE-ARGUMENT-TYPE
        WriteBlock
          arg SrcPtr: type=dtRef_const_VOID, direction=IN, server-argument-impl-policy=USE-ARGUMENT-TYPE
      error E_NOT_OK: error-code=1
    NvSWC_NvMService_AC2_SRBS_Defs
      5 x operation, all with possible-error=NvSWC_NvMService_AC2_SRBS_Defs/E_NOT_OK:
        GetErrorStatus
          arg ErrorStatus: type=NvM_RequestResultType, direction=OUT, server-argument-impl-policy=USE-ARGUMENT-TYPE
        ReadBlock
          arg DstPtr: type=dtRef_VOID, direction=IN, server-argument-impl-policy=USE-ARGUMENT-TYPE
        RestoreBlockDefaults
          arg DstPtr: type=dtRef_VOID, direction=IN, server-argument-impl-policy=USE-ARGUMENT-TYPE
        SetRamBlockStatus
          arg RamBlockStatus: type=boolean, direction=IN, server-argument-impl-policy=USE-ARGUMENT-TYPE
        WriteBlock
          arg SrcPtr: type=dtRef_const_VOID, direction=IN, server-argument-impl-policy=USE-ARGUMENT-TYPE
      error E_NOT_OK: error-code=1
    NvSWC_NvMService_AC2_SRBS_DS
      6 x operation, all with possible-error=NvSWC_NvMService_AC2_SRBS_DS/E_NOT_OK:
        GetDataIndex
          arg DataIndex: type=uint8, direction=OUT, server-argument-impl-policy=USE-ARGUMENT-TYPE
        GetErrorStatus
          arg ErrorStatus: type=NvM_RequestResultType, direction=OUT, server-argument-impl-policy=USE-ARGUMENT-TYPE
        ReadBlock
          arg DstPtr: type=dtRef_VOID, direction=IN, server-argument-impl-policy=USE-ARGUMENT-TYPE
        SetDataIndex
          arg DataIndex: type=uint8, direction=IN, server-argument-impl-policy=USE-ARGUMENT-TYPE
        SetRamBlockStatus
          arg RamBlockStatus: type=boolean, direction=IN, server-argument-impl-policy=USE-ARGUMENT-TYPE
        WriteBlock
          arg SrcPtr: type=dtRef_const_VOID, direction=IN, server-argument-impl-policy=USE-ARGUMENT-TYPE
      error E_NOT_OK: error-code=1
    NvSWC_NvMService_AC2_SRBS_DS_Defs
      7 x operation, all with possible-error=NvSWC_NvMService_AC2_SRBS_DS_Defs/E_NOT_OK:
        GetDataIndex
          arg DataIndex: type=uint8, direction=OUT, server-argument-impl-policy=USE-ARGUMENT-TYPE
        GetErrorStatus
          arg ErrorStatus: type=NvM_RequestResultType, direction=OUT, server-argument-impl-policy=USE-ARGUMENT-TYPE
        ReadBlock
          arg DstPtr: type=dtRef_VOID, direction=IN, server-argument-impl-policy=USE-ARGUMENT-TYPE
        RestoreBlockDefaults
          arg DstPtr: type=dtRef_VOID, direction=IN, server-argument-impl-policy=USE-ARGUMENT-TYPE
        SetDataIndex
          arg DataIndex: type=uint8, direction=IN, server-argument-impl-policy=USE-ARGUMENT-TYPE
        SetRamBlockStatus
          arg RamBlockStatus: type=boolean, direction=IN, server-argument-impl-policy=USE-ARGUMENT-TYPE
        WriteBlock
          arg SrcPtr: type=dtRef_const_VOID, direction=IN, server-argument-impl-policy=USE-ARGUMENT-TYPE
      error E_NOT_OK: error-code=1
    NvSWC_NvMService_AC3
      5 x operation, all with possible-error=NvSWC_NvMService_AC3/E_NOT_OK:
        EraseBlock
        GetErrorStatus
          arg ErrorStatus: type=NvM_RequestResultType, direction=OUT, server-argument-impl-policy=USE-ARGUMENT-TYPE
        InvalidateNvBlock
        ReadBlock
          arg DstPtr: type=dtRef_VOID, direction=IN, server-argument-impl-policy=USE-ARGUMENT-TYPE
        WriteBlock
          arg SrcPtr: type=dtRef_const_VOID, direction=IN, server-argument-impl-policy=USE-ARGUMENT-TYPE
      error E_NOT_OK: error-code=1
    NvSWC_NvMService_AC3_Defs
      6 x operation, all with possible-error=NvSWC_NvMService_AC3_Defs/E_NOT_OK:
        EraseBlock
        GetErrorStatus
          arg ErrorStatus: type=NvM_RequestResultType, direction=OUT, server-argument-impl-policy=USE-ARGUMENT-TYPE
        InvalidateNvBlock
        ReadBlock
          arg DstPtr: type=dtRef_VOID, direction=IN, server-argument-impl-policy=USE-ARGUMENT-TYPE
        RestoreBlockDefaults
          arg DstPtr: type=dtRef_VOID, direction=IN, server-argument-impl-policy=USE-ARGUMENT-TYPE
        WriteBlock
          arg SrcPtr: type=dtRef_const_VOID, direction=IN, server-argument-impl-policy=USE-ARGUMENT-TYPE
      error E_NOT_OK: error-code=1
    NvSWC_NvMService_AC3_DS
      7 x operation, all with possible-error=NvSWC_NvMService_AC3_DS/E_NOT_OK:
        EraseBlock
        GetDataIndex
          arg DataIndex: type=uint8, direction=OUT, server-argument-impl-policy=USE-ARGUMENT-TYPE
        GetErrorStatus
          arg ErrorStatus: type=NvM_RequestResultType, direction=OUT, server-argument-impl-policy=USE-ARGUMENT-TYPE
        InvalidateNvBlock
        ReadBlock
          arg DstPtr: type=dtRef_VOID, direction=IN, server-argument-impl-policy=USE-ARGUMENT-TYPE
        SetDataIndex
          arg DataIndex: type=uint8, direction=IN, server-argument-impl-policy=USE-ARGUMENT-TYPE
        WriteBlock
          arg SrcPtr: type=dtRef_const_VOID, direction=IN, server-argument-impl-policy=USE-ARGUMENT-TYPE
      error E_NOT_OK: error-code=1
    NvSWC_NvMService_AC3_DS_Defs
      8 x operation, all with possible-error=NvSWC_NvMService_AC3_DS_Defs/E_NOT_OK:
        EraseBlock
        GetDataIndex
          arg DataIndex: type=uint8, direction=OUT, server-argument-impl-policy=USE-ARGUMENT-TYPE
        GetErrorStatus
          arg ErrorStatus: type=NvM_RequestResultType, direction=OUT, server-argument-impl-policy=USE-ARGUMENT-TYPE
        InvalidateNvBlock
        ReadBlock
          arg DstPtr: type=dtRef_VOID, direction=IN, server-argument-impl-policy=USE-ARGUMENT-TYPE
        RestoreBlockDefaults
          arg DstPtr: type=dtRef_VOID, direction=IN, server-argument-impl-policy=USE-ARGUMENT-TYPE
        SetDataIndex
          arg DataIndex: type=uint8, direction=IN, server-argument-impl-policy=USE-ARGUMENT-TYPE
        WriteBlock
          arg SrcPtr: type=dtRef_const_VOID, direction=IN, server-argument-impl-policy=USE-ARGUMENT-TYPE
      error E_NOT_OK: error-code=1
    NvSWC_NvMService_AC3_SRBS
      6 x operation, all with possible-error=NvSWC_NvMService_AC3_SRBS/E_NOT_OK:
        EraseBlock
        GetErrorStatus
          arg ErrorStatus: type=NvM_RequestResultType, direction=OUT, server-argument-impl-policy=USE-ARGUMENT-TYPE
        InvalidateNvBlock
        ReadBlock
          arg DstPtr: type=dtRef_VOID, direction=IN, server-argument-impl-policy=USE-ARGUMENT-TYPE
        SetRamBlockStatus
          arg RamBlockStatus: type=boolean, direction=IN, server-argument-impl-policy=USE-ARGUMENT-TYPE
        WriteBlock
          arg SrcPtr: type=dtRef_const_VOID, direction=IN, server-argument-impl-policy=USE-ARGUMENT-TYPE
      error E_NOT_OK: error-code=1
    NvSWC_NvMService_AC3_SRBS_Defs
      7 x operation, all with possible-error=NvSWC_NvMService_AC3_SRBS_Defs/E_NOT_OK:
        EraseBlock
        GetErrorStatus
          arg ErrorStatus: type=NvM_RequestResultType, direction=OUT, server-argument-impl-policy=USE-ARGUMENT-TYPE
        InvalidateNvBlock
        ReadBlock
          arg DstPtr: type=dtRef_VOID, direction=IN, server-argument-impl-policy=USE-ARGUMENT-TYPE
        RestoreBlockDefaults
          arg DstPtr: type=dtRef_VOID, direction=IN, server-argument-impl-policy=USE-ARGUMENT-TYPE
        SetRamBlockStatus
          arg RamBlockStatus: type=boolean, direction=IN, server-argument-impl-policy=USE-ARGUMENT-TYPE
        WriteBlock
          arg SrcPtr: type=dtRef_const_VOID, direction=IN, server-argument-impl-policy=USE-ARGUMENT-TYPE
      error E_NOT_OK: error-code=1
    NvSWC_NvMService_AC3_SRBS_DS
      8 x operation, all with possible-error=NvSWC_NvMService_AC3_SRBS_DS/E_NOT_OK:
        EraseBlock
        GetDataIndex
          arg DataIndex: type=uint8, direction=OUT, server-argument-impl-policy=USE-ARGUMENT-TYPE
        GetErrorStatus
          arg ErrorStatus: type=NvM_RequestResultType, direction=OUT, server-argument-impl-policy=USE-ARGUMENT-TYPE
        InvalidateNvBlock
        ReadBlock
          arg DstPtr: type=dtRef_VOID, direction=IN, server-argument-impl-policy=USE-ARGUMENT-TYPE
        SetDataIndex
          arg DataIndex: type=uint8, direction=IN, server-argument-impl-policy=USE-ARGUMENT-TYPE
        SetRamBlockStatus
          arg RamBlockStatus: type=boolean, direction=IN, server-argument-impl-policy=USE-ARGUMENT-TYPE
        WriteBlock
          arg SrcPtr: type=dtRef_const_VOID, direction=IN, server-argument-impl-policy=USE-ARGUMENT-TYPE
      error E_NOT_OK: error-code=1
    NvSWC_NvMService_AC3_SRBS_DS_Defs
      9 x operation, all with possible-error=NvSWC_NvMService_AC3_SRBS_DS_Defs/E_NOT_OK:
        EraseBlock
        GetDataIndex
          arg DataIndex: type=uint8, direction=OUT, server-argument-impl-policy=USE-ARGUMENT-TYPE
        GetErrorStatus
          arg ErrorStatus: type=NvM_RequestResultType, direction=OUT, server-argument-impl-policy=USE-ARGUMENT-TYPE
        InvalidateNvBlock
        ReadBlock
          arg DstPtr: type=dtRef_VOID, direction=IN, server-argument-impl-policy=USE-ARGUMENT-TYPE
        RestoreBlockDefaults
          arg DstPtr: type=dtRef_VOID, direction=IN, server-argument-impl-policy=USE-ARGUMENT-TYPE
        SetDataIndex
          arg DataIndex: type=uint8, direction=IN, server-argument-impl-policy=USE-ARGUMENT-TYPE
        SetRamBlockStatus
          arg RamBlockStatus: type=boolean, direction=IN, server-argument-impl-policy=USE-ARGUMENT-TYPE
        WriteBlock
          arg SrcPtr: type=dtRef_const_VOID, direction=IN, server-argument-impl-policy=USE-ARGUMENT-TYPE
      error E_NOT_OK: error-code=1
    NvSWC_NvMService_SRBS
      operation GetErrorStatus: possible-error=NvSWC_NvMService_SRBS/E_NOT_OK
        arg ErrorStatus: type=NvM_RequestResultType, direction=OUT, server-argument-impl-policy=USE-ARGUMENT-TYPE
      operation SetRamBlockStatus: possible-error=NvSWC_NvMService_SRBS/E_NOT_OK
        arg RamBlockStatus: type=boolean, direction=IN, server-argument-impl-policy=USE-ARGUMENT-TYPE
      error E_NOT_OK: error-code=1
package /Systems/ModeDeclarationGroups/BasePartialNetworks
  mode declaration group PWFVehicleState: category=ALPHABETIC_ORDER, initial-mode=KEINE_KOMMUNIKATION
    mode KEINE_KOMMUNIKATION
    mode UNGUELTIG
  mode declaration group UNGUELTIG: category=ALPHABETIC_ORDER, initial-mode=UNGUELTIG/UNGUELTIG_OFF
    mode UNGUELTIG_OFF
    mode UNGUELTIG_ON
package /Systems/ModeDeclarationGroups/FunctionalPartialNetworks
  mode declaration group Ungueltig: category=ALPHABETIC_ORDER, initial-mode=Ungueltig/UNGUELTIG_OFF
    mode UNGUELTIG_OFF
    mode UNGUELTIG_ON
