[part 1 of 2: packages /BMW/Platform/Auth/Dcm/PortInterfaces to /Nexteer/Calibrations]
AUTOSAR XML (schema 4-2-2)
package /BMW/Platform/Auth/Dcm/PortInterfaces
  client server interface SecurityAccess_Coding: is-service=true
    operation CompareKey: possible-error=[SecurityAccess_Coding/DCM_E_COMPARE_KEY_FAILED, SecurityAccess_Coding/E_NOT_OK]
      arg Key: type=Dcm_SecKeyCoding_ArrayType, direction=IN, server-argument-impl-policy=USE-ARGUMENT-TYPE
      arg OpStatus: type=Dcm_OpStatusType, direction=IN, server-argument-impl-policy=USE-ARGUMENT-TYPE
      arg ErrorCode: type=Dcm_NegativeResponseCodeType, direction=OUT, server-argument-impl-policy=USE-ARGUMENT-TYPE
    operation GetSeed: possible-error=[SecurityAccess_Coding/E_NOT_OK, SecurityAccess_Coding/DCM_E_PENDING]
      4 x arg, all with server-argument-impl-policy=USE-ARGUMENT-TYPE:
        SecurityAccessDataRecord: type=Dcm_SecAccDataRecCoding_ArrayType, direction=IN
        OpStatus: type=Dcm_OpStatusType, direction=IN
        Seed: type=Dcm_SecSeedCoding_ArrayType, direction=OUT
        ErrorCode: type=Dcm_NegativeResponseCodeType, direction=OUT
    error DCM_E_COMPARE_KEY_FAILED: error-code=11
    error DCM_E_PENDING: error-code=10
    error E_NOT_OK: error-code=1
  client server interface SecurityAccess_Swt: is-service=true
    operation CompareKey: possible-error=[SecurityAccess_Swt/DCM_E_COMPARE_KEY_FAILED, SecurityAccess_Swt/E_NOT_OK]
      arg Key: type=Dcm_SecKeySwt_ArrayType, direction=IN, server-argument-impl-policy=USE-ARGUMENT-TYPE
      arg OpStatus: type=Dcm_OpStatusType, direction=IN, server-argument-impl-policy=USE-ARGUMENT-TYPE
      arg ErrorCode: type=Dcm_NegativeResponseCodeType, direction=OUT, server-argument-impl-policy=USE-ARGUMENT-TYPE
    operation GetSeed: possible-error=[SecurityAccess_Swt/E_NOT_OK, SecurityAccess_Swt/DCM_E_PENDING]
      4 x arg, all with server-argument-impl-policy=USE-ARGUMENT-TYPE:
        SecurityAccessDataRecord: type=Dcm_SecAccDataRecSwt_ArrayType, direction=IN
        OpStatus: type=Dcm_OpStatusType, direction=IN
        Seed: type=Dcm_SecSeedSwt_ArrayType, direction=OUT
        ErrorCode: type=Dcm_NegativeResponseCodeType, direction=OUT
    error DCM_E_COMPARE_KEY_FAILED: error-code=11
    error DCM_E_PENDING: error-code=10
    error E_NOT_OK: error-code=1
package /BMW/Platform/Auth/Dlog/PortInterfaces
  client server interface RandomSeed
    operation Get
      arg seed: type=Dlog_RandomSeedType, direction=OUT, server-argument-impl-policy=USE-ARGUMENT-TYPE
    operation Set: possible-error=[RandomSeed/E_PENDING, RandomSeed/E_NOT_OK]
      arg seed: type=Dlog_RandomSeedType, direction=IN, server-argument-impl-policy=USE-ARGUMENT-TYPE
      arg OpStatus: type=Dcm_OpStatusType, direction=IN, server-argument-impl-policy=USE-ARGUMENT-TYPE
    error E_NOT_OK: error-code=1
    error E_PENDING: error-code=10
  client server interface SweInfo: service-kind=BASIC-SOFTWARE-MODE-MANAGER
    operation GetSgbmId: possible-error=SweInfo/E_NOT_OK
      arg SweId: type=uint8, direction=IN, server-argument-impl-policy=USE-ARGUMENT-TYPE
      arg SgbmId: type=Dlog_SgbmIdArrayType, direction=OUT, server-argument-impl-policy=USE-ARGUMENT-TYPE
    operation IsValid: possible-error=SweInfo/E_NOT_OK
      arg sweId: type=uint8, direction=IN, server-argument-impl-policy=USE-ARGUMENT-TYPE
    error E_NOT_OK: error-code=1
package /BMW/Platform/Coding/Dcm/PortInterfaces
  6 x client server interface, all with is-service=true:
    DataServices_DcmDspData_CPS
      operation ConditionCheckRead: possible-error=[DataServices_DcmDspData_CPS/E_OK, DataServices_DcmDspData_CPS/E_NOT_OK]
        arg ErrorCode: type=Dcm_NegativeResponseCodeType, direction=OUT, server-argument-impl-policy=USE-ARGUMENT-TYPE
      operation ReadData: possible-error=[DataServices_DcmDspData_CPS/E_OK, DataServices_DcmDspData_CPS/E_NOT_OK]
        arg Data: type=Dcm_Data18ByteType, direction=OUT, server-argument-impl-policy=USE-ARGUMENT-TYPE
      error E_NOT_OK: error-code=1
      error E_OK: error-code=0
    DataServices_DcmDspData_protocolData
      operation ConditionCheckRead: possible-error=[DataServices_DcmDspData_protocolData/E_OK, DataServices_DcmDspData_protocolData/E_NOT_OK]
        arg ErrorCode: type=Dcm_NegativeResponseCodeType, direction=OUT, server-argument-impl-policy=USE-ARGUMENT-TYPE
      operation ReadData: possible-error=[DataServices_DcmDspData_protocolData/E_OK, DataServices_DcmDspData_protocolData/E_NOT_OK]
        arg Data: type=Dcm_Data9ByteType, direction=OUT, server-argument-impl-policy=USE-ARGUMENT-TYPE
      error E_NOT_OK: error-code=1
      error E_OK: error-code=0
    RoutineServices_DcmDspRoutine_checkNCD
      operation Start: possible-error=[RoutineServices_DcmDspRoutine_checkNCD/E_NOT_OK, RoutineServices_DcmDspRoutine_checkNCD/DCM_E_PENDING, RoutineServices_DcmDspRoutine_checkNCD/DCM_E_FORCE_RCRRP]
        5 x arg, all with server-argument-impl-policy=USE-ARGUMENT-TYPE:
          DcmDspStartRoutineInSignal: type=Dcm_Data18ByteType, direction=IN
          OpStatus: type=Dcm_OpStatusType, direction=IN
          DcmDspStartRoutineOutSignal: type=uint8, direction=OUT
          DataLength: type=uint16, direction=IN
          ErrorCode: type=Dcm_NegativeResponseCodeType, direction=OUT
      error DCM_E_FORCE_RCRRP: error-code=12
      error DCM_E_PENDING: error-code=10
      error E_NOT_OK: error-code=1
    RoutineServices_DcmDspRoutine_readNCD
      operation Start: possible-error=[RoutineServices_DcmDspRoutine_readNCD/E_NOT_OK, RoutineServices_DcmDspRoutine_readNCD/DCM_E_PENDING, RoutineServices_DcmDspRoutine_readNCD/DCM_E_FORCE_RCRRP]
        5 x arg, all with server-argument-impl-policy=USE-ARGUMENT-TYPE:
          DcmDspStartRoutineInSignal: type=Dcm_Data6ByteType, direction=IN
          OpStatus: type=Dcm_OpStatusType, direction=IN
          DcmDspStartRoutineOutSignal: type=Dcm_Data1024ByteType, direction=OUT
          DataLength: type=uint16, direction=OUT
          ErrorCode: type=Dcm_NegativeResponseCodeType, direction=OUT
      error DCM_E_FORCE_RCRRP: error-code=12
      error DCM_E_PENDING: error-code=10
      error E_NOT_OK: error-code=1
    RoutineServices_DcmDspRoutine_writeNCD
      operation Start: possible-error=[RoutineServices_DcmDspRoutine_writeNCD/E_NOT_OK, RoutineServices_DcmDspRoutine_writeNCD/DCM_E_PENDING, RoutineServices_DcmDspRoutine_writeNCD/DCM_E_FORCE_RCRRP]
        4 x arg, all with server-argument-impl-policy=USE-ARGUMENT-TYPE:
          DcmDspStartRoutineInSignal: type=Dcm_Data1024ByteType, direction=IN
          OpStatus: type=Dcm_OpStatusType, direction=IN
          DataLength: type=uint16, direction=IN
          ErrorCode: type=Dcm_NegativeResponseCodeType, direction=OUT
      error DCM_E_FORCE_RCRRP: error-code=12
      error DCM_E_PENDING: error-code=10
      error E_NOT_OK: error-code=1
    ServiceRequestNotification
      operation Confirmation: possible-error=[ServiceRequestNotification/E_OK, ServiceRequestNotification/E_NOT_OK]
        4 x arg, all with direction=IN, server-argument-impl-policy=USE-ARGUMENT-TYPE:
          SID: type=uint8
          ReqType: type=uint8
          SourceAddress: type=uint16
          ConfirmationStatus: type=Dcm_ConfirmationStatusType
      operation Indication: possible-error=[ServiceRequestNotification/E_OK, ServiceRequestNotification/E_NOT_OK, ServiceRequestNotification/E_REQUEST_NOT_ACCEPTED]
        6 x arg, all with server-argument-impl-policy=USE-ARGUMENT-TYPE:
          SID: type=uint8, direction=IN
          RequestData: type=Dcm_Data1024ByteType, direction=IN
          DataSize: type=uint16, direction=IN
          ReqType: type=uint8, direction=IN
          SourceAddress: type=uint16, direction=IN
          ErrorCode: type=Dcm_NegativeResponseCodeType, direction=OUT
      error E_NOT_OK: error-code=1
      error E_OK: error-code=0
      error E_REQUEST_NOT_ACCEPTED: error-code=8
package /BMW/Platform/Coding/Dem/PortInterfaces
  client server interface CallbackClearEventAllowed: is-service=true
    operation ClearEventAllowed: possible-error=[CallbackClearEventAllowed/E_OK, CallbackClearEventAllowed/E_NOT_OK]
      arg allowed: type=boolean, direction=OUT, server-argument-impl-policy=USE-ARGUMENT-TYPE
    error E_NOT_OK: error-code=1
    error E_OK: error-code=0
  client server interface DiagnosticMonitor: is-service=true
    operation SetEventStatus: possible-error=[DiagnosticMonitor/E_OK, DiagnosticMonitor/E_NOT_OK]
      arg EventStatus: type=Dem_EventStatusType, direction=IN, server-argument-impl-policy=USE-ARGUMENT-TYPE
    error E_NOT_OK: error-code=1
    error E_OK: error-code=0
package /BMW/Platform/Coding/Dlog/PortInterfaces
  sender receiver interface ProgId: invalidation-policy{data-element=ProgId/progId, handle-invalid=DONT-INVALIDATE}
    data progId: type=Dlog_ProgIdArrayType
package /BMW/Platform/Coding/ModeDeclarationGroups
  5 x mode declaration group, all with category=EXPLICIT_ORDER:
    Coding_BusComMode: initial-mode=CODING_BUSCOMOFF, on-transition-value=2
      mode CODING_BUSCOMOFF: value=0
      mode CODING_BUSCOMON: value=1
    Coding_ConditionMode: initial-mode=Coding_ConditionMode/CODING_ALLOWED, on-transition-value=2
      mode CODING_ALLOWED: value=0
      mode CODING_NOT_ALLOWED: value=1
    Coding_DataMode: initial-mode=NCDSTATE_UNDEFINED, on-transition-value=5
      5 x mode:
        NCDSTATE_DEFAULT: value=1
        NCDSTATE_INPROGRESS: value=0
        NCDSTATE_QUALIFIED: value=2
        NCDSTATE_UNDEFINED: value=3
        NCDSTATE_UNQUALIFIED: value=4
    Coding_LifeCycle: initial-mode=CODING_STOPPED, on-transition-value=3
      mode CODING_INITIALIZED: value=0
      mode CODING_RUNNING: value=1
      mode CODING_STOPPED: value=2
    Coding_SessionMode: initial-mode=CODING_SESSION_INACTIVE, on-transition-value=2
      mode CODING_SESSION_ACTIVE: value=0
      mode CODING_SESSION_INACTIVE: value=1
package /BMW/Platform/Coding/NvM/PortInterfaces
  client server interface NvMNotifyJobFinished: is-service=true
    operation JobFinished: possible-error=NvMNotifyJobFinished/E_OK
      arg ServiceId: type=uint8, direction=IN, server-argument-impl-policy=USE-ARGUMENT-TYPE
      arg JobResult: type=NvM_RequestResultType, direction=IN, server-argument-impl-policy=USE-ARGUMENT-TYPE
    error E_OK: error-code=0
  client server interface NvMService: is-service=true
    operation ReadBlock: possible-error=[NvMService/E_OK, NvMService/E_NOT_OK]
      arg DstPtr: type=VoidPtr, direction=IN, server-argument-impl-policy=USE-ARGUMENT-TYPE
    operation WriteBlock: possible-error=[NvMService/E_OK, NvMService/E_NOT_OK]
      arg SrcPtr: type=ConstVoidPtr, direction=IN, server-argument-impl-policy=USE-ARGUMENT-TYPE
    error E_NOT_OK: error-code=1
    error E_OK: error-code=0
package /BMW/Platform/Coding/PortInterfaces
  client server interface CheckCurrentLimit
    operation CheckPlausibility: possible-error=CheckCurrentLimit/E_NOT_OK
      arg Value: type=uint8, direction=IN, server-argument-impl-policy=USE-ARGUMENT-TYPE
    error E_NOT_OK: error-code=1
  client server interface Coding_SVKInterface
    operation GetCafIds: possible-error=Coding_SVKInterface/E_OK
      arg cafIds: type=Coding_CafIdArrayType, direction=OUT, server-argument-impl-policy=USE-ARGUMENT-TYPE
      arg numberOfCafIds: type=uint16, direction=OUT, server-argument-impl-policy=USE-ARGUMENT-TYPE
    error E_OK: error-code=0
  client server interface Data
    72 x operation, all with possible-error=Data/E_NOT_OK:
      GetCurrentLimit
        arg Value: type=uint8, direction=OUT, server-argument-impl-policy=USE-ARGUMENT-TYPE
      GetNAME00_00_CalculationOfLoadMinusstateMinusdependentSteeringAssistance
        arg Value: type=boolean, direction=OUT, server-argument-impl-policy=USE-ARGUMENT-TYPE
      GetNAME00_01_CalculationOfActiveReturn
        arg Value: type=boolean, direction=OUT, server-argument-impl-policy=USE-ARGUMENT-TYPE
      GetNAME00_02_reserved
        arg Value: type=boolean, direction=OUT, server-argument-impl-policy=USE-ARGUMENT-TYPE
      GetNAME00_03_ActiveInfluenceOnTheSteeringHysterisis
        arg Value: type=boolean, direction=OUT, server-argument-impl-policy=USE-ARGUMENT-TYPE
      GetNAME00_04_reserved
        arg Value: type=boolean, direction=OUT, server-argument-impl-policy=USE-ARGUMENT-TYPE
      GetNAME00_05_reserved
        arg Value: type=boolean, direction=OUT, server-argument-impl-policy=USE-ARGUMENT-TYPE
      GetNAME00_06_reserved
        arg Value: type=boolean, direction=OUT, server-argument-impl-policy=USE-ARGUMENT-TYPE
      GetNAME00_07_reserved
        arg Value: type=boolean, direction=OUT, server-argument-impl-policy=USE-ARGUMENT-TYPE
      GetNAME01_00_reserved
        arg Value: type=boolean, direction=OUT, server-argument-impl-policy=USE-ARGUMENT-TYPE
      GetNAME01_01_reserved
        arg Value: type=boolean, direction=OUT, server-argument-impl-policy=USE-ARGUMENT-TYPE
      GetNAME01_02_reserved
        arg Value: type=boolean, direction=OUT, server-argument-impl-policy=USE-ARGUMENT-TYPE
      GetNAME01_03_ParkingPowerDamping
        arg Value: type=boolean, direction=OUT, server-argument-impl-policy=USE-ARGUMENT-TYPE
      GetNAME01_04_reserved
        arg Value: type=boolean, direction=OUT, server-argument-impl-policy=USE-ARGUMENT-TYPE
      GetNAME01_05_reserved
        arg Value: type=boolean, direction=OUT, server-argument-impl-policy=USE-ARGUMENT-TYPE
      GetNAME01_06_reserved
        arg Value: type=boolean, direction=OUT, server-argument-impl-policy=USE-ARGUMENT-TYPE
      GetNAME01_07_reserved
        arg Value: type=boolean, direction=OUT, server-argument-impl-policy=USE-ARGUMENT-TYPE
      GetNAME02_00_CompensationOfFriction
        arg Value: type=boolean, direction=OUT, server-argument-impl-policy=USE-ARGUMENT-TYPE
      GetNAME02_01_CompensationOfConstantSteeringPullAndLateralInclinationPull
        arg Value: type=boolean, direction=OUT, server-argument-impl-policy=USE-ARGUMENT-TYPE
      GetNAME02_02
        arg Value: type=boolean, direction=OUT, server-argument-impl-policy=USE-ARGUMENT-TYPE
      GetNAME02_03
        arg Value: type=boolean, direction=OUT, server-argument-impl-policy=USE-ARGUMENT-TYPE
      GetNAME02_04_CompensationOfInertiaOfTheSteeringGear
        arg Value: type=boolean, direction=OUT, server-argument-impl-policy=USE-ARGUMENT-TYPE
      GetNAME02_05_CompensationOfInertiaOfTheSteeringWheel
        arg Value: type=boolean, direction=OUT, server-argument-impl-policy=USE-ARGUMENT-TYPE
      GetNAME02_06
        arg Value: type=boolean, direction=OUT, server-argument-impl-policy=USE-ARGUMENT-TYPE
      GetNAME02_07
        arg Value: type=boolean, direction=OUT, server-argument-impl-policy=USE-ARGUMENT-TYPE
      GetNAME03_00_reserved
        arg Value: type=boolean, direction=OUT, server-argument-impl-policy=USE-ARGUMENT-TYPE
      GetNAME03_01_VoltageDependantDegredation
        arg Value: type=boolean, direction=OUT, server-argument-impl-policy=USE-ARGUMENT-TYPE
      GetNAME03_02_SpeedDependantDegredation
        arg Value: type=boolean, direction=OUT, server-argument-impl-policy=USE-ARGUMENT-TYPE
      GetNAME03_03_reserved
        arg Value: type=boolean, direction=OUT, server-argument-impl-policy=USE-ARGUMENT-TYPE
      GetNAME03_04_reserved
        arg Value: type=boolean, direction=OUT, server-argument-impl-policy=USE-ARGUMENT-TYPE
      GetNAME03_05_reserved
        arg Value: type=boolean, direction=OUT, server-argument-impl-policy=USE-ARGUMENT-TYPE
      GetNAME03_06_reserved
        arg Value: type=boolean, direction=OUT, server-argument-impl-policy=USE-ARGUMENT-TYPE
      GetNAME03_07_reserved
        arg Value: type=boolean, direction=OUT, server-argument-impl-policy=USE-ARGUMENT-TYPE
      GetNAME04_00_DrivingDynamicsInterfaceMinusDriversTorque
        arg Value: type=boolean, direction=OUT, server-argument-impl-policy=USE-ARGUMENT-TYPE
      GetNAME04_00_DrivingDynamicsInterfaceMinusMotorTorque
        arg Value: type=boolean, direction=OUT, server-argument-impl-policy=USE-ARGUMENT-TYPE
      GetNAME04_02_DrivingDynamicsInterfaceMinusFactors
        arg Value: type=boolean, direction=OUT, server-argument-impl-policy=USE-ARGUMENT-TYPE
      GetNAME04_03_DrivingDynamicsInterfaceMinusAdditionalDamping
        arg Value: type=boolean, direction=OUT, server-argument-impl-policy=USE-ARGUMENT-TYPE
      GetNAME04_04_EPSVibration
        arg Value: type=boolean, direction=OUT, server-argument-impl-policy=USE-ARGUMENT-TYPE
      GetNAME04_05_DrivingExperienceSwitch
        arg Value: type=boolean, direction=OUT, server-argument-impl-policy=USE-ARGUMENT-TYPE
      GetNAME04_06_reserved
        arg Value: type=boolean, direction=OUT, server-argument-impl-policy=USE-ARGUMENT-TYPE
      GetNAME04_07_automaticEngineStartStopFunction
        arg Value: type=boolean, direction=OUT, server-argument-impl-policy=USE-ARGUMENT-TYPE
      GetNAME05_00_ActiveFanActuation
        arg Value: type=boolean, direction=OUT, server-argument-impl-policy=USE-ARGUMENT-TYPE
      GetNAME05_01_reserved
        arg Value: type=boolean, direction=OUT, server-argument-impl-policy=USE-ARGUMENT-TYPE
      GetNAME05_02_reserved
        arg Value: type=boolean, direction=OUT, server-argument-impl-policy=USE-ARGUMENT-TYPE
      GetNAME05_03_reserved
        arg Value: type=boolean, direction=OUT, server-argument-impl-policy=USE-ARGUMENT-TYPE
      GetNAME05_04_reserved
        arg Value: type=boolean, direction=OUT, server-argument-impl-policy=USE-ARGUMENT-TYPE
      GetNAME05_05_reserved
        arg Value: type=boolean, direction=OUT, server-argument-impl-policy=USE-ARGUMENT-TYPE
      GetNAME05_06_reserved
        arg Value: type=boolean, direction=OUT, server-argument-impl-policy=USE-ARGUMENT-TYPE
      GetNAME05_07_reserved
        arg Value: type=boolean, direction=OUT, server-argument-impl-policy=USE-ARGUMENT-TYPE
      GetNAME08_reserved
        arg Value: type=uint8, direction=OUT, server-argument-impl-policy=USE-ARGUMENT-TYPE
      GetNAME09_reserved
        arg Value: type=uint8, direction=OUT, server-argument-impl-policy=USE-ARGUMENT-TYPE
      GetNAME10_reserved
        arg Value: type=uint8, direction=OUT, server-argument-impl-policy=USE-ARGUMENT-TYPE
      GetNAME11_reserved
        arg Value: type=uint8, direction=OUT, server-argument-impl-policy=USE-ARGUMENT-TYPE
      GetNAME12_reserved
        arg Value: type=uint8, direction=OUT, server-argument-impl-policy=USE-ARGUMENT-TYPE
      GetNAME13_reserved
        arg Value: type=uint8, direction=OUT, server-argument-impl-policy=USE-ARGUMENT-TYPE
      GetNAME14_reserved
        arg Value: type=uint8, direction=OUT, server-argument-impl-policy=USE-ARGUMENT-TYPE
      GetNAME15_reserved
        arg Value: type=uint8, direction=OUT, server-argument-impl-policy=USE-ARGUMENT-TYPE
      GetNAME16_reserved
        arg Value: type=uint8, direction=OUT, server-argument-impl-policy=USE-ARGUMENT-TYPE
      GetNAME17_reserved
        arg Value: type=uint8, direction=OUT, server-argument-impl-policy=USE-ARGUMENT-TYPE
      GetNAME18_reserved
        arg Value: type=uint8, direction=OUT, server-argument-impl-policy=USE-ARGUMENT-TYPE
      GetNAME19_reserved
        arg Value: type=uint8, direction=OUT, server-argument-impl-policy=USE-ARGUMENT-TYPE
      GetNAME20_reserved
        arg Value: type=uint8, direction=OUT, server-argument-impl-policy=USE-ARGUMENT-TYPE
      GetNAME21_reserved
        arg Value: type=uint8, direction=OUT, server-argument-impl-policy=USE-ARGUMENT-TYPE
      GetNAME22_reserved
        arg Value: type=uint8, direction=OUT, server-argument-impl-policy=USE-ARGUMENT-TYPE
      GetNAME23_reserved
        arg Value: type=uint8, direction=OUT, server-argument-impl-policy=USE-ARGUMENT-TYPE
      GetNAME24_reserved
        arg Value: type=uint8, direction=OUT, server-argument-impl-policy=USE-ARGUMENT-TYPE
      GetNAME25_reserved
        arg Value: type=uint8, direction=OUT, server-argument-impl-policy=USE-ARGUMENT-TYPE
      GetNAME26_reserved
        arg Value: type=uint8, direction=OUT, server-argument-impl-policy=USE-ARGUMENT-TYPE
      GetNAME27_reserved
        arg Value: type=uint8, direction=OUT, server-argument-impl-policy=USE-ARGUMENT-TYPE
      GetNAME28_reserved
        arg Value: type=uint8, direction=OUT, server-argument-impl-policy=USE-ARGUMENT-TYPE
      GetNAME29_reserved
        arg Value: type=uint8, direction=OUT, server-argument-impl-policy=USE-ARGUMENT-TYPE
      GetSpeedMinuslimitForMaxCurrent
        arg Value: type=uint8, direction=OUT, server-argument-impl-policy=USE-ARGUMENT-TYPE
    error E_NOT_OK: error-code=1
  5 x mode switch interface:
    Coding_BusCom: is-service=true
      mode group Mode: type=Coding_BusComMode
    Coding_DataMode
      mode group currentDataMode: type=Coding_DataMode
    ConditionMode
      mode group currentConditionMode: type=ModeDeclarationGroups/Coding_ConditionMode
    ILifeCycle
      mode group Mode: type=Coding_LifeCycle
    SessionChangeIndication: is-service=true
      mode group currentSessionMode: type=Coding_SessionMode
  sender receiver interface ILifeCycleRequest: is-service=true, invalidation-policy{data-element=ILifeCycleRequest/requestMode, handle-invalid=DONT-INVALIDATE}
    data requestMode: type=Coding_LifeCycleRequestType
package /BMW/Platform/Coding/Vin/PortInterfaces
  sender receiver interface Vin: invalidation-policy{data-element=Vin/Vin, handle-invalid=DONT-INVALIDATE}
    data Vin: type=Vin_VinType
package /BMW/Platform/Darh/Dcm/ModeDeclarationGroups
  mode declaration group DcmResponseOnEvent: category=ALPHABETIC_ORDER, initial-mode=EVENT_CLEARED
    mode EVENT_CLEARED
    mode EVENT_STARTED
    mode EVENT_STOPPED
package /BMW/Platform/Darh/Dcm/PortInterfaces
  7 x client server interface, all with is-service=true:
    Darh_ServiceRequestNotification
      operation Confirmation: possible-error=Darh_ServiceRequestNotification/E_NOT_OK
        4 x arg, all with direction=IN, server-argument-impl-policy=USE-ARGUMENT-TYPE:
          SID: type=uint8
          ReqType: type=uint8
          SourceAddress: type=uint16
          ConfirmationStatus: type=Dcm_ConfirmationStatusType
      operation Indication: possible-error=[Darh_ServiceRequestNotification/E_NOT_OK, Darh_ServiceRequestNotification/E_REQUEST_NOT_ACCEPTED]
        6 x arg, all with server-argument-impl-policy=USE-ARGUMENT-TYPE:
          SID: type=uint8, direction=IN
          RequestData: type=Dcm_RequestData_ArrayType, direction=IN
          DataSize: type=uint16, direction=IN
          ReqType: type=uint8, direction=IN
          SourceAddress: type=uint16, direction=IN
          ErrorCode: type=Dcm_NegativeResponseCodeType, direction=OUT
      error E_NOT_OK: error-code=1
      error E_REQUEST_NOT_ACCEPTED: error-code=8
    DataServices_ActivelyReportedDtc
      operation ConditionCheckRead: possible-error=DataServices_ActivelyReportedDtc/E_NOT_OK
        arg ErrorCode: type=Dcm_NegativeResponseCodeType, direction=OUT, server-argument-impl-policy=USE-ARGUMENT-TYPE
      operation ReadData: possible-error=DataServices_ActivelyReportedDtc/E_NOT_OK
        arg Data: type=Darh_ActivelyReportedErrorListType, direction=OUT, server-argument-impl-policy=USE-ARGUMENT-TYPE
      operation ReadDataLength: possible-error=DataServices_ActivelyReportedDtc/E_NOT_OK
        arg DataLength: type=uint16, direction=OUT, server-argument-impl-policy=USE-ARGUMENT-TYPE
      error DCM_E_PENDING: error-code=10
      error E_NOT_OK: error-code=1
    DataServices_ErrorQueue
      operation ConditionCheckRead: possible-error=DataServices_ErrorQueue/E_NOT_OK
        arg ErrorCode: type=Dcm_NegativeResponseCodeType, direction=OUT, server-argument-impl-policy=USE-ARGUMENT-TYPE
      operation ReadData: possible-error=DataServices_ErrorQueue/E_NOT_OK
        arg data: type=Darh_ErrorQueueDataType, direction=OUT, server-argument-impl-policy=USE-ARGUMENT-TYPE
      operation ReadDataLength: possible-error=DataServices_ErrorQueue/E_NOT_OK
        arg DataLength: type=uint16, direction=OUT, server-argument-impl-policy=USE-ARGUMENT-TYPE
      error DCM_E_PENDING: error-code=10
      error E_NOT_OK: error-code=1
    DataServices_RoeState
      operation ConditionCheckRead: possible-error=DataServices_RoeState/E_NOT_OK
        arg ErrorCode: type=Dcm_NegativeResponseCodeType, direction=OUT, server-argument-impl-policy=USE-ARGUMENT-TYPE
      operation ReadData: possible-error=DataServices_RoeState/E_NOT_OK
        arg Data: type=Darh_RoeState_ReadData_Data_ArrayType, direction=OUT, server-argument-impl-policy=USE-ARGUMENT-TYPE
      error E_NOT_OK: error-code=1
    DCM_Roe
      operation TriggerOnEvent: possible-error=DCM_Roe/E_NOT_OK
      error E_NOT_OK: error-code=1
    RoutineServices_StartStopRoutineDiagnoseMaster
      operation Start: possible-error=[RoutineServices_StartStopRoutineDiagnoseMaster/E_NOT_OK, RoutineServices_StartStopRoutineDiagnoseMaster/DCM_E_PENDING, RoutineServices_StartStopRoutineDiagnoseMaster/DCM_E_FORCE_RCRRP]
        arg OpStatus: type=Dcm_OpStatusType, direction=IN, server-argument-impl-policy=USE-ARGUMENT-TYPE
        arg ErrorCode: type=Dcm_NegativeResponseCodeType, direction=OUT, server-argument-impl-policy=USE-ARGUMENT-TYPE
      operation Stop: possible-error=[RoutineServices_StartStopRoutineDiagnoseMaster/E_NOT_OK, RoutineServices_StartStopRoutineDiagnoseMaster/DCM_E_PENDING, RoutineServices_StartStopRoutineDiagnoseMaster/DCM_E_FORCE_RCRRP]
        arg OpStatus: type=Dcm_OpStatusType, direction=IN, server-argument-impl-policy=USE-ARGUMENT-TYPE
        arg ErrorCode: type=Dcm_NegativeResponseCodeType, direction=OUT, server-argument-impl-policy=USE-ARGUMENT-TYPE
      error DCM_E_FORCE_RCRRP: error-code=12
      error DCM_E_PENDING: error-code=10
      error E_NOT_OK: error-code=1
    RoutineServices_TriggerDTC
      operation Start: possible-error=[RoutineServices_TriggerDTC/E_NOT_OK, RoutineServices_TriggerDTC/DCM_E_PENDING, RoutineServices_TriggerDTC/DCM_E_FORCE_RCRRP]
        7 x arg, all with server-argument-impl-policy=USE-ARGUMENT-TYPE:
          DTCType: type=uint8, direction=IN
          OpStatus: type=Dcm_OpStatusType, direction=IN
          DTCTypeOut: type=uint8, direction=OUT
          DTCByte{1..3}: type=uint8, direction=OUT
          ErrorCode: type=Dcm_NegativeResponseCodeType, direction=OUT
      error DCM_E_FORCE_RCRRP: error-code=12
      error DCM_E_PENDING: error-code=10
      error E_NOT_OK: error-code=1
  mode switch interface DcmResponseOnEvent: is-service=true
    mode group currentMode: type=DcmResponseOnEvent
package /BMW/Platform/Darh/Dem/PortInterfaces
  4 x client server interface, all with is-service=true:
    Darh_DiagnosticInfo
      operation GetDTCOfEvent: possible-error=[Darh_DiagnosticInfo/E_NOT_OK, Darh_DiagnosticInfo/DEM_E_NO_DTC_AVAILABLE]
        arg DTCFormat: type=Dem_DTCFormatType, direction=IN, server-argument-impl-policy=USE-ARGUMENT-TYPE
        arg DTCOfEvent: type=uint32, direction=OUT, server-argument-impl-policy=USE-ARGUMENT-TYPE
      error DEM_E_NO_DTC_AVAILABLE: error-code=2
      error E_NOT_OK: error-code=1
    Darh_DiagnosticMonitor
      operation ResetEventStatus: possible-error=Darh_DiagnosticMonitor/E_NOT_OK
      operation SetEventStatus: possible-error=Darh_DiagnosticMonitor/E_NOT_OK
        arg EventStatus: type=Dem_EventStatusType, direction=IN, server-argument-impl-policy=USE-ARGUMENT-TYPE
      error E_NOT_OK: error-code=1
    Darh_GeneralDiagnosticInfo
      operation GetDTCOfEvent: possible-error=[Darh_GeneralDiagnosticInfo/E_NOT_OK, Darh_GeneralDiagnosticInfo/DEM_E_NO_DTC_AVAILABLE]
        arg EventId: type=Dem_EventIdType, direction=IN, server-argument-impl-policy=USE-ARGUMENT-TYPE
        arg DTCFormat: type=Dem_DTCFormatType, direction=IN, server-argument-impl-policy=USE-ARGUMENT-TYPE
        arg DTCOfEvent: type=uint32, direction=OUT, server-argument-impl-policy=USE-ARGUMENT-TYPE
      operation GetEventFreezeFrameData: possible-error=[Darh_GeneralDiagnosticInfo/E_NOT_OK, DEM_E_NODATAAVAILABLE, DEM_E_WRONG_RECORDNUMBER, DEM_E_WRONG_DIDNUMBER]
        5 x arg, all with server-argument-impl-policy=USE-ARGUMENT-TYPE:
          EventId: type=Dem_EventIdType, direction=IN
          RecordNumber: type=uint8, direction=IN
          ReportTotalRecord: type=boolean, direction=IN
          DataId: type=uint16, direction=IN
          DestBuffer: type=Dem_MaxDataValueType, direction=OUT
      5 x error:
        DEM_E_NO_DTC_AVAILABLE: error-code=2
        DEM_E_NODATAAVAILABLE: error-code=48
        DEM_E_WRONG_DIDNUMBER: error-code=50
        DEM_E_WRONG_RECORDNUMBER: error-code=49
        E_NOT_OK: error-code=1
    GeneralCallbackEventDataChanged
      operation EventDataChanged
        arg EventId: type=Dem_EventIdType, direction=IN, server-argument-impl-policy=USE-ARGUMENT-TYPE
package /BMW/Platform/Darh/ModeDeclarationGroups
  mode declaration group Darh_LifeCycle: category=EXPLICIT_ORDER, initial-mode=DARH_STOPPED, on-transition-value=3
    mode DARH_INITIALIZED: value=0
    mode DARH_RUNNING: value=1
    mode DARH_STOPPED: value=2
  mode declaration group DarhReportErrorMode: category=ALPHABETIC_ORDER, initial-mode=DARH_REPORT_ERROR_INACTIVE
    mode DARH_REPORT_ERROR_ACTIVE
    mode DARH_REPORT_ERROR_INACTIVE
package /BMW/Platform/Darh/NvM/PortInterfaces
  client server interface Darh_NvMService: is-service=true
    operation SetRamBlockStatus: possible-error=Darh_NvMService/E_NOT_OK
      arg BlockChanged: type=boolean, direction=IN, server-argument-impl-policy=USE-ARGUMENT-TYPE
    operation WriteBlock: possible-error=Darh_NvMService/E_NOT_OK
      arg SrcPtr: type=NvM_SrcPtrType, direction=IN, server-argument-impl-policy=USE-ARGUMENT-TYPE
    error E_NOT_OK: error-code=1
  client server interface NvMNotifyJobFinished: is-service=true
    operation JobFinished: possible-error=NvMNotifyJobFinished/E_OK
      arg ServiceId: type=uint8, direction=IN, server-argument-impl-policy=USE-ARGUMENT-TYPE
      arg JobResult: type=NvM_RequestResultType, direction=IN, server-argument-impl-policy=USE-ARGUMENT-TYPE
    error E_OK: error-code=0
package /BMW/Platform/Darh/PortInterfaces
  client server interface DarhControlInterface
    operation SetRoeSuspended: possible-error=DarhControlInterface/E_NOT_OK
      arg suspended: type=boolean, direction=IN, server-argument-impl-policy=USE-ARGUMENT-TYPE
    error E_NOT_OK: error-code=1
  client server interface DarhReportDynamicallyEvent
    operation EventIdx2EventId: possible-error=DarhReportDynamicallyEvent/E_NOT_OK
      arg eventIdx: type=uint16, direction=IN, server-argument-impl-policy=USE-ARGUMENT-TYPE
      arg eventId: type=Dem_EventIdType, direction=OUT, server-argument-impl-policy=USE-ARGUMENT-TYPE
    operation EventToReport: possible-error=DarhReportDynamicallyEvent/E_NOT_OK
      arg event: type=Dem_EventIdType, direction=IN, server-argument-impl-policy=USE-ARGUMENT-TYPE
      arg toReport: type=boolean, direction=OUT, server-argument-impl-policy=USE-ARGUMENT-TYPE
    operation EventToReportCount: possible-error=DarhReportDynamicallyEvent/E_NOT_OK
      arg eventCount: type=uint16, direction=OUT, server-argument-impl-policy=USE-ARGUMENT-TYPE
    error E_NOT_OK: error-code=1
  client server interface RoeStateInterface
    operation GetRoeState: possible-error=RoeStateInterface/E_NOT_OK
      arg RoeState: type=Darh_RoeStateType, direction=OUT, server-argument-impl-policy=USE-ARGUMENT-TYPE
    error E_NOT_OK: error-code=1
  mode switch interface DarhReportErrorModeInterface: is-service=true
    mode group DarhReportErrorMode: type=DarhReportErrorMode
  mode switch interface ILifeCycle
    mode group Mode: type=Darh_LifeCycle
  sender receiver interface ILifeCycleRequest: is-service=true, invalidation-policy{data-element=ILifeCycleRequest/requestMode, handle-invalid=DONT-INVALIDATE}
    data requestMode: type=Darh_LifeCycleRequestType
package /BMW/Platform/Darh/Tp/PortInterfaces
  sender receiver interface Darh_Com: is-service=true, invalidation-policy{data-element=data, handle-invalid=DONT-INVALIDATE}
    data data: type=Darh_TransmissionArrayType
package /BMW/Platform/Dlog/Coding/PortInterfaces
  client server interface Coding_SVKInterface
    operation GetCafIds: possible-error=Coding_SVKInterface/E_NOT_OK
      arg cafIds: type=Coding_CafIdArrayType, direction=OUT, server-argument-impl-policy=USE-ARRAY-BASE-TYPE
      arg numberOfCafIds: type=uint16, direction=OUT, server-argument-impl-policy=USE-ARGUMENT-TYPE
    error E_NOT_OK: error-code=1
package /BMW/Platform/Dlog/Dcm/PortInterfaces
  13 x client server interface, all with is-service=true:
    DataServices_EcuSerialNumber
      operation ReadData: possible-error=DataServices_EcuSerialNumber/E_NOT_OK
        arg Data: type=SerialNumberArrayType, direction=OUT, server-argument-impl-policy=USE-ARGUMENT-TYPE
      error E_NOT_OK: error-code=1
    DataServices_EcuUid
      operation ReadData: possible-error=DataServices_EcuUid/E_NOT_OK
        arg Data: type=Dlog_EcuUidArrayType, direction=OUT, server-argument-impl-policy=USE-ARGUMENT-TYPE
      error E_NOT_OK: error-code=1
    DataServices_FlashTimingParameter
      operation ReadData: possible-error=DataServices_FlashTimingParameter/E_NOT_OK
        arg Data: type=TimingParametersArrayType, direction=OUT, server-argument-impl-policy=USE-ARGUMENT-TYPE
      error E_NOT_OK: error-code=1
    DataServices_HWModificationIndex
      operation ReadData: possible-error=DataServices_HWModificationIndex/E_NOT_OK
        arg Data: type=Dlog_HWModificationIndexArrayType, direction=OUT, server-argument-impl-policy=USE-ARGUMENT-TYPE
      error E_NOT_OK: error-code=1
    DataServices_ManufacturingDate
      operation ReadData: possible-error=DataServices_ManufacturingDate/E_NOT_OK
        arg Data: type=ManufacturingDataArrayType, direction=OUT, server-argument-impl-policy=USE-ARGUMENT-TYPE
      error E_NOT_OK: error-code=1
    DataServices_ProgCounter
      operation ReadData: possible-error=DataServices_ProgCounter/E_NOT_OK
        arg Data: type=ProgCounterArrayType, direction=OUT, server-argument-impl-policy=USE-ARGUMENT-TYPE
      error E_NOT_OK: error-code=1
    DataServices_ProgCounterMaxValue
      operation ReadData: possible-error=DataServices_ProgCounterMaxValue/E_NOT_OK
        arg Data: type=ProgCounterMaxArrayType, direction=OUT, server-argument-impl-policy=USE-ARGUMENT-TYPE
      error E_NOT_OK: error-code=1
    DataServices_SgbdIdx
      operation ReadData: possible-error=DataServices_SgbdIdx/E_NOT_OK
        arg Data: type=SgbdIdArrayType, direction=OUT, server-argument-impl-policy=USE-ARGUMENT-TYPE
      error E_NOT_OK: error-code=1
    DataServices_Svk
      operation ConditionCheckRead: possible-error=[DataServices_Svk/E_NOT_OK, DataServices_Svk/DCM_E_PENDING]
        arg OpStatus: type=Dcm_OpStatusType, direction=IN, server-argument-impl-policy=USE-ARGUMENT-TYPE
        arg ErrorCode: type=Dcm_NegativeResponseCodeType, direction=OUT, server-argument-impl-policy=USE-ARGUMENT-TYPE
      operation ReadData: possible-error=[DataServices_Svk/E_NOT_OK, DataServices_Svk/DCM_E_PENDING]
        arg OpStatus: type=Dcm_OpStatusType, direction=IN, server-argument-impl-policy=USE-ARGUMENT-TYPE
        arg Data: type=SvkDataArrayType, direction=OUT, server-argument-impl-policy=USE-ARGUMENT-TYPE
      operation ReadDataLength: possible-error=[DataServices_Svk/DCM_E_PENDING, DataServices_Svk/E_NOT_OK]
        arg OpStatus: type=Dcm_OpStatusType, direction=IN, server-argument-impl-policy=USE-ARGUMENT-TYPE
        arg DataLength: type=uint16, direction=OUT, server-argument-impl-policy=USE-ARGUMENT-TYPE
      error DCM_E_PENDING: error-code=10
      error E_NOT_OK: error-code=1
    DataServices_SvkHistory
      operation ConditionCheckRead: possible-error=[DataServices_SvkHistory/E_NOT_OK, DataServices_SvkHistory/DCM_E_PENDING]
        arg OpStatus: type=Dcm_OpStatusType, direction=IN, server-argument-impl-policy=USE-ARGUMENT-TYPE
        arg ErrorCode: type=Dcm_NegativeResponseCodeType, direction=OUT, server-argument-impl-policy=USE-ARGUMENT-TYPE
      operation ReadData: possible-error=[DataServices_SvkHistory/E_NOT_OK, DataServices_SvkHistory/DCM_E_PENDING]
        arg OpStatus: type=Dcm_OpStatusType, direction=IN, server-argument-impl-policy=USE-ARGUMENT-TYPE
        arg Data: type=SvkHistoryDataArrayType, direction=OUT, server-argument-impl-policy=USE-ARGUMENT-TYPE
      error DCM_E_PENDING: error-code=10
      error E_NOT_OK: error-code=1
    DataServices_SwfkDeleteSupported: service-kind=BASIC-SOFTWARE-MODE-MANAGER
      operation ReadData: possible-error=DataServices_SwfkDeleteSupported/E_NOT_OK
        arg Data: type=Dlog_SwfkDeleteSupportedArrayType, direction=OUT, server-argument-impl-policy=USE-ARRAY-BASE-TYPE
      error E_NOT_OK: error-code=1
    DataServices_Vin
      operation ConditionCheckRead: possible-error=[DataServices_Vin/E_NOT_OK, DataServices_Vin/DCM_E_PENDING]
        arg OpStatus: type=Dcm_OpStatusType, direction=IN, server-argument-impl-policy=USE-ARGUMENT-TYPE
        arg ErrorCode: type=Dcm_NegativeResponseCodeType, direction=OUT, server-argument-impl-policy=USE-ARGUMENT-TYPE
      operation ReadData: possible-error=DataServices_Vin/E_NOT_OK
        arg OpStatus: type=Dcm_OpStatusType, direction=IN, server-argument-impl-policy=USE-ARGUMENT-TYPE
        arg Data: type=Dlog_VinArrayType, direction=OUT, server-argument-impl-policy=USE-ARGUMENT-TYPE
      error DCM_E_PENDING: error-code=10
      error E_NOT_OK: error-code=1
    RoutineService_DevInfo
      operation Start: possible-error=[RoutineService_DevInfo/E_NOT_OK, RoutineService_DevInfo/DCM_E_PENDING]
        5 x arg, all with server-argument-impl-policy=USE-ARGUMENT-TYPE:
          DataIn: type=RSInputArrayType, direction=IN
          OpStatus: type=Dcm_OpStatusType, direction=IN
          DataOut: type=DevInfoArrayType, direction=OUT
          CurrentDataLength: type=uint16, direction=OUT
          ErrorCode: type=Dcm_NegativeResponseCodeType, direction=OUT
      error DCM_E_PENDING: error-code=10
      error E_NOT_OK: error-code=1
package /BMW/Platform/Dlog/Det/PortInterfaces
  client server interface Dlog_DETService: is-service=true
    operation ReportError: possible-error=Dlog_DETService/E_OK
      arg InstanceId: type=uint8, direction=IN, server-argument-impl-policy=USE-ARGUMENT-TYPE
      arg ApiId: type=uint8, direction=IN, server-argument-impl-policy=USE-ARGUMENT-TYPE
      arg ErrorId: type=uint8, direction=IN, server-argument-impl-policy=USE-ARGUMENT-TYPE
    error E_OK: error-code=0
package /BMW/Platform/Dlog/ModeDeclarationGroups
  mode declaration group Dlog_LifeCycle: category=EXPLICIT_ORDER, initial-mode=DLOG_STOPPED, on-transition-value=3
    mode DLOG_INITIALIZED: value=0
    mode DLOG_RUNNING: value=1
    mode DLOG_STOPPED: value=2
  mode declaration group DlogFirstStartMDG: category=EXPLICIT_ORDER, initial-mode=DLOG_UNINIT, on-transition-value=3
    mode DLOG_FIRSTSTART: value=0
    mode DLOG_NORMALSTART: value=1
    mode DLOG_UNINIT: value=2
package /BMW/Platform/Dlog/NvM/PortInterfaces
  6 x client server interface, all with is-service=true:
    Dlog_NvMAdmin
      operation SetBlockProtection: possible-error=Dlog_NvMAdmin/E_NOT_OK
        arg ProtectionEnabled: type=boolean, direction=IN, server-argument-impl-policy=USE-ARGUMENT-TYPE
      error E_NOT_OK: error-code=1
    Dlog_NvMNotifyInitBlock
      operation InitBlock: possible-error=Dlog_NvMNotifyInitBlock/E_OK
      error E_OK: error-code=0
    Dlog_NvMNotifyJobFinished
      operation JobFinished: possible-error=Dlog_NvMNotifyJobFinished/E_OK
        arg ServiceId: type=uint8, direction=IN, server-argument-impl-policy=USE-ARGUMENT-TYPE
        arg JobResult: type=NvM_RequestResultType, direction=IN, server-argument-impl-policy=USE-ARGUMENT-TYPE
      error E_OK: error-code=0
    Dlog_NvMService
      4 x operation, all with possible-error=Dlog_NvMService/E_NOT_OK:
        GetErrorStatus
          arg RequestResultPtr: type=NvM_RequestResultType, direction=OUT, server-argument-impl-policy=USE-ARGUMENT-TYPE
        ReadBlock
          arg DstPtr: type=NvM_DstPtrType, direction=IN, server-argument-impl-policy=USE-ARGUMENT-TYPE
        SetRamBlockStatus
          arg BlockChanged: type=boolean, direction=IN, server-argument-impl-policy=USE-ARGUMENT-TYPE
        WriteBlock
          arg SrcPtr: type=NvM_SrcPtrType, direction=IN, server-argument-impl-policy=USE-ARGUMENT-TYPE
      error E_NOT_OK: error-code=1
    NvMService
      5 x operation, all with possible-error=NvMService/E_NOT_OK:
        GetErrorStatus
          arg RequestResultPtr: type=NvM_RequestResultType, direction=OUT, server-argument-impl-policy=USE-ARGUMENT-TYPE
        ReadBlock
          arg DstPtr: type=NvM_DstPtrType, direction=IN, server-argument-impl-policy=USE-ARGUMENT-TYPE
        RestoreBlockDefaults
          arg DstPtr: type=NvM_DstPtrType, direction=IN, server-argument-impl-policy=USE-VOID
        SetRamBlockStatus
          arg BlockChanged: type=boolean, direction=IN, server-argument-impl-policy=USE-ARGUMENT-TYPE
        WriteBlock
          arg SrcPtr: type=NvM_SrcPtrType, direction=IN, server-argument-impl-policy=USE-VOID
      error E_NOT_OK: error-code=1
    NvMServiceSvkEntry
      5 x operation, all with possible-error=NvMServiceSvkEntry/E_NOT_OK:
        GetErrorStatus
          arg RequestResultPtr: type=NvM_RequestResultType, direction=OUT, server-argument-impl-policy=USE-ARGUMENT-TYPE
        ReadBlock
          arg DstPtr: type=NvM_DstPtrType, direction=IN, server-argument-impl-policy=USE-ARGUMENT-TYPE
        SetDataIndex
          arg DataIndex: type=uint8, direction=IN, server-argument-impl-policy=USE-ARGUMENT-TYPE
        SetRamBlockStatus
          arg BlockChanged: type=boolean, direction=IN, server-argument-impl-policy=USE-ARGUMENT-TYPE
        WriteBlock
          arg SrcPtr: type=NvM_SrcPtrType, direction=IN, server-argument-impl-policy=USE-ARGUMENT-TYPE
      error E_NOT_OK: error-code=1
package /BMW/Platform/Dlog/PortInterfaces
  4 x client server interface:
    EcuInfo
      operation GetEcuId: possible-error=EcuInfo/E_NOT_OK
        arg ecuId: type=uint8, direction=OUT, server-argument-impl-policy=USE-ARGUMENT-TYPE
      operation GetVin: possible-error=EcuInfo/E_NOT_OK
        arg Vin: type=Dlog_VinArrayType, direction=OUT, server-argument-impl-policy=USE-ARRAY-BASE-TYPE
      error E_NOT_OK: error-code=1
    RandomSeed
      operation Get
        arg seed: type=Dlog_RandomSeedType, direction=OUT, server-argument-impl-policy=USE-ARGUMENT-TYPE
      operation Set: possible-error=[RandomSeed/E_PENDING, RandomSeed/E_NOT_OK]
        arg seed: type=Dlog_RandomSeedType, direction=IN, server-argument-impl-policy=USE-ARGUMENT-TYPE
        arg OpStatus: type=Dcm_OpStatusType, direction=IN, server-argument-impl-policy=USE-ARGUMENT-TYPE
      error E_NOT_OK: error-code=1
      error E_PENDING: error-code=10
    SweInfo: service-kind=BASIC-SOFTWARE-MODE-MANAGER
      operation GetSgbmId: possible-error=SweInfo/E_NOT_OK
        arg SweId: type=uint8, direction=IN, server-argument-impl-policy=USE-ARGUMENT-TYPE
        arg SgbmId: type=Dlog_SgbmIdArrayType, direction=OUT, server-argument-impl-policy=USE-ARGUMENT-TYPE
      operation GetSweId: possible-error=SweInfo/E_NOT_OK
        arg SgbmId: type=Dlog_SgbmIdArrayType, direction=IN, server-argument-impl-policy=USE-ARGUMENT-TYPE
        arg SweId: type=uint8, direction=OUT, server-argument-impl-policy=USE-ARGUMENT-TYPE
      operation IsValid: possible-error=SweInfo/E_NOT_OK
        arg sweId: type=uint8, direction=IN, server-argument-impl-policy=USE-ARGUMENT-TYPE
      error E_NOT_OK: error-code=1
    SweSignatureAccess
      5 x operation, all with possible-error=SweSignatureAccess/E_NOT_OK:
        GetNumSig
          arg sweId: type=uint8, direction=IN, server-argument-impl-policy=USE-ARGUMENT-TYPE
          arg numSig: type=uint8, direction=OUT, server-argument-impl-policy=USE-ARGUMENT-TYPE
        GetNumSwe
          arg numSwe: type=uint8, direction=OUT, server-argument-impl-policy=USE-ARGUMENT-TYPE
        GetSigLength
          arg sweId: type=uint8, direction=IN, server-argument-impl-policy=USE-ARGUMENT-TYPE
          arg blkNum: type=uint8, direction=IN, server-argument-impl-policy=USE-ARGUMENT-TYPE
          arg length: type=uint32, direction=OUT, server-argument-impl-policy=USE-ARGUMENT-TYPE
        GetSignature
          arg sweId: type=uint8, direction=IN, server-argument-impl-policy=USE-ARGUMENT-TYPE
          arg signature: type=Dlog_SignatureArrayType, direction=OUT, server-argument-impl-policy=USE-ARGUMENT-TYPE
        GetSigStart
          arg sweId: type=uint8, direction=IN, server-argument-impl-policy=USE-ARGUMENT-TYPE
          arg blkNum: type=uint8, direction=IN, server-argument-impl-policy=USE-ARGUMENT-TYPE
          arg address: type=uint32, direction=OUT, server-argument-impl-policy=USE-ARGUMENT-TYPE
      error E_NOT_OK: error-code=1
  mode switch interface DlogFirstStartMode
    mode group DlogFirstStartMode: type=DlogFirstStartMDG
  mode switch interface ILifeCycle
    mode group Mode: type=Dlog_LifeCycle
  sender receiver interface ILifeCycleRequest: is-service=true, invalidation-policy{data-element=ILifeCycleRequest/requestMode, handle-invalid=DONT-INVALIDATE}
    data requestMode: type=Dlog_LifeCycleRequestType
  sender receiver interface ProgId: invalidation-policy{data-element=ProgId/progId, handle-invalid=DONT-INVALIDATE}
    data progId: type=Dlog_ProgIdArrayType
package /BMW/Platform/Omc/Dcm/PortInterfaces
  4 x client server interface, all with is-service=true:
    DataServices_ExtendedOperatingMode
      operation ConditionCheckRead: possible-error=DataServices_ExtendedOperatingMode/E_NOT_OK
        arg ErrorCode: type=Dcm_NegativeResponseCodeType, direction=OUT, server-argument-impl-policy=USE-ARGUMENT-TYPE
      operation ReadData: possible-error=DataServices_ExtendedOperatingMode/E_NOT_OK
        arg Data: type=UInt8_Array1, direction=OUT, server-argument-impl-policy=USE-ARRAY-BASE-TYPE
      error E_NOT_OK: error-code=1
    DataServices_OperatingMode
      operation ConditionCheckRead: possible-error=DataServices_OperatingMode/E_NOT_OK
        arg ErrorCode: type=Dcm_NegativeResponseCodeType, direction=OUT, server-argument-impl-policy=USE-ARGUMENT-TYPE
      operation ReadData: possible-error=DataServices_OperatingMode/E_NOT_OK
        arg Data: type=UInt8_Array1, direction=OUT, server-argument-impl-policy=USE-ARRAY-BASE-TYPE
      error E_NOT_OK: error-code=1
    RoutineServices_ExtendedOperatingModeControl
      operation Start: possible-error=[RoutineServices_ExtendedOperatingModeControl/DCM_E_PENDING, RoutineServices_ExtendedOperatingModeControl/E_NOT_OK, RoutineServices_ExtendedOperatingModeControl/DCM_E_FORCE_RCRRP]
        arg ExtendedOperatingMode: type=uint8, direction=IN, server-argument-impl-policy=USE-ARGUMENT-TYPE
        arg OpStatus: type=OpStatusType, direction=IN, server-argument-impl-policy=USE-ARGUMENT-TYPE
        arg ErrorCode: type=Dcm_NegativeResponseCodeType, direction=OUT, server-argument-impl-policy=USE-ARGUMENT-TYPE
      error DCM_E_FORCE_RCRRP: error-code=12
      error DCM_E_PENDING: error-code=10
      error E_NOT_OK: error-code=1
    RoutineServices_OperatingModeControl
      operation Start: possible-error=[RoutineServices_OperatingModeControl/DCM_E_PENDING, RoutineServices_OperatingModeControl/E_NOT_OK, RoutineServices_OperatingModeControl/DCM_E_FORCE_RCRRP]
        arg OperatingMode: type=uint8, direction=IN, server-argument-impl-policy=USE-ARGUMENT-TYPE
        arg OpStatus: type=OpStatusType, direction=IN, server-argument-impl-policy=USE-ARGUMENT-TYPE
        arg ErrorCode: type=Dcm_NegativeResponseCodeType, direction=OUT, server-argument-impl-policy=USE-ARGUMENT-TYPE
      error DCM_E_FORCE_RCRRP: error-code=12
      error DCM_E_PENDING: error-code=10
      error E_NOT_OK: error-code=1
package /BMW/Platform/Omc/Dem/PortInterfaces
  client server interface CallbackClearEventAllowed: is-service=true
    operation ClearEventAllowed: possible-error=CallbackClearEventAllowed/E_NOT_OK
      arg Allowed: type=boolean, direction=OUT, server-argument-impl-policy=USE-ARGUMENT-TYPE
    error E_NOT_OK: error-code=1
  client server interface EnableCondition: is-service=true
    operation SetEnableCondition: possible-error=EnableCondition/E_NOT_OK
      arg ConditionFulfilled: type=boolean, direction=IN, server-argument-impl-policy=USE-ARGUMENT-TYPE
    error E_NOT_OK: error-code=1
  client server interface Omc_DiagnosticMonitor: is-service=true
    operation ResetEventStatus: possible-error=Omc_DiagnosticMonitor/E_NOT_OK
    operation SetEventStatus: possible-error=Omc_DiagnosticMonitor/E_NOT_OK
      arg EventStatus: type=Dem_EventStatusType, direction=IN, server-argument-impl-policy=USE-ARGUMENT-TYPE
    error E_NOT_OK: error-code=1
package /BMW/Platform/Omc/Det/PortInterfaces
  client server interface DETService: is-service=true
    operation ReportError: possible-error=DETService/E_NOT_OK
      arg InstanceId: type=uint8, direction=IN, server-argument-impl-policy=USE-ARGUMENT-TYPE
      arg ApiId: type=uint8, direction=IN, server-argument-impl-policy=USE-ARGUMENT-TYPE
      arg ErrorId: type=uint8, direction=IN, server-argument-impl-policy=USE-ARGUMENT-TYPE
    error E_NOT_OK: error-code=1
package /BMW/Platform/Omc/ModeDeclarationGroups
  mode declaration group Omc_LifeCycle: category=ALPHABETIC_ORDER, initial-mode=OMC_STOPPED
    mode OMC_INITIALIZED
    mode OMC_RUNNING
    mode OMC_STOPPED
  mode declaration group OmcExtendedOperatingMode: category=EXPLICIT_ORDER, initial-mode=OmcExtendedOperatingMode/OMC_MODE_EXTENSION_NORMAL, on-transition-value=254
    17 x mode:
      OMC_MODE_EXTENSION_1: value=1
      OMC_MODE_EXTENSION_{10..14}: value={10..14}
      OMC_MODE_EXTENSION_{2..9}: value={2..9}
      OMC_MODE_EXTENSION_INVALID: value=255
      OMC_MODE_EXTENSION_NORMAL: value=0
      OMC_MODE_EXTENSION_SAVE_ENERGY: value=15
  mode declaration group OmcOperatingMode: category=EXPLICIT_ORDER, initial-mode=OmcOperatingMode/OMC_MODE_NORMAL, on-transition-value=255
    4 x mode:
      OMC_MODE_ASSEMBLY: value=1
      OMC_MODE_BMW_FLASH: value=3
      OMC_MODE_NORMAL: value=0
      OMC_MODE_TRANSPORT: value=2
package /BMW/Platform/Omc/NvM/PortInterfaces
  client server interface NvMNotifyJobFinished: is-service=true
    operation JobFinished: possible-error=NvMNotifyJobFinished/E_OK
      arg ServiceId: type=uint8, direction=IN, server-argument-impl-policy=USE-ARGUMENT-TYPE
      arg JobResult: type=RequestResultType, direction=IN, server-argument-impl-policy=USE-ARGUMENT-TYPE
    error E_OK: error-code=0
  client server interface NvMService_OMC: is-service=true
    operation GetErrorStatus: possible-error=NvMService_OMC/E_NOT_OK
      arg RequestResultPtr: type=RequestResultType, direction=OUT, server-argument-impl-policy=USE-ARGUMENT-TYPE
    operation SetRamBlockStatus: possible-error=NvMService_OMC/E_NOT_OK
      arg BlockChanged: type=boolean, direction=IN, server-argument-impl-policy=USE-ARGUMENT-TYPE
    operation WriteBlock: possible-error=NvMService_OMC/E_NOT_OK
      arg SrcPtr: type=SrcPtrType, direction=IN, server-argument-impl-policy=USE-ARGUMENT-TYPE
    error E_NOT_OK: error-code=1
package /BMW/Platform/Omc/PortInterfaces
  client server interface OmcModesCallouts
    operation AllowOpModeSwitch: possible-error=[OmcModesCallouts/E_NOT_OK, OmcModesCallouts/E_RUNNING]
      4 x arg, all with direction=IN, server-argument-impl-policy=USE-ARGUMENT-TYPE:
        OperatingMode: type=Omc_OperatingModeType
        ExtendedOperatingMode: type=Omc_ExtendedOperatingModeType
        NewOperatingMode: type=Omc_OperatingModeType
        NewExtendedOperatingMode: type=Omc_ExtendedOperatingModeType
    operation OpModeSwitchCancelled: possible-error=[OmcModesCallouts/E_OK, OmcModesCallouts/E_RUNNING]
      4 x arg, all with direction=IN, server-argument-impl-policy=USE-ARGUMENT-TYPE:
        OperatingMode: type=Omc_OperatingModeType
        ExtendedOperatingMode: type=Omc_ExtendedOperatingModeType
        RequestedOperatingMode: type=Omc_OperatingModeType
        RequestedExtendedOperatingMode: type=Omc_ExtendedOperatingModeType
    error E_NOT_OK: error-code=1
    error E_OK: error-code=0
    error E_RUNNING: error-code=10
  client server interface OmcModesCalloutsResult
    operation OpModeSwitchAllowedResult: possible-error=OmcModesCalloutsResult/E_OK
      arg Result: type=boolean, direction=IN, server-argument-impl-policy=USE-ARGUMENT-TYPE
    operation OpModeSwitchCancelledAck: possible-error=OmcModesCalloutsResult/E_OK
    error E_OK: error-code=0
  mode switch interface ExtendedOperatingModeNotification
    mode group currentExtendedOperatingMode: type=ModeDeclarationGroups/OmcExtendedOperatingMode
  mode switch interface ILifeCycle
    mode group Mode: type=Omc_LifeCycle
  mode switch interface OperatingModeNotification
    mode group currentOperatingMode: type=ModeDeclarationGroups/OmcOperatingMode
  sender receiver interface ILifeCycleRequest: is-service=true, invalidation-policy{data-element=ILifeCycleRequest/requestMode, handle-invalid=DONT-INVALIDATE}
    data requestMode: type=Omc_LifeCycleRequestType
package /BMW/Platform/Rmh/PortInterfaces
  client server interface Rmh_ComTriggerIPDUSendInterface
    operation Rmh_TriggerComIPDUSend
      arg messageId: type=uint16, direction=IN, server-argument-impl-policy=USE-ARGUMENT-TYPE
  sender receiver interface Rmh_DummyTriggerInterface: invalidation-policy{data-element=dummySignal, handle-invalid=DONT-INVALIDATE}
    data dummySignal: type=uint8
  sender receiver interface Rmh_RequestIDInterface: invalidation-policy{data-element=requestedMsgID, handle-invalid=DONT-INVALIDATE}
    data requestedMsgID: type=uint16
package /BMW/Platform/StdDiag/Coding/ModeDeclarationGroups
  mode declaration group Coding_ConditionMode: category=EXPLICIT_ORDER, initial-mode=Coding_ConditionMode/CODING_ALLOWED, on-transition-value=2
    mode CODING_ALLOWED: value=0
    mode CODING_NOT_ALLOWED: value=1
package /BMW/Platform/StdDiag/Coding/PortInterfaces
  mode switch interface Coding_ConditionModeInterface
    mode group currentConditionMode: type=ModeDeclarationGroups/Coding_ConditionMode
package /BMW/Platform/StdDiag/Darh/PortInterfaces
  client server interface DarhControlInterface
    operation SetRoeSuspended: possible-error=DarhControlInterface/E_NOT_OK
      arg suspended: type=boolean, direction=IN, server-argument-impl-policy=USE-ARGUMENT-TYPE
    error E_NOT_OK: error-code=1
  client server interface RoeStateInterface
    operation GetRoeState: possible-error=RoeStateInterface/E_NOT_OK
      arg RoeState: type=Darh_RoeStateType, direction=OUT, server-argument-impl-policy=USE-ARGUMENT-TYPE
    error E_NOT_OK: error-code=1
package /BMW/Platform/StdDiag/Dcm/PortInterfaces
  9 x client server interface, all with is-service=true:
    DataServices_ActiveDiagSession
      operation ConditionCheckRead: possible-error=[DataServices_ActiveDiagSession/E_OK, DataServices_ActiveDiagSession/E_NOT_OK]
        arg ErrorCode: type=Dcm_NegativeResponseCodeType, direction=OUT, server-argument-impl-policy=USE-ARGUMENT-TYPE
      operation ReadData: possible-error=[DataServices_ActiveDiagSession/E_OK, DataServices_ActiveDiagSession/E_NOT_OK]
        arg Data: type=ActiveDiagSession_ArrayType, direction=OUT, server-argument-impl-policy=USE-ARGUMENT-TYPE
      error E_NOT_OK: error-code=1
      error E_OK: error-code=0
    DataServices_ActiveSessionState
      operation ConditionCheckRead: possible-error=[DataServices_ActiveSessionState/E_OK, DataServices_ActiveSessionState/E_NOT_OK]
        arg ErrorCode: type=Dcm_NegativeResponseCodeType, direction=OUT, server-argument-impl-policy=USE-ARGUMENT-TYPE
      operation ReadData: possible-error=[DataServices_ActiveSessionState/E_NOT_OK, DataServices_ActiveSessionState/E_OK]
        arg Data: type=ActiveSessionState_ArrayType, direction=OUT, server-argument-impl-policy=USE-ARGUMENT-TYPE
      error E_NOT_OK: error-code=1
      error E_OK: error-code=0
    DataServices_SgbdIndex
      operation ReadData: possible-error=[DataServices_SgbdIndex/E_OK, DataServices_SgbdIndex/E_NOT_OK]
        arg Data: type=SgbdIndex_ArrayType, direction=OUT, server-argument-impl-policy=USE-ARGUMENT-TYPE
      error E_NOT_OK: error-code=1
      error E_OK: error-code=0
    RoutineServices_CheckProgrammingPreconditions
      operation Start: possible-error=[RoutineServices_CheckProgrammingPreconditions/E_OK, RoutineServices_CheckProgrammingPreconditions/E_NOT_OK, RoutineServices_CheckProgrammingPreconditions/DCM_E_PENDING, RoutineServices_CheckProgrammingPreconditions/DCM_E_FORCE_RCRRP]
        4 x arg, all with server-argument-impl-policy=USE-ARGUMENT-TYPE:
          OpStatus: type=Dcm_OpStatusType, direction=IN
          dataOut: type=CheckProgrammingPreconditions_ArrayType, direction=OUT
          currentDataLength: type=uint16, direction=OUT
          ErrorCode: type=Dcm_NegativeResponseCodeType, direction=OUT
      4 x error:
        DCM_E_FORCE_RCRRP: error-code=12
        DCM_E_PENDING: error-code=10
        E_NOT_OK: error-code=1
        E_OK: error-code=0
    RoutineServices_ClearDTCSecondaryErrorMemory
      operation Start: possible-error=[RoutineServices_ClearDTCSecondaryErrorMemory/DCM_E_PENDING, RoutineServices_ClearDTCSecondaryErrorMemory/E_NOT_OK, RoutineServices_ClearDTCSecondaryErrorMemory/DCM_E_FORCE_RCRRP]
        arg OpStatus: type=Dcm_OpStatusType, direction=IN, server-argument-impl-policy=USE-ARGUMENT-TYPE
        arg ErrorCode: type=Dcm_NegativeResponseCodeType, direction=OUT, server-argument-impl-policy=USE-ARGUMENT-TYPE
      error DCM_E_FORCE_RCRRP: error-code=12
      error DCM_E_PENDING: error-code=10
      error E_NOT_OK: error-code=1
    RoutineServices_DiagCommLoopback
      operation Start: possible-error=[RoutineServices_DiagCommLoopback/E_OK, RoutineServices_DiagCommLoopback/E_NOT_OK, RoutineServices_DiagCommLoopback/DCM_E_PENDING, RoutineServices_DiagCommLoopback/DCM_E_FORCE_RCRRP]
        5 x arg, all with server-argument-impl-policy=USE-ARGUMENT-TYPE:
          dataIn: type=DiagCommLoopback_ArrayType, direction=IN
          OpStatus: type=Dcm_OpStatusType, direction=IN
          dataOut: type=DiagCommLoopback_ArrayType, direction=OUT
          currentDataLength: type=uint16, direction=INOUT
          ErrorCode: type=Dcm_NegativeResponseCodeType, direction=OUT
      4 x error:
        DCM_E_FORCE_RCRRP: error-code=12
        DCM_E_PENDING: error-code=10
        E_NOT_OK: error-code=1
        E_OK: error-code=0
    RoutineServices_UpDownloadPrePostProcessing
      operation Start: possible-error=[RoutineServices_UpDownloadPrePostProcessing/DCM_E_PENDING, RoutineServices_UpDownloadPrePostProcessing/E_NOT_OK, RoutineServices_UpDownloadPrePostProcessing/DCM_E_FORCE_RCRRP]
        5 x arg:
          Data: type=UpDownloadPrePostProcessing_ArrayType, direction=IN, server-argument-impl-policy=USE-ARRAY-BASE-TYPE
          OpStatus: type=Dcm_OpStatusType, direction=IN, server-argument-impl-policy=USE-ARGUMENT-TYPE
          Result: type=uint8, direction=OUT, server-argument-impl-policy=USE-ARRAY-BASE-TYPE
          currentDataLength: type=uint16, direction=IN, server-argument-impl-policy=USE-ARGUMENT-TYPE
          ErrorCode: type=Dcm_NegativeResponseCodeType, direction=OUT, server-argument-impl-policy=USE-ARGUMENT-TYPE
      error DCM_E_FORCE_RCRRP: error-code=12
      error DCM_E_PENDING: error-code=10
      error E_NOT_OK: error-code=1
    ServiceRequestNotification
      operation Confirmation: possible-error=[ServiceRequestNotification/E_OK, ServiceRequestNotification/E_NOT_OK]
        4 x arg, all with direction=IN, server-argument-impl-policy=USE-ARGUMENT-TYPE:
          SID: type=uint8
          ReqType: type=uint8
          SourceAddress: type=uint16
          ConfirmationStatus: type=Dcm_ConfirmationStatusType
      operation Indication: possible-error=[ServiceRequestNotification/E_OK, ServiceRequestNotification/E_NOT_OK, ServiceRequestNotification/E_REQUEST_NOT_ACCEPTED]
        6 x arg, all with server-argument-impl-policy=USE-ARGUMENT-TYPE:
          SID: type=uint8, direction=IN
          RequestData: type=RequestDataArray, direction=IN
          DataSize: type=uint16, direction=IN
          ReqType: type=uint8, direction=IN
          SourceAddress: type=uint16, direction=IN
          ErrorCode: type=Dcm_NegativeResponseCodeType, direction=OUT
      error E_NOT_OK: error-code=1
      error E_OK: error-code=0
      error E_REQUEST_NOT_ACCEPTED: error-code=8
    StdDiagDCMServices
      operation GetSesCtrlType: possible-error=[StdDiagDCMServices/E_OK, StdDiagDCMServices/E_NOT_OK]
        arg SesCtrlType: type=Dcm_SesCtrlType, direction=OUT, server-argument-impl-policy=USE-ARGUMENT-TYPE
      error E_NOT_OK: error-code=1
      error E_OK: error-code=0
package /BMW/Platform/StdDiag/Dem/PortInterfaces
  client server interface CddIf: is-service=true
    operation ClearDTC: possible-error=[CddIf/E_OK, DEM_CLEAR_WRONG_DTC, DEM_CLEAR_WRONG_DTCORIGIN, DEM_CLEAR_FAILED, DEM_CLEAR_PENDING, DEM_CLEAR_BUSY, DEM_CLEAR_MEMORY_ERROR]
      arg DTC: type=uint32, direction=IN, server-argument-impl-policy=USE-ARGUMENT-TYPE
      arg DTCFormat: type=Dem_DTCFormatType, direction=IN, server-argument-impl-policy=USE-ARGUMENT-TYPE
      arg DTCOrigin: type=Dem_DTCOriginType, direction=IN, server-argument-impl-policy=USE-ARGUMENT-TYPE
    7 x error:
      DEM_CLEAR_BUSY: error-code=5
      DEM_CLEAR_FAILED: error-code=3
      DEM_CLEAR_MEMORY_ERROR: error-code=6
      DEM_CLEAR_PENDING: error-code=4
      DEM_CLEAR_WRONG_DTC: error-code=1
      DEM_CLEAR_WRONG_DTCORIGIN: error-code=2
      E_OK: error-code=0
  client server interface EnableCondition: is-service=true
    operation SetEnableCondition: possible-error=[EnableCondition/E_OK, EnableCondition/E_NOT_OK]
      arg ConditionFulfilled: type=boolean, direction=IN, server-argument-impl-policy=USE-ARGUMENT-TYPE
    error E_NOT_OK: error-code=1
    error E_OK: error-code=0
package /BMW/Platform/StdDiag/ModeDeclarationGroups
  mode declaration group StdDiag_LifeCycle: category=EXPLICIT_ORDER, initial-mode=STDDIAG_STOPPED, on-transition-value=3
    mode STDDIAG_INITIALIZED: value=0
    mode STDDIAG_RUNNING: value=1
    mode STDDIAG_STOPPED: value=2
  mode declaration group StdDiag_NormalCommunicationModeGroup: category=EXPLICIT_ORDER, initial-mode=ENABLE_RX_AND_TX_NORMAL, on-transition-value=4
    4 x mode:
      DISABLE_RX_AND_TX_NORMAL: value=0
      DISABLE_RX_ENABLE_TX_NORMAL: value=1
      ENABLE_RX_AND_TX_NORMAL: value=2
      ENABLE_RX_DISABLE_TX_NORMAL: value=3
  mode declaration group StdDiag_SessionModeGroup: category=ALPHABETIC_ORDER, initial-mode=STDDIAG_DEFAULT_SESSION
    mode STDDIAG_DEFAULT_SESSION
    mode STDDIAG_OTHER_SESSION
package /BMW/Platform/StdDiag/Omc/ModeDeclarationGroups
  mode declaration group OmcExtendedOperatingMode: category=EXPLICIT_ORDER, initial-mode=OmcExtendedOperatingMode/OMC_MODE_EXTENSION_NORMAL, on-transition-value=254
    17 x mode:
      OMC_MODE_EXTENSION_1: value=1
      OMC_MODE_EXTENSION_{10..14}: value={10..14}
      OMC_MODE_EXTENSION_{2..9}: value={2..9}
      OMC_MODE_EXTENSION_INVALID: value=255
      OMC_MODE_EXTENSION_NORMAL: value=0
      OMC_MODE_EXTENSION_SAVE_ENERGY: value=15
  mode declaration group OmcOperatingMode: category=EXPLICIT_ORDER, initial-mode=OmcOperatingMode/OMC_MODE_NORMAL, on-transition-value=255
    4 x mode:
      OMC_MODE_ASSEMBLY: value=1
      OMC_MODE_BMW_FLASH: value=3
      OMC_MODE_NORMAL: value=0
      OMC_MODE_TRANSPORT: value=2
package /BMW/Platform/StdDiag/Omc/PortInterfaces
  client server interface OmcModesCallouts
    operation AllowOpModeSwitch: possible-error=[OmcModesCallouts/E_NOT_OK, OmcModesCallouts/E_RUNNING]
      4 x arg, all with direction=IN, server-argument-impl-policy=USE-ARGUMENT-TYPE:
        OperatingMode: type=Omc_OperatingModeType
        ExtendedOperatingMode: type=Omc_ExtendedOperatingModeType
        NewOperatingMode: type=Omc_OperatingModeType
        NewExtendedOperatingMode: type=Omc_ExtendedOperatingModeType
    operation OpModeSwitchCancelled: possible-error=[OmcModesCallouts/E_OK, OmcModesCallouts/E_RUNNING]
      4 x arg, all with direction=IN, server-argument-impl-policy=USE-ARGUMENT-TYPE:
        OperatingMode: type=Omc_OperatingModeType
        ExtendedOperatingMode: type=Omc_ExtendedOperatingModeType
        RequestedOperatingMode: type=Omc_OperatingModeType
        RequestedExtendedOperatingMode: type=Omc_ExtendedOperatingModeType
    error E_NOT_OK: error-code=1
    error E_OK: error-code=0
    error E_RUNNING: error-code=10
  client server interface OmcModesCalloutsResult
    operation OpModeSwitchAllowedResult: possible-error=OmcModesCalloutsResult/E_OK
      arg Result: type=boolean, direction=IN, server-argument-impl-policy=USE-ARGUMENT-TYPE
    operation OpModeSwitchCancelledAck: possible-error=OmcModesCalloutsResult/E_OK
    error E_OK: error-code=0
  mode switch interface ExtendedOperatingModeNotification
    mode group currentExtendedOperatingMode: type=ModeDeclarationGroups/OmcExtendedOperatingMode
  mode switch interface OperatingModeNotification
    mode group currentOperatingMode: type=ModeDeclarationGroups/OmcOperatingMode
package /BMW/Platform/StdDiag/PortInterfaces
  5 x client server interface:
    ApplicationDataTransfer
      11 x operation:
        CancelOperation: possible-error=ApplicationDataTransfer/E_OK
        Download: possible-error=[ApplicationDataTransfer/E_RUNNING, ApplicationDataTransfer/E_NOT_OK]
          4 x arg:
            blockSequenceCounter: type=uint8, direction=IN, server-argument-impl-policy=USE-ARGUMENT-TYPE
            data: type=UpDownload_ArrayType, direction=IN, server-argument-impl-policy=USE-ARRAY-BASE-TYPE
            length: type=uint32, direction=IN, server-argument-impl-policy=USE-ARGUMENT-TYPE
            errorCode: type=Dcm_NegativeResponseCodeType, direction=OUT, server-argument-impl-policy=USE-ARGUMENT-TYPE
        DownloadPostprocess: possible-error=[ApplicationDataTransfer/E_RUNNING, ApplicationDataTransfer/E_NOT_OK]
          arg parameter: type=AdtApplicationParameter_ArrayType, direction=IN, server-argument-impl-policy=USE-ARRAY-BASE-TYPE
          arg parameterSize: type=uint16, direction=IN, server-argument-impl-policy=USE-ARGUMENT-TYPE
          arg errorCode: type=Dcm_NegativeResponseCodeType, direction=OUT, server-argument-impl-policy=USE-ARGUMENT-TYPE
        DownloadPreprocess: possible-error=[ApplicationDataTransfer/E_RUNNING, ApplicationDataTransfer/E_NOT_OK]
          arg parameter: type=AdtApplicationParameter_ArrayType, direction=IN, server-argument-impl-policy=USE-ARRAY-BASE-TYPE
          arg parameterSize: type=uint16, direction=IN, server-argument-impl-policy=USE-ARGUMENT-TYPE
          arg errorCode: type=Dcm_NegativeResponseCodeType, direction=OUT, server-argument-impl-policy=USE-ARGUMENT-TYPE
        RequestDownload: possible-error=[ApplicationDataTransfer/E_RUNNING, ApplicationDataTransfer/E_NOT_OK]
          4 x arg, all with server-argument-impl-policy=USE-ARGUMENT-TYPE:
            dataFormatIdentifier: type=uint8, direction=IN
            size: type=uint32, direction=IN
            maxBlockLength: type=uint32, direction=OUT
            errorCode: type=Dcm_NegativeResponseCodeType, direction=OUT
        RequestDownloadExit: possible-error=ApplicationDataTransfer/E_OK
        RequestUpload: possible-error=[ApplicationDataTransfer/E_RUNNING, ApplicationDataTransfer/E_NOT_OK]
          4 x arg, all with server-argument-impl-policy=USE-ARGUMENT-TYPE:
            dataFormatIdentifier: type=uint8, direction=IN
            size: type=uint32, direction=IN
            maxBlockLength: type=uint32, direction=OUT
            errorCode: type=Dcm_NegativeResponseCodeType, direction=OUT
        RequestUploadExit: possible-error=ApplicationDataTransfer/E_OK
        Upload: possible-error=[ApplicationDataTransfer/E_RUNNING, ApplicationDataTransfer/E_NOT_OK]
          4 x arg:
            blockSequenceCounter: type=uint8, direction=IN, server-argument-impl-policy=USE-ARGUMENT-TYPE
            data: type=UpDownload_ArrayType, direction=OUT, server-argument-impl-policy=USE-ARRAY-BASE-TYPE
            length: type=uint32, direction=IN, server-argument-impl-policy=USE-ARGUMENT-TYPE
            errorCode: type=Dcm_NegativeResponseCodeType, direction=OUT, server-argument-impl-policy=USE-ARGUMENT-TYPE
        UploadPostprocess: possible-error=[ApplicationDataTransfer/E_RUNNING, ApplicationDataTransfer/E_NOT_OK]
          arg parameter: type=AdtApplicationParameter_ArrayType, direction=IN, server-argument-impl-policy=USE-ARRAY-BASE-TYPE
          arg parameterSize: type=uint16, direction=IN, server-argument-impl-policy=USE-ARGUMENT-TYPE
          arg errorCode: type=Dcm_NegativeResponseCodeType, direction=OUT, server-argument-impl-policy=USE-ARGUMENT-TYPE
        UploadPreprocess: possible-error=[ApplicationDataTransfer/E_RUNNING, ApplicationDataTransfer/E_NOT_OK]
          arg parameter: type=AdtApplicationParameter_ArrayType, direction=IN, server-argument-impl-policy=USE-ARRAY-BASE-TYPE
          arg parameterSize: type=uint16, direction=IN, server-argument-impl-policy=USE-ARGUMENT-TYPE
          arg errorCode: type=Dcm_NegativeResponseCodeType, direction=OUT, server-argument-impl-policy=USE-ARGUMENT-TYPE
      error E_NOT_OK: error-code=1
      error E_OK: error-code=0
      error E_RUNNING: error-code=10
    ApplicationDataTransferCbk
      operation OperationFinished: possible-error=ApplicationDataTransferCbk/E_OK
        arg result: type=boolean, direction=IN, server-argument-impl-policy=USE-ARGUMENT-TYPE
      error E_OK: error-code=0
    UserActiveSessionState
      operation GetActiveSessionState: possible-error=UserActiveSessionState/E_NOT_OK
        arg activeSession: type=Dcm_SesCtrlType, direction=IN, server-argument-impl-policy=USE-ARGUMENT-TYPE
        arg activeSessionState: type=uint8, direction=OUT, server-argument-impl-policy=USE-ARGUMENT-TYPE
      error E_NOT_OK: error-code=1
    UserEstablishIntrinsicSafety
      operation EstablishIntrinsicSafety: possible-error=[UserEstablishIntrinsicSafety/E_NOT_OK, UserEstablishIntrinsicSafety/E_RUNNING]
        arg IntrinsicSafetyEstablished: type=boolean, direction=OUT, server-argument-impl-policy=USE-ARGUMENT-TYPE
      operation EstablishIntrinsicSafetyCancelled: possible-error=UserEstablishIntrinsicSafety/E_RUNNING
      error E_NOT_OK: error-code=1
      error E_RUNNING: error-code=10
    UserEstablishIntrinsicSafetyCbk
      operation EstablishIntrinsicSafetyCancelledAck: possible-error=UserEstablishIntrinsicSafetyCbk/E_OK
      operation EstablishIntrinsicSafetyResult: possible-error=UserEstablishIntrinsicSafetyCbk/E_OK
        arg IntrinsicSafetyEstablished: type=boolean, direction=IN, server-argument-impl-policy=USE-ARGUMENT-TYPE
      error E_OK: error-code=0
  mode switch interface ComControlNormalNotificationInterface: is-service=true
    mode group CommunicationModeDeclarationGroup: type=StdDiag_NormalCommunicationModeGroup
  mode switch interface ILifeCycle
    mode group Mode: type=StdDiag_LifeCycle
  mode switch interface SessionChangeIndicationInterface: is-service=true
    mode group SessionModeDeclarationGroup: type=StdDiag_SessionModeGroup
  sender receiver interface ComControlModeRequestInterface: is-service=true, invalidation-policy{data-element=requestedMode, handle-invalid=DONT-INVALIDATE}
    data requestedMode: type=NormalCommunicationModeType
  sender receiver interface ILifeCycleRequest: is-service=true, invalidation-policy{data-element=ILifeCycleRequest/requestMode, handle-invalid=DONT-INVALIDATE}
    data requestMode: type=StdDiag_LifeCycleRequestType
package /BMW/Platform/StdDiag/Stm/ModeDeclarationGroups
  mode declaration group Stm_VehicleStateMode: category=ALPHABETIC_ORDER, initial-mode=Stm_VehicleStateMode/STM_VEHICLE_STATE_UNAVAILABLE
    10 x mode:
      STM_VEHICLE_STATE_CHECK_ANALYS_DIAGNOSTICS
      STM_VEHICLE_STATE_CUSTOMER_ABSENT
      STM_VEHICLE_STATE_DRIVE
      STM_VEHICLE_STATE_INVALID
      STM_VEHICLE_STATE_LIVING
      STM_VEHICLE_STATE_PARKING_BN_NOK
      STM_VEHICLE_STATE_PARKING_BN_OK
      STM_VEHICLE_STATE_READINESS_TO_DRIVE_INIT
      STM_VEHICLE_STATE_READINESS_TO_DRIVE_STOP
      STM_VEHICLE_STATE_UNAVAILABLE
package /BMW/Platform/StdDiag/Stm/PortInterfaces
  mode switch interface VehicleStateModeInterface
    mode group currentVehicleStateMode: type=ModeDeclarationGroups/Stm_VehicleStateMode
package /BMW/Platform/Stm/Dem/PortInterfaces
  client server interface EnableCondition: is-service=true
    operation SetEnableCondition: possible-error=[EnableCondition/E_OK, EnableCondition/E_NOT_OK]
      arg ConditionFulfilled: type=boolean, direction=IN, server-argument-impl-policy=USE-ARGUMENT-TYPE
    error E_NOT_OK: error-code=1
    error E_OK: error-code=0
package /BMW/Platform/Stm/ModeDeclarationGroups
  5 x mode declaration group, all with category=ALPHABETIC_ORDER:
    ErrorMemoryLockSignalReceptionMode: initial-mode=EM_LOCK_NOT_RECEIVABLE
      mode EM_LOCK_NOT_RECEIVABLE
      mode EM_LOCK_RECEIVABLE
    Stm_CentralErrorLockMode: initial-mode=STM_CEL_INVALID
      mode STM_CEL_INVALID
      mode STM_CEL_LOCKED
      mode STM_CEL_UNLOCKED
    Stm_EnergyStateMode: initial-mode=STM_ENERGY_INVALID
      5 x mode:
        STM_ENERGY_GOOD
        STM_ENERGY_INVALID
        STM_ENERGY_OK
        STM_ENERGY_SEVERE_SHORTAGE
        STM_ENERGY_SHORTAGE
    Stm_VehicleStateMode: initial-mode=Stm_VehicleStateMode/STM_VEHICLE_STATE_UNAVAILABLE
      10 x mode:
        STM_VEHICLE_STATE_CHECK_ANALYS_DIAGNOSTICS
        STM_VEHICLE_STATE_CUSTOMER_ABSENT
        STM_VEHICLE_STATE_DRIVE
        STM_VEHICLE_STATE_INVALID
        STM_VEHICLE_STATE_LIVING
        STM_VEHICLE_STATE_PARKING_BN_NOK
        STM_VEHICLE_STATE_PARKING_BN_OK
        STM_VEHICLE_STATE_READINESS_TO_DRIVE_INIT
        STM_VEHICLE_STATE_READINESS_TO_DRIVE_STOP
        STM_VEHICLE_STATE_UNAVAILABLE
    Stm_VehicleStateSP2015Mode: initial-mode=STM_VEHICLE_STATE_SP2015_UNAVAILABLE
      10 x mode:
        STM_VEHICLE_STATE_SP2015_CHECK_ANALYS_DIAGNOSTICS
        STM_VEHICLE_STATE_SP2015_CUSTOMER_ABSENT
        STM_VEHICLE_STATE_SP2015_DRIVE
        STM_VEHICLE_STATE_SP2015_INVALID
        STM_VEHICLE_STATE_SP2015_LIVING
        STM_VEHICLE_STATE_SP2015_PARKING_BN_NOK
        STM_VEHICLE_STATE_SP2015_PARKING_BN_OK
        STM_VEHICLE_STATE_SP2015_READINESS_TO_DRIVE_INIT
        STM_VEHICLE_STATE_SP2015_READINESS_TO_DRIVE_STOP
        STM_VEHICLE_STATE_SP2015_UNAVAILABLE
package /BMW/Platform/Stm/PortInterfaces
  5 x mode switch interface:
    CentralErrorLockModeInterface
      mode group currentCentralErrorLockMode: type=Stm_CentralErrorLockMode
    EMLockSignalReceptionModeInterface: is-service=true
      mode group currentEMLockSignalReceptionMode: type=ErrorMemoryLockSignalReceptionMode
    EnergyStateModeInterface
      mode group currentEnergyMode: type=Stm_EnergyStateMode
    VehicleStateModeInterface
      mode group currentVehicleStateMode: type=ModeDeclarationGroups/Stm_VehicleStateMode
    VehicleStateSP2015ModeInterface
      mode group currentVehicleStateSP2015Mode: type=Stm_VehicleStateSP2015Mode
  4 x sender receiver interface:
    CentralErrorLockSignalInterface: invalidation-policy{data-element=centralErrorLock, handle-invalid=DONT-INVALIDATE}
      data centralErrorLock: type=Stm_CentralErrorLockType
    EnergyStateSignalInterface: invalidation-policy{data-element=energyState, handle-invalid=DONT-INVALIDATE}
      data energyState: type=Stm_EnergyStateType
    VehicleStateSignalInterface: invalidation-policy{data-element=VehicleState, handle-invalid=DONT-INVALIDATE}
      data VehicleState: type=Stm_VehicleStateType
    VehicleStateSP2015SignalInterface: invalidation-policy{data-element=vehicleStateSP2015, handle-invalid=DONT-INVALIDATE}
      data vehicleStateSP2015: type=Stm_VehicleStateSP2015Type
package /BMW/Platform/SysTime/Dcm/PortInterfaces
  client server interface DataServices_SystemTime: is-service=true
    operation ReadData: possible-error=DataServices_SystemTime/E_NOT_OK
      arg Data: type=Array4, direction=OUT, server-argument-impl-policy=USE-ARGUMENT-TYPE
    error E_NOT_OK: error-code=1
package /BMW/Platform/SysTime/Det/PortInterfaces
  client server interface DETService: is-service=true
    operation ReportError: possible-error=DETService/E_OK
      arg InstanceId: type=uint8, direction=IN, server-argument-impl-policy=USE-ARGUMENT-TYPE
      arg ApiId: type=uint8, direction=IN, server-argument-impl-policy=USE-ARGUMENT-TYPE
      arg ErrorId: type=uint8, direction=IN, server-argument-impl-policy=USE-ARGUMENT-TYPE
    error E_OK: error-code=0
package /BMW/Platform/SysTime/ModeDeclarationGroups
  mode declaration group SysTime_LifeCycle: category=EXPLICIT_ORDER, initial-mode=SYSTIME_STOPPED, on-transition-value=3
    mode SYSTIME_INITIALIZED: value=0
    mode SYSTIME_RUNNING: value=1
    mode SYSTIME_STOPPED: value=2
package /BMW/Platform/SysTime/PortInterfaces
  client server interface GetSysTime
    operation GetTime: possible-error=GetSysTime/E_NOT_OK
      arg currentTime: type=uint32, direction=OUT, server-argument-impl-policy=USE-ARGUMENT-TYPE
    error E_NOT_OK: error-code=1
  mode switch interface ILifeCycle
    mode group Mode: type=SysTime_LifeCycle
  sender receiver interface ILifeCycleRequest: is-service=true, invalidation-policy{data-element=ILifeCycleRequest/requestMode, handle-invalid=DONT-INVALIDATE}
    data requestMode: type=SysTime_LifeCycleRequestType
  sender receiver interface SysTimeRx: invalidation-policy{data-element=timeSignal, handle-invalid=DONT-INVALIDATE}
    data timeSignal: type=uint32
package /BMW/Platform/Vin/Dem/PortInterfaces
  client server interface Vin_DiagnosticMonitor: is-service=true
    operation SetEventStatus: possible-error=Vin_DiagnosticMonitor/E_NOT_OK
      arg EventStatus: type=Dem_EventStatusType, direction=IN, server-argument-impl-policy=USE-ARGUMENT-TYPE
    error E_NOT_OK: error-code=1
package /BMW/Platform/Vin/Det/PortInterfaces
  client server interface DETService: is-service=true
    operation ReportError: possible-error=DETService/E_NOT_OK
      arg InstanceId: type=uint8, direction=IN, server-argument-impl-policy=USE-ARGUMENT-TYPE
      arg ApiId: type=uint8, direction=IN, server-argument-impl-policy=USE-ARGUMENT-TYPE
      arg ErrorId: type=uint8, direction=IN, server-argument-impl-policy=USE-ARGUMENT-TYPE
    error E_NOT_OK: error-code=1
package /BMW/Platform/Vin/Dlog/PortInterfaces
  client server interface EcuInfo
    operation GetEcuId: possible-error=EcuInfo/E_NOT_OK
      arg ecuId: type=uint8, direction=OUT, server-argument-impl-policy=USE-ARGUMENT-TYPE
    operation GetVin: possible-error=EcuInfo/E_NOT_OK
      arg Vin: type=Dlog_VinArrayType, direction=OUT, server-argument-impl-policy=USE-ARGUMENT-TYPE
    error E_NOT_OK: error-code=1
package /BMW/Platform/Vin/ModeDeclarationGroups
  mode declaration group Vin_ChangeIndicator: category=EXPLICIT_ORDER, initial-mode=VIN_CI_INIT, on-transition-value=5
    mode VIN_CI_CHANGED: value=2
    mode VIN_CI_INIT: value=0
    mode VIN_CI_NOCHANGE: value=1
  mode declaration group Vin_LifeCycle: category=EXPLICIT_ORDER, initial-mode=VIN_STOPPED, on-transition-value=3
    mode VIN_INITIALIZED: value=0
    mode VIN_RUNNING: value=1
    mode VIN_STOPPED: value=2
  mode declaration group Vin_VinComMode: category=EXPLICIT_ORDER, initial-mode=VIN_VINCOMOFF, on-transition-value=2
    mode VIN_VINCOMOFF: value=1
    mode VIN_VINCOMON: value=0
package /BMW/Platform/Vin/NvM/PortInterfaces
  client server interface Vin_NvMNotifyJobFinished: is-service=true
    operation JobFinished: possible-error=Vin_NvMNotifyJobFinished/E_OK
      arg ServiceId: type=uint8, direction=IN, server-argument-impl-policy=USE-ARGUMENT-TYPE
      arg JobResult: type=NvM_RequestResultType, direction=IN, server-argument-impl-policy=USE-ARGUMENT-TYPE
    error E_OK: error-code=0
  client server interface Vin_NvMService: is-service=true
    operation GetErrorStatus: possible-error=Vin_NvMService/E_NOT_OK
      arg RequestResultPtr: type=NvM_RequestResultType, direction=OUT, server-argument-impl-policy=USE-ARGUMENT-TYPE
    operation ReadBlock: possible-error=Vin_NvMService/E_NOT_OK
      arg DstPtr: type=NvM_DstPtrType, direction=IN, server-argument-impl-policy=USE-ARGUMENT-TYPE
    operation WriteBlock: possible-error=Vin_NvMService/E_NOT_OK
      arg SrcPtr: type=NvM_SrcPtrType, direction=IN, server-argument-impl-policy=USE-ARGUMENT-TYPE
    error E_NOT_OK: error-code=1
package /BMW/Platform/Vin/PortInterfaces
  mode switch interface ILifeCycle: service-kind=BASIC-SOFTWARE-MODE-MANAGER
    mode group Mode: type=Vin_LifeCycle
  mode switch interface IVinChangeIndicator
    mode group ChangeIndicator: type=Vin_ChangeIndicator
  mode switch interface VinCom: is-service=true
    mode group Mode: type=Vin_VinComMode
  4 x sender receiver interface:
    ComVin: invalidation-policy{data-element=ComVin, handle-invalid=DONT-INVALIDATE}
      data ComVin: type=Vin_ComVinType
    ILifeCycleRequest: is-service=true, service-kind=BASIC-SOFTWARE-MODE-MANAGER, invalidation-policy{data-element=ILifeCycleRequest/requestMode, handle-invalid=DONT-INVALIDATE}
      data requestMode: type=Vin_LifeCycleRequestType
    Vin: invalidation-policy{data-element=Vin/Vin, handle-invalid=DONT-INVALIDATE}
      data Vin: type=Vin_VinType
    VinRequest: invalidation-policy{data-element=RequestMessageIdentifier, handle-invalid=DONT-INVALIDATE}
      data RequestMessageIdentifier: sw-impl-policy=QUEUED, type=uint16
package /ComponentTypes/DataTypeMappingSets
  port interface mapping set InterfaceMappingSet
    port-interface-mappings:
      4 x variable and parameter interface mapping:
        CentralErrorLockSignalInterfaceST_ILK_ERRM_FZM_Mapping: data-prototype-mapping{first-data-prototype=centralErrorLock, second-data-prototype=ST_ILK_ERRM_FZM}
        EnergyStateSignalInterfaceST_ENERG_FZM_Mapping: data-prototype-mapping{first-data-prototype=energyState, second-data-prototype=ST_ENERG_FZM}
        SysTimeRxT_SEC_COU_REL_PortIf1_Mapping: data-prototype-mapping{first-data-prototype=timeSignal, second-data-prototype=T_SEC_COU_REL}
        uint16_PortIf1TRGG_ENGTORQ_EPS_Mapping: data-prototype-mapping{first-data-prototype=uint16_PortIf1/Val, second-data-prototype=TRGG_ENGTORQ_EPS}
package /Nexteer/Calibrations
  291 x parameter interface:
    Ag4
      parameter data prototype Val: sw-calibration-access=READ-WRITE, type=Ag13
    AgAry1D2
      parameter data prototype Ary1D: sw-calibration-access=READ-WRITE, type=AgAry1D4
    Ar1D_u2p14_5_calPortIf1
      parameter data prototype Ary1D: sw-calibration-access=READ-WRITE, type=Ary1D_u2p14_5
    Ary1D_boolean_4_CalPortIf1
      parameter data prototype Ary1D: sw-calibration-access=READ-WRITE, type=Ary1D_boolean_4
    Ary1D_f32_11_CalPortIf1
      parameter data prototype Ary1D: sw-calibration-access=READ-WRITE, type=Ary1D_f32_11
    Ary1D_f32_2_CalPortIf1
      parameter data prototype Ary1D: sw-calibration-access=READ-WRITE, type=Ary1D_f32_2
    Ary1D_f32_3_CalPortIf1
      parameter data prototype Ary1D: sw-calibration-access=READ-WRITE, type=Ary1D_f32_3
    Ary1D_f32_4_CalPortIf1
      parameter data prototype Ary1D: sw-calibration-access=READ-WRITE, type=Ary1D_f32_4
    Ary1D_f32_5_CalPortIf1
      parameter data prototype Ary1D: sw-calibration-access=READ-WRITE, type=Ary1D_f32_5
    Ary1D_f32_8_CalPortIf1
      parameter data prototype Ary1D: sw-calibration-access=READ-WRITE, type=Ary1D_f32_8
    Ary1D_logl_2_CalPortIf1
      parameter data prototype Ary1D: sw-calibration-access=READ-WRITE, type=Ary1D_logl_2
    Ary1D_logl_3_CalPortIf1
      parameter data prototype Ary1D: sw-calibration-access=READ-WRITE, type=Ary1D_logl_3
    Ary1D_logl_4_CalPortIf1
      parameter data prototype Ary1D: sw-calibration-access=READ-WRITE, type=Ary1D_logl_4
    Ary1D_s10p5_8_CalPortIf1
      parameter data prototype Ary1D: sw-calibration-access=READ-WRITE, type=Ary1D_s10p5_8
    Ary1D_s11p4_11_CalPortIf1
      parameter data prototype Ary1D: sw-calibration-access=READ-WRITE, type=Ary1D_s11p4_11
    Ary1D_s11p4_14_CalPortIf1
      parameter data prototype Ary1D: sw-calibration-access=READ-WRITE, type=Ary1D_s11p4_14
    Ary1D_s11p4_4_CalPortIf1
      parameter data prototype Ary1D: sw-calibration-access=READ-WRITE, type=Ary1D_s11p4_4
    Ary1D_s11p4_5_CalPortIf1
      parameter data prototype Ary1D: sw-calibration-access=READ-WRITE, type=Ary1D_s11p4_5
    Ary1D_s12p3_4_CalPortIf1
      parameter data prototype Ary1D: sw-calibration-access=READ-WRITE, type=Ary1D_s12p3_4
    Ary1D_s14p1_4_CalPortIf1
      parameter data prototype Ary1D: sw-calibration-access=READ-WRITE, type=Ary1D_s14p1_4
    Ary1D_s14p1_8_CalPortIf1
      parameter data prototype Ary1D: sw-calibration-access=READ-WRITE, type=Ary1D_s14p1_8
    Ary1D_s15p0_10_CalPortIf1
      parameter data prototype Ary1D: sw-calibration-access=READ-WRITE, type=Ary1D_s15p0_10
    Ary1D_s15p0_21_CalPortIf1
      parameter data prototype Ary1D: sw-calibration-access=READ-WRITE, type=Ary1D_s15p0_21
    Ary1D_s15p0_4_CalPortIf1
      parameter data prototype Ary1D: sw-calibration-access=READ-WRITE, type=Ary1D_s15p0_4
    Ary1D_s15p0_5_CalPortIf1
      parameter data prototype Ary1D: sw-calibration-access=READ-WRITE, type=Ary1D_s15p0_5
    Ary1D_s16_22_CalPortIf1
      parameter data prototype Ary1D: sw-calibration-access=READ-WRITE, type=Ary1D_s16_22
    Ary1D_s2p13_21_CalPortIf1
      parameter data prototype Ary1D: sw-calibration-access=READ-WRITE, type=Ary1D_s2p13_21
    Ary1D_s3p12_4_CalPortIf1
      parameter data prototype Ary1D: sw-calibration-access=READ-WRITE, type=Ary1D_s3p12_4
    Ary1D_s4p11_12_CalPort1f
      parameter data prototype Ary1D: sw-calibration-access=READ-WRITE, type=Ary1D_s4p11_12
    Ary1D_s4p11_12_CalPortIf1
      parameter data prototype Ary1D: sw-calibration-access=READ-WRITE, type=Ary1D_s4p11_12
    Ary1D_s4p11_20_CalPortIf1
      parameter data prototype Ary1D: sw-calibration-access=READ-WRITE, type=Ary1D_s4p11_20
    Ary1D_s4p11_4_CalPortIf1
      parameter data prototype Ary1D: sw-calibration-access=READ-WRITE, type=Ary1D_s4p11_4
    Ary1D_s4p11_5_CalPortIf1
      parameter data prototype Ary1D: sw-calibration-access=READ-WRITE, type=Ary1D_s4p11_5
    Ary1D_s4p11_7_CalPortIf1
      parameter data prototype Ary1D: sw-calibration-access=READ-WRITE, type=Ary1D_s4p11_7
    Ary1D_s7p8_20_CalPortIf1
      parameter data prototype Ary1D: sw-calibration-access=READ-WRITE, type=Ary1D_s7p8_20
    Ary1D_s7p8_4_CalPortIf1
      parameter data prototype Ary1D: sw-calibration-access=READ-WRITE, type=Ary1D_s7p8_4
    Ary1D_s8p7_12_CalPortIf1
      parameter data prototype Ary1D: sw-calibration-access=READ-WRITE, type=Ary1D_s8p7_12
    Ary1D_s8p7_14_CalPortIf1
      parameter data prototype Ary1D: sw-calibration-access=READ-WRITE, type=Ary1D_s8p7_14
    Ary1D_s8p7_21_CalPortIf1
      parameter data prototype Ary1D: sw-calibration-access=READ-WRITE, type=Ary1D_s8p7_21
    Ary1D_s8p7_3_CalPortIf1
      parameter data prototype Ary1D: sw-calibration-access=READ-WRITE, type=Ary1D_s8p7_3
    Ary1D_s8p7_4_CalPortIf1
      parameter data prototype Ary1D: sw-calibration-access=READ-WRITE, type=Ary1D_s8p7_4
    Ary1D_u08_22_CalPortIf1
      parameter data prototype Ary1D: sw-calibration-access=READ-WRITE, type=Ary1D_u08_22
    Ary1D_u08_48_CalPortIf1
      parameter data prototype Ary1D: sw-calibration-access=READ-WRITE, type=Ary1D_u08_48
    Ary1D_u08_6_CalPortIf1
      parameter data prototype Ary1D: sw-calibration-access=READ-WRITE, type=Ary1D_u08_6
    Ary1D_u0p16_10_CalPortIf1
      parameter data prototype Ary1D: sw-calibration-access=READ-WRITE, type=Ary1D_u0p16_10
    Ary1D_u0p16_3_CalPortIf1
      parameter data prototype Ary1D: sw-calibration-access=READ-WRITE, type=Ary1D_u0p16_3
    Ary1D_u10p6_10_CalPortIf1
      parameter data prototype Ary1D: sw-calibration-access=READ-WRITE, type=Ary1D_u10p6_10
    Ary1D_u10p6_13_CalPortIf1
      parameter data prototype Ary1D: sw-calibration-access=READ-WRITE, type=Ary1D_u10p6_13
    Ary1D_u10p6_2_CalPortIf1
      parameter data prototype Ary1D: sw-calibration-access=READ-WRITE, type=Ary1D_u10p6_2
    Ary1D_u10p6_3_CalPortIf1
      parameter data prototype Ary1D: sw-calibration-access=READ-WRITE, type=Ary1D_u10p6_3
    Ary1D_u10p6_4_CalPortIf1
      parameter data prototype Ary1D: sw-calibration-access=READ-WRITE, type=Ary1D_u10p6_4
    Ary1D_u10p6_5_CalPortIf1
      parameter data prototype Ary1D: sw-calibration-access=READ-WRITE, type=Ary1D_u10p6_5
    Ary1D_u10p6_7_CalPortIf1
      parameter data prototype Ary1D: sw-calibration-access=READ-WRITE, type=Ary1D_u10p6_7
    Ary1D_u10p6_8_CalPortIf1
      parameter data prototype Ary1D: sw-calibration-access=READ-WRITE, type=Ary1D_u10p6_8
    Ary1D_u11p5_10_CalPortIf1
      parameter data prototype Ary1D: sw-calibration-access=READ-WRITE, type=Ary1D_u11p5_10
    Ary1D_u11p5_11_CalPortIf1
      parameter data prototype Ary1D: sw-calibration-access=READ-WRITE, type=Ary1D_u11p5_11
    Ary1D_u11p5_12_CalPortIf1
      parameter data prototype Ary1D: sw-calibration-access=READ-WRITE, type=Ary1D_u11p5_12
    Ary1D_u11p5_13_CalPortIf1
      parameter data prototype Ary1D: sw-calibration-access=READ-WRITE, type=Ary1D_u11p5_13
    Ary1D_u11p5_4_CalPortIf1
      parameter data prototype Ary1D: sw-calibration-access=READ-WRITE, type=Ary1D_u11p5_4
    Ary1D_u11p5_5_CalPortIf1
      parameter data prototype Ary1D: sw-calibration-access=READ-WRITE, type=Ary1D_u11p5_5
    Ary1D_u11p5_6_CalPortIf1
      parameter data prototype Ary1D: sw-calibration-access=READ-WRITE, type=Ary1D_u11p5_6
    Ary1D_u11p5_8_CalPortIf1
      parameter data prototype Ary1D: sw-calibration-access=READ-WRITE, type=Ary1D_u11p5_8
    Ary1D_u11p5_9_CalPortIf1
      parameter data prototype Ary1D: sw-calibration-access=READ-WRITE, type=Ary1D_u11p5_9
    Ary1D_u12p4_10_CalPortIf1
      parameter data prototype Ary1D: sw-calibration-access=READ-WRITE, type=Ary1D_u12p4_10
    Ary1D_u12p4_12_CalPortIf1
      parameter data prototype Ary1D: sw-calibration-access=READ-WRITE, type=Ary1D_u12p4_12
    Ary1D_u12p4_2_CalPortIf1
      parameter data prototype Ary1D: sw-calibration-access=READ-WRITE, type=Ary1D_u12p4_2
    Ary1D_u12p4_4_CalPortIf1
      parameter data prototype Ary1D: sw-calibration-access=READ-WRITE, type=Ary1D_u12p4_4
    Ary1D_u12p4_7_CalPortIf1
      parameter data prototype Ary1D: sw-calibration-access=READ-WRITE, type=Ary1D_u12p4_7
    Ary1D_u12p4_9_CalPortIf1
      parameter data prototype Ary1D: sw-calibration-access=READ-WRITE, type=Ary1D_u12p4_9
    Ary1D_u13p3_2_CalPortIf1
      parameter data prototype Ary1D: sw-calibration-access=READ-WRITE, type=Ary1D_u13p3_2
    Ary1D_u13p3_4_CalPortIf1
      parameter data prototype Ary1D: sw-calibration-access=READ-WRITE, type=Ary1D_u13p3_4
    Ary1D_u13p3_6_CalPortIf1
      parameter data prototype Ary1D: sw-calibration-access=READ-WRITE, type=Ary1D_u13p3_6
    Ary1D_u15p1_12_CalPortIf1
      parameter data prototype Ary1D: sw-calibration-access=READ-WRITE, type=Ary1D_u15p1_12
    Ary1D_u15p1_4_CalPortIf1
      parameter data prototype Ary1D: sw-calibration-access=READ-WRITE, type=Ary1D_u15p1_4
    Ary1D_u16_13_CalPortIf1
      parameter data prototype Ary1D: sw-calibration-access=READ-WRITE, type=Ary1D_u16_13
    Ary1D_u16_3_CalPortIf1
      parameter data prototype Ary1D: sw-calibration-access=READ-WRITE, type=Ary1D_u16_3
    Ary1D_u16_512_CalPortIf1
      parameter data prototype Ary1D: sw-calibration-access=READ-WRITE, type=Ary1D_u16_512
    Ary1D_u16p0_2_CalPortIf1
      parameter data prototype Ary1D: sw-calibration-access=READ-WRITE, type=Ary1D_u16p0_2
    Ary1D_u16p0_20_CalPortIf1
      parameter data prototype Ary1D: sw-calibration-access=READ-WRITE, type=Ary1D_u16p0_20
    Ary1D_u16p0_22_CalPortIf1
      parameter data prototype Ary1D: sw-calibration-access=READ-WRITE, type=Ary1D_u16p0_22
    Ary1D_u16p0_8_CalPortIf1
      parameter data prototype Ary1D: sw-calibration-access=READ-WRITE, type=Ary1D_u16p0_8
    Ary1D_u1p15_10_CalPortIf1
      parameter data prototype Ary1D: sw-calibration-access=READ-WRITE, type=Ary1D_u1p15_10
    Ary1D_u1p15_11_CalPortIf1
      parameter data prototype Ary1D: sw-calibration-access=READ-WRITE, type=Ary1D_u1p15_11
    Ary1D_u1p15_12_CalPortIf1
      parameter data prototype Ary1D: sw-calibration-access=READ-WRITE, type=Ary1D_u1p15_12
    Ary1D_u1p15_2_CalPortIf1
      parameter data prototype Ary1D: sw-calibration-access=READ-WRITE, type=Ary1D_u1p15_2
    Ary1D_u1p15_21_CalPortIf1
      parameter data prototype Ary1D: sw-calibration-access=READ-WRITE, type=Ary1D_u1p15_21
    Ary1D_u1p15_4_CalPortIf1
      parameter data prototype Ary1D: sw-calibration-access=READ-WRITE, type=Ary1D_u1p15_4
    Ary1D_u1p15_5_CalPortIf1
      parameter data prototype Ary1D: sw-calibration-access=READ-WRITE, type=Ary1D_u1p15_5
    Ary1D_u1p15_6_CalPortIf1
      parameter data prototype Ary1D: sw-calibration-access=READ-WRITE, type=Ary1D_u1p15_6
    Ary1D_u1p15_9_CalPortIf1
      parameter data prototype Ary1D: sw-calibration-access=READ-WRITE, type=Ary1D_u1p15_9
    Ary1D_u2p14_10_CalPortIf1
      parameter data prototype Ary1D: sw-calibration-access=READ-WRITE, type=Ary1D_u2p14_10
    Ary1D_u2p14_11_CalPortIf1
      parameter data prototype Ary1D: sw-calibration-access=READ-WRITE, type=Ary1D_u2p14_11
    Ary1D_u2p14_12_CalPortIf1
      parameter data prototype Ary1D: sw-calibration-access=READ-WRITE, type=Ary1D_u2p14_12
    Ary1D_u2p14_16_CalPortIf1
      parameter data prototype Ary1D: sw-calibration-access=READ-WRITE, type=Ary1D_u2p14_16
    Ary1D_u2p14_2_CalPortIf1
      parameter data prototype Ary1D: sw-calibration-access=READ-WRITE, type=Ary1D_u2p14_2
    Ary1D_u2p14_3_CalPortIf1
      parameter data prototype Ary1D: sw-calibration-access=READ-WRITE, type=Ary1D_u2p14_3
    Ary1D_u2p14_4_CalPortIf1
      parameter data prototype Ary1D: sw-calibration-access=READ-WRITE, type=Ary1D_u2p14_4
    Ary1D_u2p14_5_CalPortIf1
      parameter data prototype Ary1D: sw-calibration-access=READ-WRITE, type=Ary1D_u2p14_5
    Ary1D_u2p14_6_CalPortIf1
      parameter data prototype Ary1D: sw-calibration-access=READ-WRITE, type=Ary1D_u2p14_6
    Ary1D_u2p14_7_CalPortIf1
      parameter data prototype Ary1D: sw-calibration-access=READ-WRITE, type=Ary1D_u2p14_7
    Ary1D_u2p14_8_CalPortIf1
      parameter data prototype Ary1D: sw-calibration-access=READ-WRITE, type=Ary1D_u2p14_8
    Ary1D_u2p14_9_CalPortIf1
      parameter data prototype Ary1D: sw-calibration-access=READ-WRITE, type=Ary1D_u2p14_9
    Ary1D_u32_512_CalPortIf1
      parameter data prototype Ary1D: sw-calibration-access=READ-WRITE, type=Ary1D_u32_512
    Ary1D_u3p13_10_CalPortIf1
      parameter data prototype Ary1D: sw-calibration-access=READ-WRITE, type=Ary1D_u3p13_10
    Ary1D_u3p13_5_CalPortIf1
      parameter data prototype Ary1D: sw-calibration-access=READ-WRITE, type=Ary1D_u3p13_5
    Ary1D_u4p12_10_CalPortIf1
      parameter data prototype Ary1D: sw-calibration-access=READ-WRITE, type=Ary1D_u4p12_10
    Ary1D_u4p12_11_CalPortIf1
      parameter data prototype Ary1D: sw-calibration-access=READ-WRITE, type=Ary1D_u4p12_11
    Ary1D_u4p12_12_CalPortIf1
      parameter data prototype Ary1D: sw-calibration-access=READ-WRITE, type=Ary1D_u4p12_12
    Ary1D_u4p12_13_CalPortIf1
      parameter data prototype Ary1D: sw-calibration-access=READ-WRITE, type=Ary1D_u4p12_13
    Ary1D_u4p12_14_CalPortIf1
      parameter data prototype Ary1D: sw-calibration-access=READ-WRITE, type=Ary1D_u4p12_14
    Ary1D_u4p12_2_CalPortIf1
      parameter data prototype Ary1D: sw-calibration-access=READ-WRITE, type=Ary1D_u4p12_2
    Ary1D_u4p12_21_CalPortIf1
      parameter data prototype Ary1D: sw-calibration-access=READ-WRITE, type=Ary1D_u4p12_21
    Ary1D_u4p12_4_CalPortIf1
      parameter data prototype Ary1D: sw-calibration-access=READ-WRITE, type=Ary1D_u4p12_4
    Ary1D_u4p12_5_CalPortIf1
      parameter data prototype Ary1D: sw-calibration-access=READ-WRITE, type=Ary1D_u4p12_5
    Ary1D_u4p12_6_CalPortIf1
      parameter data prototype Ary1D: sw-calibration-access=READ-WRITE, type=Ary1D_u4p12_6
    Ary1D_u4p12_8_CalPortIf1
      parameter data prototype Ary1D: sw-calibration-access=READ-WRITE, type=Ary1D_u4p12_8
    Ary1D_u5p11_10_CalPortIf1
      parameter data prototype Ary1D: sw-calibration-access=READ-WRITE, type=Ary1D_u5p11_10
    Ary1D_u5p11_11_CalPortIf1
      parameter data prototype Ary1D: sw-calibration-access=READ-WRITE, type=Ary1D_u5p11_11
    Ary1D_u5p11_14_CalPortIf1
      parameter data prototype Ary1D: sw-calibration-access=READ-WRITE, type=Ary1D_u5p11_14
    Ary1D_u5p11_17_CalPortIf1
      parameter data prototype Ary1D: sw-calibration-access=READ-WRITE, type=Ary1D_u5p11_17
    Ary1D_u5p11_21_CalPortIf1
      parameter data prototype Ary1D: sw-calibration-access=READ-WRITE, type=Ary1D_u5p11_21
    Ary1D_u5p11_5_CalPortIf1
      parameter data prototype Ary1D: sw-calibration-access=READ-WRITE, type=Ary1D_u5p11_5
    Ary1D_u5p11_6_CalPortIf1
      parameter data prototype Ary1D: sw-calibration-access=READ-WRITE, type=Ary1D_u5p11_6
    Ary1D_u5p11_8_CalPortIf1
      parameter data prototype Ary1D: sw-calibration-access=READ-WRITE, type=Ary1D_u5p11_8
    Ary1D_u6p10_10_CalPortIf1
      parameter data prototype Ary1D: sw-calibration-access=READ-WRITE, type=Ary1D_u6p10_10
    Ary1D_u6p10_12_CalPortIf1
      parameter data prototype Ary1D: sw-calibration-access=READ-WRITE, type=Ary1D_u6p10_12
    Ary1D_u6p10_13_CalPortIf1
      parameter data prototype Ary1D: sw-calibration-access=READ-WRITE, type=Ary1D_u6p10_13
    Ary1D_u6p10_17_CalPortIf1
      parameter data prototype Ary1D: sw-calibration-access=READ-WRITE, type=Ary1D_u6p10_17
    Ary1D_u6p10_2_CalPortIf1
      parameter data prototype Ary1D: sw-calibration-access=READ-WRITE, type=Ary1D_u6p10_2
    Ary1D_u6p10_5_CalPortIf1
      parameter data prototype Ary1D: sw-calibration-access=READ-WRITE, type=Ary1D_u6p10_5
    Ary1D_u6p10_6_CalPortIf1
      parameter data prototype Ary1D: sw-calibration-access=READ-WRITE, type=Ary1D_u6p10_6
    Ary1D_u6p10_8_CalPortIf1
      parameter data prototype Ary1D: sw-calibration-access=READ-WRITE, type=Ary1D_u6p10_8
    Ary1D_u6p10_9_CalPortIf1
      parameter data prototype Ary1D: sw-calibration-access=READ-WRITE, type=Ary1D_u6p10_9
    Ary1D_u7p9_12_CalPortIf1
      parameter data prototype Ary1D: sw-calibration-access=READ-WRITE, type=Ary1D_u7p9_12
    Ary1D_u7p9_3_CalPortIf1
      parameter data prototype Ary1D: sw-calibration-access=READ-WRITE, type=Ary1D_u7p9_3
    Ary1D_u7p9_6_CalPortIf1
      parameter data prototype Ary1D: sw-calibration-access=READ-WRITE, type=Ary1D_u7p9_6
    Ary1D_u8_48_CalPortIf1
      parameter data prototype Ary1D: sw-calibration-access=READ-WRITE, type=Ary1D_u8_48
    Ary1D_u8_6_CalPortIf1
      parameter data prototype Ary1D: sw-calibration-access=READ-WRITE, type=Ary1D_u8_6
    Ary1D_u8p8_10_CalPortIf1
      parameter data prototype Ary1D: sw-calibration-access=READ-WRITE, type=Ary1D_u8p8_10
    Ary1D_u8p8_11_CalPortIf1
      parameter data prototype Ary1D: sw-calibration-access=READ-WRITE, type=Ary1D_u8p8_11
    Ary1D_u8p8_12_CalPortIf1
      parameter data prototype Ary1D: sw-calibration-access=READ-WRITE, type=Ary1D_u8p8_12
    Ary1D_u8p8_14_CalPortIf1
      parameter data prototype Ary1D: sw-calibration-access=READ-WRITE, type=Ary1D_u8p8_14
    Ary1D_u8p8_2_CalPortIf1
      parameter data prototype Ary1D: sw-calibration-access=READ-WRITE, type=Ary1D_u8p8_2
    Ary1D_u8p8_20_CalPortIf1
      parameter data prototype Ary1D: sw-calibration-access=READ-WRITE, type=Ary1D_u8p8_20
    Ary1D_u8p8_3_CalPortIf1
      parameter data prototype Ary1D: sw-calibration-access=READ-WRITE, type=Ary1D_u8p8_3
    Ary1D_u8p8_4_CalPortIf1
      parameter data prototype Ary1D: sw-calibration-access=READ-WRITE, type=Ary1D_u8p8_4
    Ary1D_u8p8_5_CalPortIf1
      parameter data prototype Ary1D: sw-calibration-access=READ-WRITE, type=Ary1D_u8p8_5
    Ary1D_u8p8_6_CalPortIf1
      parameter data prototype Ary1D: sw-calibration-access=READ-WRITE, type=Ary1D_u8p8_6
    Ary1D_u8p8_7_CalPortIf1
      parameter data prototype Ary1D: sw-calibration-access=READ-WRITE, type=Ary1D_u8p8_7
    Ary1D_u8p8_8_CalPortIf1
      parameter data prototype Ary1D: sw-calibration-access=READ-WRITE, type=Ary1D_u8p8_8
    Ary1D_u8p8_9_CalPortIf1
      parameter data prototype Ary1D: sw-calibration-access=READ-WRITE, type=Ary1D_u8p8_9
    Ary1D_u9p7_10_CalPortIf1
      parameter data prototype Ary1D: sw-calibration-access=READ-WRITE, type=Ary1D_u9p7_10
    Ary1D_u9p7_11_CalPortIf1
      parameter data prototype Ary1D: sw-calibration-access=READ-WRITE, type=Ary1D_u9p7_11
    Ary1D_u9p7_12_CalPortIf1
      parameter data prototype Ary1D: sw-calibration-access=READ-WRITE, type=Ary1D_u9p7_12
    Ary1D_u9p7_16_CalPortIf1
      parameter data prototype Ary1D: sw-calibration-access=READ-WRITE, type=Ary1D_u9p7_16
    Ary1D_u9p7_2_CalPortIf1
      parameter data prototype Ary1D: sw-calibration-access=READ-WRITE, type=Ary1D_u9p7_2
    Ary1D_u9p7_3_CalPortIf1
      parameter data prototype Ary1D: sw-calibration-access=READ-WRITE, type=Ary1D_u9p7_3
    Ary1D_u9p7_4_CalPortIf1
      parameter data prototype Ary1D: sw-calibration-access=READ-WRITE, type=Ary1D_u9p7_4
    Ary1D_u9p7_5_CalPortIf1
      parameter data prototype Ary1D: sw-calibration-access=READ-WRITE, type=Ary1D_u9p7_5
    Ary1D_u9p7_6_CalPortIf1
      parameter data prototype Ary1D: sw-calibration-access=READ-WRITE, type=Ary1D_u9p7_6
    Ary1D_u9p7_7_CalPortIf1
      parameter data prototype Ary1D: sw-calibration-access=READ-WRITE, type=Ary1D_u9p7_7
    Ary1D_u9p7_8_CalPortIf1
      parameter data prototype Ary1D: sw-calibration-access=READ-WRITE, type=Ary1D_u9p7_8
    Ary1D_u9p7_9_CalPortIf1
      parameter data prototype Ary1D: sw-calibration-access=READ-WRITE, type=Ary1D_u9p7_9
    Ary2D_f32_2_4_CalPortIf1
      parameter data prototype Ary2D: sw-calibration-access=READ-WRITE, type=Ary2D_f32_2_4
    Ary2D_f32_4_2_CalPortIf1
      parameter data prototype Ary2D: sw-calibration-access=READ-WRITE, type=Ary2D_f32_4_2
    Ary2D_f32_4_5_CalPortIf1
      parameter data prototype Ary2D: sw-calibration-access=READ-WRITE, type=Ary2D_f32_4_5
    Ary2D_f32_4_8_CalPortIf1
      parameter data prototype Ary2D: sw-calibration-access=READ-WRITE, type=Ary2D_f32_4_8
    Ary2D_f32_5_3_CalPortIf1
      parameter data prototype Ary2D: sw-calibration-access=READ-WRITE, type=Ary2D_f32_5_3
    Ary2D_f32_5_4_CalPortIf1
      parameter data prototype Ary2D: sw-calibration-access=READ-WRITE, type=Ary2D_f32_5_4
    Ary2D_f32_5_5_CalPortIf1
      parameter data prototype Ary2D: sw-calibration-access=READ-WRITE, type=Ary2D_f32_5_5
    Ary2D_f32_8_4_CalPortIf1
      parameter data prototype Ary2D: sw-calibration-access=READ-WRITE, type=Ary2D_f32_8_4
    Ary2D_s1p14_10_12_CalPortIf1
      parameter data prototype Ary2D: sw-calibration-access=READ-WRITE, type=Ary2D_s1p14_10_12
    Ary2D_s4p11_10_13_CalPortIf1
      parameter data prototype Ary2D: sw-calibration-access=READ-WRITE, type=Ary2D_s4p11_10_13
    Ary2D_s4p11_11_8_CalPortIf1
      parameter data prototype Ary2D: sw-calibration-access=READ-WRITE, type=Ary2D_s4p11_11_8
    Ary2D_s4p11_12_11_CalPortIf1
      parameter data prototype Ary2D: sw-calibration-access=READ-WRITE, type=Ary2D_s4p11_12_11
    Ary2D_s4p11_12_20_CalPortIf1
      parameter data prototype Ary2D: sw-calibration-access=READ-WRITE, type=Ary2D_s4p11_12_20
    Ary2D_s4p11_8_11_CalPortIf1
      parameter data prototype Ary2D: sw-calibration-access=READ-WRITE, type=Ary2D_s4p11_8_11
    Ary2D_s7p8_11_12_CalPortIf1
      parameter data prototype Ary2D: sw-calibration-access=READ-WRITE, type=Ary2D_s7p8_11_12
    Ary2D_s7p8_12_11_CalPortIf1
      parameter data prototype Ary2D: sw-calibration-access=READ-WRITE, type=Ary2D_s7p8_12_11
    Ary2D_s7p8_3_5_CalPortIf1
      parameter data prototype Ary2D: sw-calibration-access=READ-WRITE, type=Ary2D_s7p8_3_5
    Ary2D_s7p8_3_6_CalPortIf1
      parameter data prototype Ary2D: sw-calibration-access=READ-WRITE, type=Ary2D_s7p8_3_6
    Ary2D_s7p8_4_5_CalPortIf1
      parameter data prototype Ary2D: sw-calibration-access=READ-WRITE, type=Ary2D_s7p8_4_5
    Ary2D_s7p8_9_5_CalPortIf1
      parameter data prototype Ary2D: sw-calibration-access=READ-WRITE, type=Ary2D_s7p8_9_5
    Ary2D_s7p8_9_6_CalPortIf1
      parameter data prototype Ary2D: sw-calibration-access=READ-WRITE, type=Ary2D_s7p8_9_6
    Ary2D_u0p16_20_8_CalPortIf1
      parameter data prototype Ary2D: sw-calibration-access=READ-WRITE, type=Ary2D_u0p16_20_8
    Ary2D_u0p16_4_2_CalPortIf1
      parameter data prototype Ary2D: sw-calibration-access=READ-WRITE, type=Ary2D_u0p16_4_2
    Ary2D_u10p6_3_7_CalPortIf1
      parameter data prototype Ary2D: sw-calibration-access=READ-WRITE, type=Ary2D_u10p6_3_7
    Ary2D_u10p6_8_12_CalPortIf1
      parameter data prototype Ary2D: sw-calibration-access=READ-WRITE, type=Ary2D_u10p6_8_12
    Ary2D_u10p6_8_9_CalPortIf1
      parameter data prototype Ary2D: sw-calibration-access=READ-WRITE, type=Ary2D_u10p6_8_9
    Ary2D_u11p5_6_5_CalPortIf1
      parameter data prototype Ary2D: sw-calibration-access=READ-WRITE, type=Ary2D_u11p5_6_5
    Ary2D_u12p4_12_13_CalPortIf1
      parameter data prototype Ary2D: sw-calibration-access=READ-WRITE, type=Ary2D_u12p4_12_13
    Ary2D_u12p4_4_2_CalPortIf1
      parameter data prototype Ary2D: sw-calibration-access=READ-WRITE, type=Ary2D_u12p4_4_2
    Ary2D_u12p4_5_4_CalPortIf1
      parameter data prototype Ary2D: sw-calibration-access=READ-WRITE, type=Ary2D_u12p4_5_4
    Ary2D_u12p4_8_12_CalPortIf1
      parameter data prototype Ary2D: sw-calibration-access=READ-WRITE, type=Ary2D_u12p4_8_12
    Ary2D_u12p4_9_16_CalPortIf1
      parameter data prototype Ary2D: sw-calibration-access=READ-WRITE, type=Ary2D_u12p4_9_16
    Ary2D_u15p1_10_24_CalPortIf1
      parameter data prototype Ary2D: sw-calibration-access=READ-WRITE, type=Ary2D_u15p1_10_24
    Ary2D_u15p1_12_9_CalPortIf1
      parameter data prototype Ary2D: sw-calibration-access=READ-WRITE, type=Ary2D_u15p1_12_9
    Ary2D_u16_3_8_CalPortIf1
      parameter data prototype Ary2D: sw-calibration-access=READ-WRITE, type=Ary2D_u16_3_8
    Ary2D_u16_8_3_CalPortIf1
      parameter data prototype Ary2D: sw-calibration-access=READ-WRITE, type=Ary2D_u16_8_3
    Ary2D_u16p0_2_8_CalPortIf1
      parameter data prototype Ary2D: sw-calibration-access=READ-WRITE, type=Ary2D_u16p0_2_8
    Ary2D_u1p15_12_12_CalPortIf1
      parameter data prototype Ary2D: sw-calibration-access=READ-WRITE, type=Ary2D_u1p15_12_12
    Ary2D_u1p15_12_5_CalPortIf1
      parameter data prototype Ary2D: sw-calibration-access=READ-WRITE, type=Ary2D_u1p15_12_5
    Ary2D_u1p15_12_9_CalPortIf1
      parameter data prototype Ary2D: sw-calibration-access=READ-WRITE, type=Ary2D_u1p15_12_9
    Ary2D_u1p15_5_4_CalPortIf1
      parameter data prototype Ary2D: sw-calibration-access=READ-WRITE, type=Ary2D_u1p15_5_4
    Ary2D_u1p15_8_4_CalPortIf1
      parameter data prototype Ary2D: sw-calibration-access=READ-WRITE, type=Ary2D_u1p15_8_4
    Ary2D_u2p14_12_12_CalPortIf1
      parameter data prototype Ary2D: sw-calibration-access=READ-WRITE, type=Ary2D_u2p14_12_12
    Ary2D_u2p14_12_4_CalPortIf1
      parameter data prototype Ary2D: sw-calibration-access=READ-WRITE, type=Ary2D_u2p14_12_4
    Ary2D_u2p14_12_5_CalPortIf1
      parameter data prototype Ary2D: sw-calibration-access=READ-WRITE, type=Ary2D_u2p14_12_5
    Ary2D_u2p14_5_10_CalPortIf1
      parameter data prototype Ary2D: sw-calibration-access=READ-WRITE, type=Ary2D_u2p14_5_10
    Ary2D_u2p14_5_8_CalPortIf1
      parameter data prototype Ary2D: sw-calibration-access=READ-WRITE, type=Ary2D_u2p14_5_8
    Ary2D_u2p14_6_5_CalPortIf1
      parameter data prototype Ary2D: sw-calibration-access=READ-WRITE, type=Ary2D_u2p14_6_5
    Ary2D_u2p14_6_7_CalPortIf1
      parameter data prototype Ary2D: sw-calibration-access=READ-WRITE, type=Ary2D_u2p14_6_7
    Ary2D_u2p14_6_7_PortIf1
      parameter data prototype Ary2D: sw-calibration-access=READ-WRITE, type=Ary2D_u2p14_6_7
    Ary2D_u2p14_7_8_CalPortIf1
      parameter data prototype Ary2D: sw-calibration-access=READ-WRITE, type=Ary2D_u2p14_7_8
    Ary2D_u3p13_12_13_CalPortIf1
      parameter data prototype Ary2D: sw-calibration-access=READ-WRITE, type=Ary2D_u3p13_12_13
    Ary2D_u3p13_20_8_CalPortIf1
      parameter data prototype Ary2D: sw-calibration-access=READ-WRITE, type=Ary2D_u3p13_20_8
    Ary2D_u4p12_10_24_CalPortIf1
      parameter data prototype Ary2D: sw-calibration-access=READ-WRITE, type=Ary2D_u4p12_10_24
    Ary2D_u4p12_12_12_CalPortIf1
      parameter data prototype Ary2D: sw-calibration-access=READ-WRITE, type=Ary2D_u4p12_12_12
    Ary2D_u4p12_12_20_CalPortIf1
      parameter data prototype Ary2D: sw-calibration-access=READ-WRITE, type=Ary2D_u4p12_12_20
    Ary2D_u4p12_12_5_CalPortIf1
      parameter data prototype Ary2D: sw-calibration-access=READ-WRITE, type=Ary2D_u4p12_12_5
    Ary2D_u4p12_12_8_CalPortIf1
      parameter data prototype Ary2D: sw-calibration-access=READ-WRITE, type=Ary2D_u4p12_12_8
    Ary2D_u4p12_12_9_CalPortIf1
      parameter data prototype Ary2D: sw-calibration-access=READ-WRITE, type=Ary2D_u4p12_12_9
    Ary2D_u4p12_13_13_CalPortIf1
      parameter data prototype Ary2D: sw-calibration-access=READ-WRITE, type=Ary2D_u4p12_13_13
    Ary2D_u4p12_13_3_CalPortIf1
      parameter data prototype Ary2D: sw-calibration-access=READ-WRITE, type=Ary2D_u4p12_13_3
    Ary2D_u4p12_3_13_CalPortIf1
      parameter data prototype Ary2D: sw-calibration-access=READ-WRITE, type=Ary2D_u4p12_3_13
    Ary2D_u5p11_12_13_CalPortIf1
      parameter data prototype Ary2D: sw-calibration-access=READ-WRITE, type=Ary2D_u5p11_12_13
    Ary2D_u5p11_12_5_CalPortIf1
      parameter data prototype Ary2D: sw-calibration-access=READ-WRITE, type=Ary2D_u5p11_12_5
    Ary2D_u5p11_9_16_CalPortIf1
      parameter data prototype Ary2D: sw-calibration-access=READ-WRITE, type=Ary2D_u5p11_9_16
    Ary2D_u5p11_9_9_CalPortIf1
      parameter data prototype Ary2D: sw-calibration-access=READ-WRITE, type=Ary2D_u5p11_9_9
    Ary2D_u6p10_12_12_CalPortIf1
      parameter data prototype Ary2D: sw-calibration-access=READ-WRITE, type=Ary2D_u6p10_12_12
    Ary2D_u6p10_12_20_CalPortIf1
      parameter data prototype Ary2D: sw-calibration-access=READ-WRITE, type=Ary2D_u6p10_12_20
    Ary2D_u6p10_12_9_CalPortIf1
      parameter data prototype Ary2D: sw-calibration-access=READ-WRITE, type=Ary2D_u6p10_12_9
    Ary2D_u6p10_13_13_CalPortIf1
      parameter data prototype Ary2D: sw-calibration-access=READ-WRITE, type=Ary2D_u6p10_13_13
    Ary2D_u6p10_5_9_CalPortIf1
      parameter data prototype Ary2D: sw-calibration-access=READ-WRITE, type=Ary2D_u6p10_5_9
    Ary2D_u6p10_8_9_CalPortIf1
      parameter data prototype Ary2D: sw-calibration-access=READ-WRITE, type=Ary2D_u6p10_8_9
    Ary2D_u7p9_9_4_CalPortIf1
      parameter data prototype Ary2D: sw-calibration-access=READ-WRITE, type=Ary2D_u7p9_9_4
    Ary2D_u8p8_12_20_CalPortIf1
      parameter data prototype Ary2D: sw-calibration-access=READ-WRITE, type=Ary2D_u8p8_12_20
    Ary2D_u8p8_3_5_CalPortIf1
      parameter data prototype Ary2D: sw-calibration-access=READ-WRITE, type=Ary2D_u8p8_3_5
    Ary2D_u8p8_3_6_CalPortIf1
      parameter data prototype Ary2D: sw-calibration-access=READ-WRITE, type=Ary2D_u8p8_3_6
    Ary2D_u8p8_5_10_CalPortIf1
      parameter data prototype Ary2D: sw-calibration-access=READ-WRITE, type=Ary2D_u8p8_5_10
    Ary2D_u8p8_5_8_CalPortIf1
      parameter data prototype Ary2D: sw-calibration-access=READ-WRITE, type=Ary2D_u8p8_5_8
    Ary2D_u8p8_6_5_CalPortIf1
      parameter data prototype Ary2D: sw-calibration-access=READ-WRITE, type=Ary2D_u8p8_6_5
    Ary2D_u8p8_9_4_CalPortIf1
      parameter data prototype Ary2D: sw-calibration-access=READ-WRITE, type=Ary2D_u8p8_9_4
    Ary2D_u8p8_9_5_CalPortIf1
      parameter data prototype Ary2D: sw-calibration-access=READ-WRITE, type=Ary2D_u8p8_9_5
    Ary2D_u8p8_9_6_CalPortIf1
      parameter data prototype Ary2D: sw-calibration-access=READ-WRITE, type=Ary2D_u8p8_9_6
    Ary2D_u8p8_9_8_CalPortIf1
      parameter data prototype Ary2D: sw-calibration-access=READ-WRITE, type=Ary2D_u8p8_9_8
    Ary2D_u9p7_2_5_CalPortIf1
      parameter data prototype Ary2D: sw-calibration-access=READ-WRITE, type=Ary2D_u9p7_2_5
    Ary2D_u9p7_2_8_CalPortIf1
      parameter data prototype Ary2D: sw-calibration-access=READ-WRITE, type=Ary2D_u9p7_2_8
    boolean_CalPortIf1
      parameter data prototype Logl: sw-calibration-access=READ-WRITE, type=boolean
    Cnt6
      parameter data prototype Val: sw-calibration-access=READ-WRITE, type=Cnt14
    Cnt7
      parameter data prototype Val: sw-calibration-access=READ-WRITE, type=Cnt28
    Cnt8
      parameter data prototype Val: sw-calibration-access=READ-WRITE, type=Cnt29
    Curr3
      parameter data prototype Val: sw-calibration-access=READ-WRITE, type=Curr9
    CurrAry1D1
      parameter data prototype Ary1D: sw-calibration-access=READ-WRITE, type=CurrAry1D1
    CurrAry1D2
      parameter data prototype Ary1D: sw-calibration-access=READ-WRITE, type=CurrAry1D2
    CurrAry1D3
      parameter data prototype Ary1D: sw-calibration-access=READ-WRITE, type=CurrAry1D3
    FilNotchGainRec1_CalPortIf1
      parameter data prototype Rec: sw-calibration-access=READ-WRITE, type=FilNotchGainRec1
    float32_CalPortIf1
      parameter data prototype Val: sw-calibration-access=READ-WRITE, type=float32
    Frq2
      parameter data prototype Val: sw-calibration-access=READ-WRITE, type=Frq2
    Gain4
      parameter data prototype Val: sw-calibration-access=READ-WRITE, type=Gain5
    Gain5
      parameter data prototype Val: sw-calibration-access=READ-WRITE, type=Gain6
    Gain6
      parameter data prototype Val: sw-calibration-access=READ-WRITE, type=Gain7
    Indu1
      parameter data prototype Val: sw-calibration-access=READ-WRITE, type=Indu1
    Logl1
      parameter data prototype Logl: sw-calibration-access=READ-WRITE, type=Logl1
    MotCon1
      parameter data prototype Val: sw-calibration-access=READ-WRITE, type=MotCon1
    R1
      parameter data prototype Val: sw-calibration-access=READ-WRITE, type=R1
    R2
      parameter data prototype Val: sw-calibration-access=READ-WRITE, type=R6
    R3
      parameter data prototype Val: sw-calibration-access=READ-WRITE, type=R8
    Rate1
      parameter data prototype Val: sw-calibration-access=READ-WRITE, type=Rate3
    s18p13_CalPortIf1
      parameter data prototype Val: sw-calibration-access=READ-WRITE, type=s18p13
    sint16_CalPortIf1
      parameter data prototype Val: sw-calibration-access=READ-WRITE, type=sint16
    sint8_CalPortIf1
      parameter data prototype Val: sw-calibration-access=READ-WRITE, type=sint8
    T4
      parameter data prototype Val: sw-calibration-access=READ-WRITE, type=T5
    Ti9
      parameter data prototype Val: sw-calibration-access=READ-WRITE, type=Ti12
    TqAry1D1
      parameter data prototype Ary1D: sw-calibration-access=READ-WRITE, type=TqAry1D6
    u0p16_CalPortIf1
      parameter data prototype Val: sw-calibration-access=READ-WRITE, type=u0p16
    u10p6_CalPortIf1
      parameter data prototype Val: sw-calibration-access=READ-WRITE, type=u10p6
    u16p0_CalPortIf1
      parameter data prototype Val: sw-calibration-access=READ-WRITE, type=u16p0
    u2p14_CalPortIf1
      parameter data prototype Val: sw-calibration-access=READ-WRITE, type=u2p14
    u9p7_CalPortIf1
      parameter data prototype Val: sw-calibration-access=READ-WRITE, type=u9p7
    uint16_CalPortIf1
      parameter data prototype Val: sw-calibration-access=READ-WRITE, type=uint16
    uint32_CalPortIf1
      parameter data prototype Val: sw-calibration-access=READ-WRITE, type=uint32
    uint8_CalPortIf1
      parameter data prototype Val: sw-calibration-access=READ-WRITE, type=uint8
    Uls2
      parameter data prototype Val: sw-calibration-access=READ-WRITE, type=Uls7
    Uls3
      parameter data prototype Val: sw-calibration-access=READ-WRITE, type=Uls9
    Uls4
      parameter data prototype Val: sw-calibration-access=READ-WRITE, type=Uls2
    Uls6
      parameter data prototype Val: sw-calibration-access=READ-WRITE, type=Uls14
    UlsAry1D2
      parameter data prototype Ary1D: sw-calibration-access=READ-WRITE, type=UlsAry1D3
    UlsAry1D3
      parameter data prototype Ary1D: sw-calibration-access=READ-WRITE, type=UlsAry1D5
    VelAry1D3
      parameter data prototype Ary1D: sw-calibration-access=READ-WRITE, type=VelAry1D3
    VoltAry1D1
      parameter data prototype Ary1D: sw-calibration-access=READ-WRITE, type=VoltAry1D1
