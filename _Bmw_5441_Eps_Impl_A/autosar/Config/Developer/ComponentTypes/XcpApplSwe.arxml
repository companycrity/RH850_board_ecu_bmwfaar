AUTOSAR XML (schema 4-2-2)
package /ComponentTypes
  application sw component type XcpApplSwe
    behavior XcpApplSwe_InternalBehavior
      timing event TMT_Runnable: start-on-event=XcpApplSwePer1, period=0.002
      runnable XcpApplSwePer1
  swc implementation XcpApplSwe_Implementation: behavior=XcpApplSwe_InternalBehavior
    code-descriptors:
      code Default: artifact-descriptors=autosar-engineering-object={short-label=Default, category=SWSRC}
