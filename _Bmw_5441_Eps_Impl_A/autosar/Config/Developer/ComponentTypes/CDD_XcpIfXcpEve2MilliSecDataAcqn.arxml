AUTOSAR XML (schema 4-2-2)
package /ComponentTypes
  complex device driver sw component type CDD_XcpIfXcpEve2MilliSecDataAcqn
    behavior CDD_XcpIfXcpEve2MilliSecDataAcqn_InternalBehavior
      timing event TMT_CDD_XcpIfXcpEve2MilliSecDataAcqnPer1: start-on-event=CDD_XcpIfXcpEve2MilliSecDataAcqnPer1, period=0.002
      runnable CDD_XcpIfXcpEve2MilliSecDataAcqnPer1
  swc implementation CDD_XcpIfXcpEve2MilliSecDataAcqn_Implementation: behavior=CDD_XcpIfXcpEve2MilliSecDataAcqn_InternalBehavior
    code-descriptors:
      code Default: artifact-descriptors=autosar-engineering-object={short-label=Default, category=SWSRC}
