[part 1 of 2: packages /AUTOSAR_Platform/ImplementationDataTypes to /Nexteer/ComponentTypes/DataTypeMappingSets]
AUTOSAR XML (schema 4-2-2)
standard types defined: float32_DataConstr, float64_DataConstr, sint16_DataConstr, sint32_DataConstr, sint8_DataConstr, uint16_DataConstr, uint32_DataConstr, uint8_DataConstr, boolean, float32, float64, sint16, sint32, sint8, uint16, uint32, uint8, Boolean, dtRef_const_VOID, dtRef_VOID, UInt8, SINT16, UINT8
package /AUTOSAR_Platform/ImplementationDataTypes
  8 x impl type:
    ALIV_V_VEH1: category=VALUE, base-type=uint8
    CRC_V_VEH1: category=VALUE, base-type=uint8
    DVCO_VEH1: category=VALUE, base-type=uint8
    QU_V_VEH_COG1: category=VALUE, base-type=uint8
    sigGroup_V_VEH1: category=STRUCTURE, dynamic-array-size-profile=None
      7 x element, all with category=TYPE_REFERENCE:
        V_VEH_COG: range phys 0..22400 "Transp.MOST-GW-Migration, 01.09.2006: Zusammenführung der Signalklasse Geschwindigkeit_Fahrzeug_Schwerpunkt [2] mit den Parametern CarSpeedExt [1].", implementation-data-type=V_VEH_COG1
        ST_V_VEH_NSS: range raw 0..15, implementation-data-type=ImplementationDataTypes/ST_V_VEH_NSS1
        QU_V_VEH_COG: range raw 0..15, implementation-data-type=ImplementationDataTypes/QU_V_VEH_COG1
        ALIV_V_VEH: range raw 0..15, implementation-data-type=ALIV_V_VEH1
        V_VEH_dummy_39_39: range phys 0..1, implementation-data-type=V_VEH_dummy_39_391
        DVCO_VEH: range raw 0..7, implementation-data-type=DVCO_VEH1
        CRC_V_VEH: range phys 0..255 "Standartabsicherung Apllikations-CRC. Transp.MOST-GW-Migration, 01.09.2006: Zusammenführung der Signalklasse CRC_Geschwindigkeit_Fahrzeug [1] mit den Parametern ChecksumSpeedCRC [1].", implementation-data-type=CRC_V_VEH1
    ST_V_VEH_NSS1: category=VALUE, base-type=uint8
    V_VEH_COG1: category=VALUE, base-type=uint16
    V_VEH_dummy_39_391: category=VALUE, base-type=uint8
package /BMW/Boardnet/CodingDatatypes/CompuMethodsForBoardnet
  compu method ACLNY_COG: phys=raw*0.002-65 for raw 32500..32532500; unit m/s^2  # Codierung zu überarbeiten. Transp.MOST-GW-Migration, 01.09.2006: Zusammenführung der Signalklasse Querbeschleunigung_Schwerpunkt [1] mit den Parametern LateralAccelerationMassCenter [1].
  compu method ACTVN_FN_ESTP_VIRT_FTAX: 0=FunktionVirtuellerEndanschlagDeaktivieren (ACTVN_FN_ESTP_VIRT_FTAX_FunktionVirtuellerEndanschlagDeaktivieren) (BNE original name: Funktion virtueller Endanschlag deaktivieren), 1=FunktionVirtuellerEndanschlagAktivieren (ACTVN_FN_ESTP_VIRT_FTAX_FunktionVirtuellerEndanschlagAktivieren) (BNE original name: Funktion virtueller Endanschlag aktivieren), 13=Funktionsschnittstelle_ist_nicht_verfuegbar (ACTVN_FN_ESTP_VIRT_FTAX_Funktionsschnittstelle_ist_nicht_verfuegbar) (Sendefunktion in Betrieb, Werte nicht verfügbar), 14=Funktion_meldet_Fehler (ACTVN_FN_ESTP_VIRT_FTAX_Funktion_meldet_Fehler) (Sendefunktion in Betrieb, meldet Fehler), 15=Signal_unbefuellt (ACTVN_FN_ESTP_VIRT_FTAX_Signal_unbefuellt) (Sendefunktion nicht in Betrieb)
  compu method ALIV_COU_4: 0=Zaehlerstand0DotDotE (ALIV_COU_4_Zaehlerstand0DotDotE) (BNE original name: Zählerstand 0..E), 15=SignalUngueltig (ALIV_COU_4_SignalUngueltig) (BNE original name: Signal ungültig)
  compu method ALIV_COU_V: 0=Zaehlerstand0DotDotE (ALIV_COU_V_Zaehlerstand0DotDotE) (BNE original name: Zählerstand 0..E), 15=SignalUngueltig (ALIV_COU_V_SignalUngueltig) (BNE original name: Signal ungültig)  # Transp.MOST-GW-Migration, 01.09.2006: Zusammenführung der Signalklasse Alive_Zähler_Geschwindigkeit [1] mit den Parametern AliveSpeed [1].
  compu method AVL_FORC_GRD: phys=raw*0.0084-17 for raw 2023.8095238095239..483883.2199546486; unit kN
  compu method AVL_RPM_WHL: phys=raw/64-511.984375 for raw 491455..3768255
  compu method AVL_STEA_PNI_OFFS: phys=raw*0.021994-45 for raw 2046.0125488769665..188097.8947783001, 4093=Funktionsschnittstelle_ist_nicht_verfuegbar (AVL_STEA_PNI_OFFS_Funktionsschnittstelle_ist_nicht_verfuegbar) (Signal Tag - Schnittstelle ist nicht verfügbar), 4094=Funktion_meldet_Fehler (AVL_STEA_PNI_OFFS_Funktion_meldet_Fehler) (Signal Tag - Funktion meldet Fehler), 4095=Signal_unbefuellt (AVL_STEA_PNI_OFFS_Signal_unbefuellt) (Signal Tag - Signal ist unbefüllt)
  compu method COU_BS_RESP: identical
  compu method CRC_V_VEH: identical  # Standartabsicherung Apllikations-CRC. Transp.MOST-GW-Migration, 01.09.2006: Zusammenführung der Signalklasse CRC_Geschwindigkeit_Fahrzeug [1] mit den Parametern ChecksumSpeedCRC [1].
  compu method CRC8: identical  # Standartabsicherung Apllikations-CRC.
  compu method CTR_DEAC_EPS_FNS: mask 15: 0=Keine_Deaktivierung_EPS_Funktionen (CTR_DEAC_EPS_FNS_Keine_Deaktivierung_EPS_Funktionen) (Es besteht keine Anforderung zur Deaktivierung von Funktionen auf der EPS.), mask 15: 13=Funktionsschnittstelle_ist_nicht_verfuegbar (CTR_DEAC_EPS_FNS_Funktionsschnittstelle_ist_nicht_verfuegbar) (Sendefunktion in Betrieb, Werte nicht verfügbar), mask 15: 14=Funktion_meldet_Fehler (CTR_DEAC_EPS_FNS_Funktion_meldet_Fehler) (Sendefunktion in Betrieb, meldet Fehler), mask 15: 15=Signal_unbefuellt (CTR_DEAC_EPS_FNS_Signal_unbefuellt) (Wird nicht aktiv gesetzt), mask 9: 1=Deaktivierung_EPS_Funktionen_Funktionsgruppe_1 (CTR_DEAC_EPS_FNS_Deaktivierung_EPS_Funktionen_Funktionsgruppe_1) (BNE original name: Deaktivierung_EPS_Funktionen_ Funktionsgruppe_1), mask 10: 2=Deaktivierung_EPS_Funktionen_Funktionsgruppe_2 (CTR_DEAC_EPS_FNS_Deaktivierung_EPS_Funktionen_Funktionsgruppe_2) (BNE original name: Deaktivierung_EPS_Funktionen_ Funktionsgruppe_2)
  compu method CTR_ERRM_BN_U: mask 33: 0=KeineUnterspannungNormalbetrieb (CTR_ERRM_BN_U_KeineUnterspannungNormalbetrieb) (BNE original name: Keine Unterspannung Normalbetrieb), mask 33: 1=UnterspannungNormalbetrieb (CTR_ERRM_BN_U_UnterspannungNormalbetrieb) (BNE original name: Unterspannung Normalbetrieb), mask 34: 0=KeineUnterspannungMSA_Start (CTR_ERRM_BN_U_KeineUnterspannungMSA_Start) (BNE original name: Keine Unterspannung MSA-Start), mask 34: 2=UnterspannungMSA_Start (CTR_ERRM_BN_U_UnterspannungMSA_Start) (BNE original name: Unterspannung MSA-Start), mask 36: 0=KeineUeberspannung (CTR_ERRM_BN_U_KeineUeberspannung) (BNE original name: Keine Überspannung), mask 36: 4=Ueberspannung (CTR_ERRM_BN_U_Ueberspannung) (BNE original name: Überspannung), mask 63: 61=Funktionsschnittstelle_ist_nicht_verfuegbar (CTR_ERRM_BN_U_Funktionsschnittstelle_ist_nicht_verfuegbar) (Sendefunktion in Betrieb, Werte nicht verfügbar), mask 63: 62=Funktion_meldet_Fehler (CTR_ERRM_BN_U_Funktion_meldet_Fehler) (Sendefunktion in Betrieb, meldet Fehler), mask 63: 63=Signal_unbefuellt (CTR_ERRM_BN_U_Signal_unbefuellt) (Sendefunktion nicht in Betrieb)
  compu method CTR_WARN_DIR_VIB_EPS: 0=Keine_Richtung (CTR_WARN_DIR_VIB_EPS_Keine_Richtung) (Ungerichteter Impuls Diese Codierung wird auch versendet, wenn keine haptische Warnung erfolgt.), 1=Richtung_links (CTR_WARN_DIR_VIB_EPS_Richtung_links) (Impuls Richtung links), 2=Richtung_rechts (CTR_WARN_DIR_VIB_EPS_Richtung_rechts) (Impuls Richtung rechts), 3=Signal_unbefuellt (CTR_WARN_DIR_VIB_EPS_Signal_unbefuellt) (Sendefunktion nicht in Betrieb)
  compu method CTR_WARN_ILVL_VIB_EPS: 0=Intensitaetsstufe_0 (CTR_WARN_ILVL_VIB_EPS_Intensitaetsstufe_0) (Diese Codierung wird auch verwendet, wenn keine haptische Warnung erfolgt.), 1=Intensitaetsstufe_1 (CTR_WARN_ILVL_VIB_EPS_Intensitaetsstufe_1), 2=Intensitaetsstufe_2 (CTR_WARN_ILVL_VIB_EPS_Intensitaetsstufe_2), 3=Intensitaetsstufe_3 (CTR_WARN_ILVL_VIB_EPS_Intensitaetsstufe_3), 4=Intensitaetsstufe_4 (CTR_WARN_ILVL_VIB_EPS_Intensitaetsstufe_4), 5=Intensitaetsstufe_5 (CTR_WARN_ILVL_VIB_EPS_Intensitaetsstufe_5), 6=Intensitaetsstufe_6 (CTR_WARN_ILVL_VIB_EPS_Intensitaetsstufe_6), 7=Intensitaetsstufe_7 (CTR_WARN_ILVL_VIB_EPS_Intensitaetsstufe_7), 8=Intensitaetsstufe_8 (CTR_WARN_ILVL_VIB_EPS_Intensitaetsstufe_8), 9=Intensitaetsstufe_9 (CTR_WARN_ILVL_VIB_EPS_Intensitaetsstufe_9), 10=Intensitaetsstufe_10 (CTR_WARN_ILVL_VIB_EPS_Intensitaetsstufe_10), 11=Intensitaetsstufe_11 (CTR_WARN_ILVL_VIB_EPS_Intensitaetsstufe_11), 12=Intensitaetsstufe_12 (CTR_WARN_ILVL_VIB_EPS_Intensitaetsstufe_12), 13=Reserviert (CTR_WARN_ILVL_VIB_EPS_Reserviert) (Hinweis: Reserviert für funktionale Kennung Signal-Tag.), 14=Reserviert_bne_F5E488CE22EB4069AA18D5B18C674FB7_14 (CTR_WARN_ILVL_VIB_EPS_Reserviert_bne_F5E488CE22EB4069AA18D5B18C674FB7_14) (BNE original name: Reserviert), 15=Signal_unbefuellt (CTR_WARN_ILVL_VIB_EPS_Signal_unbefuellt) (Sendefunktion nicht in Betrieb)
  compu method CTR_WARN_PTRN_VIB_EPS: 0=Keine_haptische_Warnung (CTR_WARN_PTRN_VIB_EPS_Keine_haptische_Warnung), 1=Muster_1 (CTR_WARN_PTRN_VIB_EPS_Muster_1), 2=Muster_2 (CTR_WARN_PTRN_VIB_EPS_Muster_2), 3=Muster_3 (CTR_WARN_PTRN_VIB_EPS_Muster_3), 4=Muster_4 (CTR_WARN_PTRN_VIB_EPS_Muster_4), 5=Muster_5 (CTR_WARN_PTRN_VIB_EPS_Muster_5), 6=Muster_6 (CTR_WARN_PTRN_VIB_EPS_Muster_6), 7=Muster_7 (CTR_WARN_PTRN_VIB_EPS_Muster_7), 8=Muster_8 (CTR_WARN_PTRN_VIB_EPS_Muster_8), 9=Muster_9 (CTR_WARN_PTRN_VIB_EPS_Muster_9), 10=Muster_10 (CTR_WARN_PTRN_VIB_EPS_Muster_10), 13=Funktionsschnittstelle_ist_nicht_verfuegbar (CTR_WARN_PTRN_VIB_EPS_Funktionsschnittstelle_ist_nicht_verfuegbar) (Sendefunktion in Betrieb, Werte nicht verfügbar), 14=Funktion_meldet_Fehler (CTR_WARN_PTRN_VIB_EPS_Funktion_meldet_Fehler) (Sendefunktion in Betrieb, meldet Fehler), 15=Signal_unbefuellt (CTR_WARN_PTRN_VIB_EPS_Signal_unbefuellt) (Sendefunktion nicht in Betrieb)
  compu method DBG_16Bit: identical
  compu method DBG_32Bit: identical
  compu method DIAG_ST_OBD: identical
  compu method DVCO_VEH: 0=FahrzeugSteht (DVCO_VEH_FahrzeugSteht) (BNE original name: Fahrzeug steht), 1=FahrzeugFaehrtVorwaerts (DVCO_VEH_FahrzeugFaehrtVorwaerts) (BNE original name: Fahrzeug fährt vorwärts), 2=FahrzeugFaehrtRueckwaerts (DVCO_VEH_FahrzeugFaehrtRueckwaerts) (BNE original name: Fahrzeug fährt rückwärts), 3=FahrzeugFaehrt (DVCO_VEH_FahrzeugFaehrt) (BNE original name: Fahrzeug fährt), 4=FahrzeugStehtHinterachseAufRollenpruefstandErkannt (DVCO_VEH_FahrzeugStehtHinterachseAufRollenpruefstandErkannt) (BNE original name: Fahrzeug steht, Hinterachse auf Rollenprüfstand erkannt), 5=FahrzeugStehtZwei_Achs_RollenbetriebGesetzt (DVCO_VEH_FahrzeugStehtZwei_Achs_RollenbetriebGesetzt) (BNE original name: Fahrzeug steht, Zwei-Achs-Rollenbetrieb gesetzt), 6=FahrzeugStehtVorderachseAufRollenpruefstandErkannt (DVCO_VEH_FahrzeugStehtVorderachseAufRollenpruefstandErkannt) (BNE original name: Fahrzeug steht, Vorderachse auf Rollenprüfstand erkannt), 7=SignalUngueltig (DVCO_VEH_SignalUngueltig) (BNE original name: Signal ungültig)
  compu method ENERG_AVAI_ARS: phys=raw for raw 0..100, 253=Funktionsschnittstelle_ist_nicht_verfuegbar (ENERG_AVAI_ARS_Funktionsschnittstelle_ist_nicht_verfuegbar) (Sendefunktion in Betrieb, Werte nicht verfügbar), 254=Funktion_meldet_Fehler (ENERG_AVAI_ARS_Funktion_meldet_Fehler) (Nutzsignal kann nicht berechnet werden), 255=Signal_unbefuellt (ENERG_AVAI_ARS_Signal_unbefuellt) (Sendefunktion nicht in Betrieb)
  compu method FACT_DMPNG_ADDON_STMOM_FTAX: phys=raw/64 for raw 0..8192, 253=Reserviert (FACT_DMPNG_ADDON_STMOM_FTAX_Reserviert) (Hinweis: Reserviert für funktionale Kennung Signal-Tag.), 254=Reserviert_bne_5B8A124DE2884D68A663388C50F241EF_254 (FACT_DMPNG_ADDON_STMOM_FTAX_Reserviert_bne_5B8A124DE2884D68A663388C50F241EF_254) (BNE original name: Reserviert), 255=Signal_unbefuellt (FACT_DMPNG_ADDON_STMOM_FTAX_Signal_unbefuellt) (Sendefunktion nicht in Betrieb)
  compu method FACT_MO_STE_SO_DXP: phys=raw*0.02 for raw 0..12500, 253=Funktionsschnittstelle_ist_nicht_verfuegbar (FACT_MO_STE_SO_DXP_Funktionsschnittstelle_ist_nicht_verfuegbar) (Sendefunktion in Betrieb, Werte nicht verfügbar), 254=Funktion_meldet_Fehler (FACT_MO_STE_SO_DXP_Funktion_meldet_Fehler) (Sendefunktion in Betrieb, meldet Fehler), 255=Signal_unbefuellt (FACT_MO_STE_SO_DXP_Signal_unbefuellt) (Sendefunktion nicht in Betrieb)
  compu method FKTN_PRTNT: mask 2147483649: 0=KonfigurationAus (FKTN_PRTNT_KonfigurationAus) (BNE original name: Konfiguration aus), mask 2147483649: 1=KonfigurationEin (FKTN_PRTNT_KonfigurationEin) (BNE original name: Konfiguration ein), mask 2147483650: 0=EthernetInfrastrukturAus (FKTN_PRTNT_EthernetInfrastrukturAus) (BNE original name: Ethernet Infrastruktur aus), mask 2147483650: 2=EthernetInfrastrukturEin (FKTN_PRTNT_EthernetInfrastrukturEin) (BNE original name: Ethernet Infrastruktur ein), mask 2147483652: 0=Datenkommunikation_aus (FKTN_PRTNT_Datenkommunikation_aus) (Gilt ab SP2018), mask 2147483652: 4=Datenkommunikation_ein (FKTN_PRTNT_Datenkommunikation_ein) (Gilt ab SP2018), mask 2147483904: 0=KlimabetriebAus (FKTN_PRTNT_KlimabetriebAus) (BNE original name: Klimabetrieb aus), mask 2147483904: 256=KlimabetriebEin (FKTN_PRTNT_KlimabetriebEin) (BNE original name: Klimabetrieb ein), mask 2147484160: 0=EntertainmentbetriebAus (FKTN_PRTNT_EntertainmentbetriebAus) (BNE original name: Entertainmentbetrieb aus), mask 2147484160: 512=EntertainmentbetriebEin (FKTN_PRTNT_EntertainmentbetriebEin) (BNE original name: Entertainmentbetrieb ein), mask 2147484672: 0=Externe_KommunikationAus (FKTN_PRTNT_Externe_KommunikationAus) (BNE original name: Externe_Kommunikation aus), mask 2147484672: 1024=Externe_KommunikationEin (FKTN_PRTNT_Externe_KommunikationEin) (BNE original name: Externe_Kommunikation ein), mask 2147485696: 0=Entertainmentbetrieb_Fond_aus (FKTN_PRTNT_Entertainmentbetrieb_Fond_aus) (Gilt ab SP2018), mask 2147485696: 2048=Entertainmentbetrieb_Fond_ein (FKTN_PRTNT_Entertainmentbetrieb_Fond_ein) (Gilt ab SP2018), mask 2147487744: 0=Assistenz_Parken_highAus (FKTN_PRTNT_Assistenz_Parken_highAus) (BNE original name: Assistenz_Parken_high aus), mask 2147487744: 4096=Assistenz_Parken_highEin (FKTN_PRTNT_Assistenz_Parken_highEin) (BNE original name: Assistenz_Parken_high ein), mask 2147516416: 0=LadenAus (FKTN_PRTNT_LadenAus) (BNE original name: Laden aus), mask 2147516416: 32768=LadenEin (FKTN_PRTNT_LadenEin) (BNE original name: Laden ein), mask 2147549184: 0=FahrzeugInfrastrukturAus (FKTN_PRTNT_FahrzeugInfrastrukturAus) (BNE original name: Fahrzeug Infrastruktur aus), mask 2147549184: 65536=FahrzeugInfrastrukturEin (FKTN_PRTNT_FahrzeugInfrastrukturEin) (BNE original name: Fahrzeug Infrastruktur ein), mask 2148007936: 0=Licht_aus (FKTN_PRTNT_Licht_aus) (Gilt ab SP2018), mask 2148007936: 524288=Licht_ein (FKTN_PRTNT_Licht_ein) (Gilt ab SP2018), mask 2148532224: 0=TN_48V_aus (FKTN_PRTNT_TN_48V_aus), mask 2148532224: 1048576=TN_48V_ein (FKTN_PRTNT_TN_48V_ein), mask 4294967295: 4294967295=Signal_unbefuellt (FKTN_PRTNT_Signal_unbefuellt)
  compu method I_SPEC_ARS: phys=raw for raw 0..252, 253=Funktionsschnittstelle_ist_nicht_verfuegbar (I_SPEC_ARS_Funktionsschnittstelle_ist_nicht_verfuegbar) (Sendefunktion in Betrieb, Werte nicht verfügbar), 254=Funktion_meldet_Fehler (I_SPEC_ARS_Funktion_meldet_Fehler) (Nutzsignal kann nicht berechnet werden), 255=Signal_unbefuellt (I_SPEC_ARS_Signal_unbefuellt) (Sendefunktion nicht in Betrieb); unit A
  compu method ID_FN_INQY: 41216=BedienungTastenEntertainment (ID_FN_INQY_BedienungTastenEntertainment) (BNE original name: Bedienung Tasten Entertainment), 62976=SteuerungAussenspiegel (ID_FN_INQY_SteuerungAussenspiegel) (BNE original name: Steuerung Außenspiegel), 57857=SicherFahrgestellnummer (ID_FN_INQY_SicherFahrgestellnummer) (BNE original name: Sicher Fahrgestellnummer), 9730=Regensensor_Wischergeschwindigkeit (ID_FN_INQY_Regensensor_Wischergeschwindigkeit) (BNE original name: Regensensor-Wischergeschwindigkeit), 14850=StatusFunkschluessel (ID_FN_INQY_StatusFunkschluessel) (BNE original name: Status Funkschlüssel), 26370=BedienungTastgeberBedienelementFront (ID_FN_INQY_BedienungTastgeberBedienelementFront) (BNE original name: Bedienung Tastgeber Bedienelement Front), 32258=StatusVerdeckCabrio (ID_FN_INQY_StatusVerdeckCabrio) (BNE original name: Status Verdeck Cabrio), 36866=StatusSchluesselSuche (ID_FN_INQY_StatusSchluesselSuche) (BNE original name: Status Schlüssel Suche), 58882=StatusKlimaLuftverteilungFA (ID_FN_INQY_StatusKlimaLuftverteilungFA) (BNE original name: Status Klima Luftverteilung FA), 59906=StatusKlimaLuftverteilungBF (ID_FN_INQY_StatusKlimaLuftverteilungBF) (BNE original name: Status Klima Luftverteilung BF), 60418=StatusKlimaSHSlashZHZusatzwasserpumpe (ID_FN_INQY_StatusKlimaSHSlashZHZusatzwasserpumpe) (BNE original name: Status Klima SH/ZH Zusatzwasserpumpe), 60930=StatusKlimaZusatzprogramme (ID_FN_INQY_StatusKlimaZusatzprogramme) (BNE original name: Status Klima Zusatzprogramme), 61442=StatusKlimaStandfunktionen (ID_FN_INQY_StatusKlimaStandfunktionen) (BNE original name: Status Klima Standfunktionen), 63234=EinheitenBN2020 (ID_FN_INQY_EinheitenBN2020) (BNE original name: Einheiten BN2020), 63490=UhrzeitSlashDatum (ID_FN_INQY_UhrzeitSlashDatum) (BNE original name: Uhrzeit/Datum), 3843=StatusServiceCallTeleX (ID_FN_INQY_StatusServiceCallTeleX) (BNE original name: Status Service Call TeleX), 4867=StatusServiceCallTeleservice (ID_FN_INQY_StatusServiceCallTeleservice) (BNE original name: Status Service Call Teleservice), 12803=VerbrauchInformationDaten (ID_FN_INQY_VerbrauchInformationDaten) (BNE original name: Verbrauch Information Daten), 13827=AnzeigeCheckcontrol_Meldung_Rolle_ (ID_FN_INQY_AnzeigeCheckcontrol_Meldung_Rolle_) (BNE original name: Anzeige Checkcontrol-Meldung (Rolle)), 14851=StatusMonitorFront (ID_FN_INQY_StatusMonitorFront) (BNE original name: Status Monitor Front), 16643=StatusKartendaten (ID_FN_INQY_StatusKartendaten) (BNE original name: Status Kartendaten), 23555=StatusBordcomputerBN2020 (ID_FN_INQY_StatusBordcomputerBN2020) (BNE original name: Status Bordcomputer BN2020), 24579=DatenBordcomputer_Fahrtbeginn_ (ID_FN_INQY_DatenBordcomputer_Fahrtbeginn_) (BNE original name: Daten Bordcomputer (Fahrtbeginn)), 32771=Fahrgestellnummer (ID_FN_INQY_Fahrgestellnummer), 33027=ElektronischerMotoroelmessstab (ID_FN_INQY_ElektronischerMotoroelmessstab) (BNE original name: Elektronischer Motorölmessstab), 34819=Fahrzeugtyp (ID_FN_INQY_Fahrzeugtyp), 38147=CodierungPowermanagement (ID_FN_INQY_CodierungPowermanagement) (BNE original name: Codierung Powermanagement), 40451=Bedienung_Uhrzeit_Datum (ID_FN_INQY_Bedienung_Uhrzeit_Datum), 43523=Bedienung_Uhrzeit_Datum_UTC (ID_FN_INQY_Bedienung_Uhrzeit_Datum_UTC), 43779=Bedienung_Datum_Winterzeit_Sommerzeit (ID_FN_INQY_Bedienung_Datum_Winterzeit_Sommerzeit), 46595=PositionFensterheberFAT (ID_FN_INQY_PositionFensterheberFAT) (BNE original name: Position Fensterheber FAT), 46851=PositionFensterheberFATH (ID_FN_INQY_PositionFensterheberFATH) (BNE original name: Position Fensterheber FATH), 47107=PositionFensterheberBFT (ID_FN_INQY_PositionFensterheberBFT) (BNE original name: Position Fensterheber BFT), 47363=PositionFensterheberBFTH (ID_FN_INQY_PositionFensterheberBFTH) (BNE original name: Position Fensterheber BFTH), 47619=PositionSHD (ID_FN_INQY_PositionSHD) (BNE original name: Position SHD), 48131=PositionFensterheberSicherheitsfahrzeug (ID_FN_INQY_PositionFensterheberSicherheitsfahrzeug) (BNE original name: Position Fensterheber Sicherheitsfahrzeug), 48899=PositionFensterheberHeckscheibe (ID_FN_INQY_PositionFensterheberHeckscheibe) (BNE original name: Position Fensterheber Heckscheibe), 49155=KonfigurationFAS (ID_FN_INQY_KonfigurationFAS) (BNE original name: Konfiguration FAS), 49411=KonfigurationBFS (ID_FN_INQY_KonfigurationBFS) (BNE original name: Konfiguration BFS), 49667=KonfigurationFASH (ID_FN_INQY_KonfigurationFASH) (BNE original name: Konfiguration FASH), 49923=KonfigurationBFSH (ID_FN_INQY_KonfigurationBFSH) (BNE original name: Konfiguration BFSH), 53251=StatusSpurverlassenswarnsystemCKM (ID_FN_INQY_StatusSpurverlassenswarnsystemCKM) (BNE original name: Status Spurverlassenswarnsystem CKM), 54531=StatusZentralverriegelungCKM (ID_FN_INQY_StatusZentralverriegelungCKM) (BNE original name: Status Zentralverriegelung CKM), 55043=StatusDWACKM (ID_FN_INQY_StatusDWACKM) (BNE original name: Status DWA CKM), 56067=StatusMemorypositionenCKM (ID_FN_INQY_StatusMemorypositionenCKM) (BNE original name: Status Memorypositionen CKM), 56579=StatusLichtCKM (ID_FN_INQY_StatusLichtCKM) (BNE original name: Status Licht CKM), 57603=StatusALCCKM (ID_FN_INQY_StatusALCCKM) (BNE original name: Status ALC CKM), 58115=StatusHeckklappeCKM (ID_FN_INQY_StatusHeckklappeCKM) (BNE original name: Status Heckklappe CKM), 60163=GrenzwerteSchwenkLinks (ID_FN_INQY_GrenzwerteSchwenkLinks) (BNE original name: Grenzwerte Schwenk Links), 60419=GrenzwerteSchwenkRechts (ID_FN_INQY_GrenzwerteSchwenkRechts) (BNE original name: Grenzwerte Schwenk Rechts), 61699=StatusLichtErweitertCKM (ID_FN_INQY_StatusLichtErweitertCKM) (BNE original name: Status Licht Erweitert CKM), 9731=WirkungsgradInformationData (ID_FN_INQY_WirkungsgradInformationData) (BNE original name: Wirkungsgrad Information Data), 10243=RelativzeitBN2020 (ID_FN_INQY_RelativzeitBN2020) (BNE original name: Relativzeit BN2020), 3588=GPS_Datum_CAN (ID_FN_INQY_GPS_Datum_CAN), 3844=GPS_Uhrzeit_CAN (ID_FN_INQY_GPS_Uhrzeit_CAN), 6660=StatusKonfigurationKombi4 (ID_FN_INQY_StatusKonfigurationKombi4) (BNE original name: Status Konfiguration Kombi 4), 9220=StatusKonfigurationKombi (ID_FN_INQY_StatusKonfigurationKombi) (BNE original name: Status Konfiguration Kombi), 9988=KonfigurationDSC (ID_FN_INQY_KonfigurationDSC) (BNE original name: Konfiguration DSC), 11780=StatusM_Drive2 (ID_FN_INQY_StatusM_Drive2) (BNE original name: Status M-Drive 2), 13316=KonfigurationEPS (ID_FN_INQY_KonfigurationEPS) (BNE original name: Konfiguration EPS), 13572=MessungMotoroel (ID_FN_INQY_MessungMotoroel) (BNE original name: Messung Motoröl), 16132=IdentifikationsnummerSensorcluster (ID_FN_INQY_IdentifikationsnummerSensorcluster) (BNE original name: Identifikationsnummer Sensorcluster), 16642=Status_Hindernis_Tuer (ID_FN_INQY_Status_Hindernis_Tuer), 65535=Signal_unbefuellt (ID_FN_INQY_Signal_unbefuellt), 65533=Reserviert_nicht_verfuegbar (ID_FN_INQY_Reserviert_nicht_verfuegbar) (Hinweis: Reserviert für funktionale Kennung Signal-Tag "Funktionsschnittstelle_ist_nicht_verfuegbar"), 65534=Reserviert_Fehler (ID_FN_INQY_Reserviert_Fehler) (Hinweis: Reserviert für funktionale Kennung Signal-Tag "Funktion_meldet_Fehler")  # Enthält den Identifier der angefragten Nachricht. Es sind nur die Identifier erlaubt, die als anfragbare Nachrichten definiert sind.
  compu method ID_FN_RQ_STG_EFAN: 1=AFS_Anforderung (ID_FN_RQ_STG_EFAN_AFS_Anforderung) (BNE original name: AFS-Anforderung), 2=EPS_Anforderung (ID_FN_RQ_STG_EFAN_EPS_Anforderung) (BNE original name: EPS-Anforderung), 3=DSC_Anforderung (ID_FN_RQ_STG_EFAN_DSC_Anforderung) (BNE original name: DSC-Anforderung), 4=Servotronic_Anforderung (ID_FN_RQ_STG_EFAN_Servotronic_Anforderung) (BNE original name: Servotronic-Anforderung), 255=SignalUngueltig (ID_FN_RQ_STG_EFAN_SignalUngueltig) (BNE original name: Signal ungültig)  # Automatisch generiert (Migration 2004-10-30)
  compu method ID_TEMP_CPO_HET_MNG: 1=EPS_Motortemperatur (ID_TEMP_CPO_HET_MNG_EPS_Motortemperatur) (BNE original name: EPS-Motortemperatur), 13=Reserviert (ID_TEMP_CPO_HET_MNG_Reserviert) (Hinweis: Reserviert für funktionale Kennung Signal-Tag.), 14=Reserviert_bne_FCE0E84AD43C48B79F8D9B411125541C_14 (ID_TEMP_CPO_HET_MNG_Reserviert_bne_FCE0E84AD43C48B79F8D9B411125541C_14) (BNE original name: Reserviert), 15=Signal_unbefuellt (ID_TEMP_CPO_HET_MNG_Signal_unbefuellt) (Sendefunktion nicht in Betrieb)
  compu method MILE_KM: identical  # Automatisch generiert (Migration 2004-10-30) Transp.MOST-GW-Migration, 01.09.2006: Zusammenführung der Signalklasse Wegstrecke_Kilometer [1] mit den Parametern MileageKM [2].
  compu method MIN_I_SPEC_ARS: phys=raw-252 for raw 252..504, 253=Funktionsschnittstelle_ist_nicht_verfuegbar (MIN_I_SPEC_ARS_Funktionsschnittstelle_ist_nicht_verfuegbar) (Sendefunktion in Betrieb, Werte nicht verfügbar), 254=Funktion_meldet_Fehler (MIN_I_SPEC_ARS_Funktion_meldet_Fehler) (Nutzsignal kann nicht berechnet werden), 255=Signal_unbefuellt (MIN_I_SPEC_ARS_Signal_unbefuellt) (Sendefunktion nicht in Betrieb); unit A
  compu method NO_VECH_{1..7}: identical
  compu method OFFS_QUAD_PINA_EPS: phys=raw-127 for raw 127..381; unit Uls
  compu method QU_ACLNY_COG: 8=Initialisierung (QU_ACLNY_COG_Initialisierung) (Tritt während der Initialisierungsphase auf bis Ist-Wert verfügbar (Vorbefüllung). Nutzsignal wird permanent mit Nutzwert 0 befüllt.), 1=SignalwertIstGueltigUndAbgesichertUndPlausibilisiert (QU_ACLNY_COG_SignalwertIstGueltigUndAbgesichertUndPlausibilisiert) (BNE original name: Signalwert ist gültig und abgesichert und plausibilisiert), 9=SignalwertIstGueltigUndAbgesichertZustandSlashStatusTemporaer (QU_ACLNY_COG_SignalwertIstGueltigUndAbgesichertZustandSlashStatusTemporaer) (BNE original name: Signalwert ist gültig und abgesichert, Zustand/Status temporär), 2=SignalwertIstGueltig (QU_ACLNY_COG_SignalwertIstGueltig) (BNE original name: Signalwert ist gültig), 10=SignalwertIstGueltigZustandSlashStatusTemporaer (QU_ACLNY_COG_SignalwertIstGueltigZustandSlashStatusTemporaer) (BNE original name: Signalwert ist gültig, Zustand/Status temporär), 3=SignalqualitaetBzwDotUeberwachungEingeschraenkt (QU_ACLNY_COG_SignalqualitaetBzwDotUeberwachungEingeschraenkt) (BNE original name: Signalqualität bzw. Überwachung eingeschränkt), 11=SignalqualitaetBzwDotUeberwachungEingeschraenktZustandSlashStatusTemporaer (QU_ACLNY_COG_SignalqualitaetBzwDotUeberwachungEingeschraenktZustandSlashStatusTemporaer) (BNE original name: Signalqualität bzw. Überwachung eingeschränkt, Zustand/Status temporär), 4=Reserved (QU_ACLNY_COG_Reserved), 12=ErsatzwertIstImNutzsignalGesetztZustandSlashStatusTemporaer (QU_ACLNY_COG_ErsatzwertIstImNutzsignalGesetztZustandSlashStatusTemporaer) (BNE original name: Ersatzwert ist im Nutzsignal gesetzt, Zustand/Status temporär), 6=SignalwertIstUngueltig (QU_ACLNY_COG_SignalwertIstUngueltig) (BNE original name: Signalwert ist ungültig), 14=SignalwertIstUngueltigZustandSlashStatusTemporaer (QU_ACLNY_COG_SignalwertIstUngueltigZustandSlashStatusTemporaer) (BNE original name: Signalwert ist ungültig, Zustand/Status temporär), 7=Reserved_bne_18ACE6A1DACA4F44BAB0F4D6BBE8870D_7 (QU_ACLNY_COG_Reserved_bne_18ACE6A1DACA4F44BAB0F4D6BBE8870D_7) (BNE original name: Reserved), 15=SignalUngueltig (QU_ACLNY_COG_SignalUngueltig) (BNE original name: Signal ungültig)
  compu method QU_AVL_FORC_GRD: 8=Initialisierung (QU_AVL_FORC_GRD_Initialisierung) (At the startup of the TSU driver. Nutzsignal wird permanent mit 0,0016 befüllt.), 2=SignalwertIstGueltig (QU_AVL_FORC_GRD_SignalwertIstGueltig) (BNE original name: Signalwert ist gültig), 14=SignalwertIstUngueltigZustandSlashStatusTemporaer (QU_AVL_FORC_GRD_SignalwertIstUngueltigZustandSlashStatusTemporaer) (BNE original name: Signalwert ist ungültig, Zustand/Status temporär), 15=SignalUngueltig (QU_AVL_FORC_GRD_SignalUngueltig) (BNE original name: Signal ungültig)
  compu method QU_AVL_RPM_WHL: 8=Initialisierung (QU_AVL_RPM_WHL_Initialisierung) (Wird gelegt solange aufgrund des Aufstartvorgangs (und der dazu gehörenden Sensorprüfung) für den zugehörigen Raddrehzahlsensor kein Wert ermittelt werden kann. Nutzsignal wird permanent mit der Ungültigkeitskennung befüllt.), 1=SignalwertIstGueltigUndAbgesichertUndPlausibilisiert (QU_AVL_RPM_WHL_SignalwertIstGueltigUndAbgesichertUndPlausibilisiert) (BNE original name: Signalwert ist gültig und abgesichert und plausibilisiert), 9=Reserved (QU_AVL_RPM_WHL_Reserved), 2=Reserved_bne_BFE56DC998394BD9A8FED9E096CC9242_2 (QU_AVL_RPM_WHL_Reserved_bne_BFE56DC998394BD9A8FED9E096CC9242_2) (BNE original name: Reserved), 10=Reserved_bne_BFE56DC998394BD9A8FED9E096CC9242_10 (QU_AVL_RPM_WHL_Reserved_bne_BFE56DC998394BD9A8FED9E096CC9242_10) (BNE original name: Reserved), 3=Reserved_bne_BFE56DC998394BD9A8FED9E096CC9242_3 (QU_AVL_RPM_WHL_Reserved_bne_BFE56DC998394BD9A8FED9E096CC9242_3) (BNE original name: Reserved), 11=SignalqualitaetBzwDotUeberwachungEingeschraenktZustandSlashStatusTemporaer (QU_AVL_RPM_WHL_SignalqualitaetBzwDotUeberwachungEingeschraenktZustandSlashStatusTemporaer) (BNE original name: Signalqualität bzw. Überwachung eingeschränkt, Zustand/Status temporär), 4=ErsatzwertIstImNutzsignalGesetzt (QU_AVL_RPM_WHL_ErsatzwertIstImNutzsignalGesetzt) (BNE original name: Ersatzwert ist im Nutzsignal gesetzt), 12=ErsatzwertIstImNutzsignalGesetztZustandSlashStatusTemporaer (QU_AVL_RPM_WHL_ErsatzwertIstImNutzsignalGesetztZustandSlashStatusTemporaer) (BNE original name: Ersatzwert ist im Nutzsignal gesetzt Zustand / Status Temporär), 6=Wert_nicht_verfuegbar_Fehler_elektrisch (QU_AVL_RPM_WHL_Wert_nicht_verfuegbar_Fehler_elektrisch) (Im Fehlerfall wird abhängig von der Ursache entweder 0110 (Schwerpunkt: elektrische Fehler mit Reparaturbedarf) oder 1110 (Schwerpunkt: Plausibilitätsfehler ohne Reparaturbedarf) gesendet. Die Umsetzung ist produktlinienspezifisch unterschiedlich. Nutzsignal wird permanent mit der Ungültigkeitskennung befüllt.), 14=Wert_nicht_verfuegbar_Plausibilitaetsfehler (QU_AVL_RPM_WHL_Wert_nicht_verfuegbar_Plausibilitaetsfehler) (Im Fehlerfall wird abhängig von der Ursache entweder 0110 (Schwerpunkt: elektrische Fehler mit Reparaturbedarf) oder 1110 (Schwerpunkt: Plausibilitätsfehler ohne Reparaturbedarf) gesendet. Die Umsetzung ist produktlinienspezifisch unterschiedlich. Nutzsignal wird permanent mit der Ungültigkeitskennung befüllt.), 7=Reserved_bne_BFE56DC998394BD9A8FED9E096CC9242_7 (QU_AVL_RPM_WHL_Reserved_bne_BFE56DC998394BD9A8FED9E096CC9242_7) (BNE original name: Reserved), 15=SignalUngueltig (QU_AVL_RPM_WHL_SignalUngueltig) (BNE original name: Signal ungültig)
  compu method QU_AVL_STMOM_DV_ACT: 8=Initialisierung (QU_AVL_STMOM_DV_ACT_Initialisierung) (Tritt während der Initialisierungsphase auf (Vorbefüllung). Nutzsignal wird permanent mit Nutzwert 0 befüllt.), 1=SignalwertIstGueltigUndAbgesichertUndPlausibilisiert (QU_AVL_STMOM_DV_ACT_SignalwertIstGueltigUndAbgesichertUndPlausibilisiert) (BNE original name: Signalwert ist gültig und abgesichert und plausibilisiert), 14=SignalwertIstUngueltigZustandSlashStatusTemporaer (QU_AVL_STMOM_DV_ACT_SignalwertIstUngueltigZustandSlashStatusTemporaer) (BNE original name: Signalwert ist ungültig, Zustand/Status temporär), 6=SignalwertIstUngueltig (QU_AVL_STMOM_DV_ACT_SignalwertIstUngueltig) (BNE original name: Signalwert ist ungültig), 15=SignalUngueltig (QU_AVL_STMOM_DV_ACT_SignalUngueltig) (BNE original name: Signal ungültig)
  compu method QU_DGR_AISP_ENERG: 0=Degradationsstufe0 (QU_DGR_AISP_ENERG_Degradationsstufe0) (BNE original name: Degradationsstufe 0), 1=Degradationsstufe1 (QU_DGR_AISP_ENERG_Degradationsstufe1) (BNE original name: Degradationsstufe 1), 2=Degradationsstufe2 (QU_DGR_AISP_ENERG_Degradationsstufe2) (BNE original name: Degradationsstufe 2), 3=Degradationsstufe3 (QU_DGR_AISP_ENERG_Degradationsstufe3) (BNE original name: Degradationsstufe 3), 4=Degradationsstufe4 (QU_DGR_AISP_ENERG_Degradationsstufe4) (BNE original name: Degradationsstufe 4), 15=SignalUngueltig (QU_DGR_AISP_ENERG_SignalUngueltig) (BNE original name: Signal ungültig)
  compu method QU_FN_ENSU_SFY: mask 240: 144=Sichere_Energieversorgung_aktiv (QU_FN_ENSU_SFY_Sichere_Energieversorgung_aktiv) (Zustand der sicheren Energieversorgung: Die sichere Energieversorgung ist aktiv, es liegt kein Fehler oder Vorwarnung vor.), mask 240: 176=Sichere_Energieversorgung_aktiv_Vorwarnung (QU_FN_ENSU_SFY_Sichere_Energieversorgung_aktiv_Vorwarnung) (Zustand der sicheren Energieversorgung: Die sichere Energieversorgung ist aktiv, es liegt eine Vorwarnung vor. Der Zustand kann wieder in _aktiv zurückwechseln oder in _nicht_verfügbar_Fehler wechseln.), mask 240: 96=Sichere_Energieversorgung_nicht_verfuegbar_Fehler (QU_FN_ENSU_SFY_Sichere_Energieversorgung_nicht_verfuegbar_Fehler) (Zustand der sicheren Energieversorgung: Die sichere Energieversorgung ist nicht verfügbar, weil ein Fehler vorliegt.), mask 15: 0=Sichere_Energieversorgung_Klasse_0 (QU_FN_ENSU_SFY_Sichere_Energieversorgung_Klasse_0) (Zusätzlich zum Zustand die Klasse der sicheren Energieversorgung: Es ist keine spezielle Ausprägung der sicheren Energieversorgung angefordert und umgesetzt. Die Klassen sind weder pauschal disjunkt noch pauschal überschneidend oder pauschal inkludierend.), mask 15: 1=Sichere_Energieversorgung_Klasse_1 (QU_FN_ENSU_SFY_Sichere_Energieversorgung_Klasse_1) (Zusätzlich zum Zustand die Klasse der sicheren Energieversorgung: Es ist eine spezielle Ausprägung der sicheren Energieversorgung angefordert und umgesetzt. Die Klassen sind weder pauschal disjunkt noch pauschal überschneidend oder pauschal inkludierend.), mask 15: 2=Sichere_Energieversorgung_Klasse_2 (QU_FN_ENSU_SFY_Sichere_Energieversorgung_Klasse_2) (Zusätzlich zum Zustand die Klasse der sicheren Energieversorgung: Es ist eine spezielle Ausprägung der sicheren Energieversorgung angefordert und umgesetzt. Die Klassen sind weder pauschal disjunkt noch pauschal überschneidend oder pauschal inkludierend.), mask 15: 3=Sichere_Energieversorgung_Klasse_3 (QU_FN_ENSU_SFY_Sichere_Energieversorgung_Klasse_3) (Zusätzlich zum Zustand die Klasse der sicheren Energieversorgung: Es ist eine spezielle Ausprägung der sicheren Energieversorgung angefordert und umgesetzt. Die Klassen sind weder pauschal disjunkt noch pauschal überschneidend oder pauschal inkludierend.), mask 15: 4=Sichere_Energieversorgung_Klasse_4 (QU_FN_ENSU_SFY_Sichere_Energieversorgung_Klasse_4) (Zusätzlich zum Zustand die Klasse der sicheren Energieversorgung: Es ist eine spezielle Ausprägung der sicheren Energieversorgung angefordert und umgesetzt. Die Klassen sind weder pauschal disjunkt noch pauschal überschneidend oder pauschal inkludierend.), mask 15: 5=Sichere_Energieversorgung_Klasse_5 (QU_FN_ENSU_SFY_Sichere_Energieversorgung_Klasse_5) (Zusätzlich zum Zustand die Klasse der sicheren Energieversorgung: Es ist eine spezielle Ausprägung der sicheren Energieversorgung angefordert und umgesetzt. Die Klassen sind weder pauschal disjunkt noch pauschal überschneidend oder pauschal inkludierend.), mask 255: 254=Funktion_meldet_Fehler (QU_FN_ENSU_SFY_Funktion_meldet_Fehler) (Sendefunktion in Betrieb, meldet Fehler), mask 255: 255=Signal_unbefuellt (QU_FN_ENSU_SFY_Signal_unbefuellt) (Sendefunktion nicht in Betrieb)
  compu method QU_FN_EST: 128=Initialisierung (QU_FN_EST_Initialisierung) (EPS Initialisierungszustand), 160=FunktionVerfuegbar_Aktiv12VEPS (QU_FN_EST_FunktionVerfuegbar_Aktiv12VEPS) (BNE original name: Funktion verfügbar - Aktiv, 12V EPS), 164=FunktionVerfuegbar_Aktiv12VEAS (QU_FN_EST_FunktionVerfuegbar_Aktiv12VEAS) (BNE original name: Funktion verfügbar - Aktiv, 12V EAS), 168=FunktionVerfuegbar_Aktiv24VEAS (QU_FN_EST_FunktionVerfuegbar_Aktiv24VEAS) (BNE original name: Funktion verfügbar - Aktiv, 24V EAS), 162=FunktionVerfuegbar_AktivNotfallfunktionUmwelteinfluesse_Aktiv (QU_FN_EST_FunktionVerfuegbar_AktivNotfallfunktionUmwelteinfluesse_Aktiv) (BNE original name: Funktion verfügbar - Aktiv, Notfallfunktion Umwelteinflüsse - Aktiv), 49=FunktionInRueckfallebene (QU_FN_EST_FunktionInRueckfallebene) (BNE original name: Funktion in Rückfallebene), 51=FunktionInRueckfallebeneNotfallfunktionUmwelteinfluesse_Aktiv (QU_FN_EST_FunktionInRueckfallebeneNotfallfunktionUmwelteinfluesse_Aktiv) (BNE original name: Funktion in Rückfallebene, Notfallfunktion Umwelteinflüsse- Aktiv), 176=FunktionTemporaerInRueckfallebene (QU_FN_EST_FunktionTemporaerInRueckfallebene) (BNE original name: Funktion temporär in Rückfallebene), 178=FunktionTemporaerInRueckfallebeneNotfallfunktionUmwelteinfluesse_Aktiv (QU_FN_EST_FunktionTemporaerInRueckfallebeneNotfallfunktionUmwelteinfluesse_Aktiv) (BNE original name: Funktion temporär in Rückfallebene, Notfallfunktion Umwelteinflüsse- Aktiv), 96=FunktionNichtVerfuegbar_Fehler (QU_FN_EST_FunktionNichtVerfuegbar_Fehler) (BNE original name: Funktion nicht verfügbar - Fehler), 224=FunktionNichtVerfuegbar_Ausgeschaltet (QU_FN_EST_FunktionNichtVerfuegbar_Ausgeschaltet) (BNE original name: Funktion nicht verfügbar - ausgeschaltet), 255=SignalUngueltig (QU_FN_EST_SignalUngueltig) (BNE original name: Signal ungültig)
  compu method QU_FN_FDR: mask 3848: 512=FunktionVerfuegbarUndBereitNichtAktivSchlupfschwellenNormal (QU_FN_FDR_FunktionVerfuegbarUndBereitNichtAktivSchlupfschwellenNormal) (BNE original name: Funktion verfügbar und bereit, nicht aktiv, Schlupfschwellen normal), mask 3848: 520=FunktionVerfuegbarUndBereitNichtAktivSchlupfschwellenAufgeweitet (QU_FN_FDR_FunktionVerfuegbarUndBereitNichtAktivSchlupfschwellenAufgeweitet) (BNE original name: Funktion verfügbar und bereit, nicht aktiv, Schlupfschwellen aufgeweitet), mask 3848: 2560=FunktionVerfuegbarUndAktivSchlupfschwellenNormal (QU_FN_FDR_FunktionVerfuegbarUndAktivSchlupfschwellenNormal) (BNE original name: Funktion verfügbar und aktiv, Schlupfschwellen normal), mask 3848: 2568=FunktionVerfuegbarUndAktivSchlupfschwellenAufgeweitet (QU_FN_FDR_FunktionVerfuegbarUndAktivSchlupfschwellenAufgeweitet) (BNE original name: Funktion verfügbar und aktiv, Schlupfschwellen aufgeweitet), mask 3848: 768=reserviert (QU_FN_FDR_reserviert_DUPLICATE4275619181), mask 3848: 776=reserviert_bne_13C341D8A98349C2A0E5CFC9373CD7D4_776 (QU_FN_FDR_reserviert_bne_13C341D8A98349C2A0E5CFC9373CD7D4_776) (BNE original name: reserviert), mask 3856: 2576=FunktionVerfuegbarUndAktivFDRRegeleingriffVL (QU_FN_FDR_FunktionVerfuegbarUndAktivFDRRegeleingriffVL) (BNE original name: Funktion verfügbar und aktiv, FDR Regeleingriff VL), mask 3872: 2592=FunktionVerfuegbarUndAktivFDRRegeleingriffVR (QU_FN_FDR_FunktionVerfuegbarUndAktivFDRRegeleingriffVR) (BNE original name: Funktion verfügbar und aktiv, FDR Regeleingriff VR), mask 3904: 2624=FunktionVerfuegbarUndAktivFDRRegeleingriffHL (QU_FN_FDR_FunktionVerfuegbarUndAktivFDRRegeleingriffHL) (BNE original name: Funktion verfügbar und aktiv, FDR Regeleingriff HL), mask 3968: 2688=FunktionVerfuegbarUndAktivFDRRegeleingriffHR (QU_FN_FDR_FunktionVerfuegbarUndAktivFDRRegeleingriffHR) (BNE original name: Funktion verfügbar und aktiv, FDR Regeleingriff HR), mask 3840: 1536=FunktionNichtVerfuegbarColonFehler (QU_FN_FDR_FunktionNichtVerfuegbarColonFehler) (BNE original name: Funktion nicht verfügbar: Fehler), mask 3840: 3584=FunktionNichtVerfuegbarColonAusgeschaltet (QU_FN_FDR_FunktionNichtVerfuegbarColonAusgeschaltet) (BNE original name: Funktion nicht verfügbar: Ausgeschaltet), mask 3840: 2048=reserviert (QU_FN_FDR_reserviert_DUPLICATE1945092900), mask 3840: 512=reserviert_bne_13C341D8A98349C2A0E5CFC9373CD7D4_512 (QU_FN_FDR_reserviert_bne_13C341D8A98349C2A0E5CFC9373CD7D4_512) (BNE original name: reserviert), mask 4095: 4095=SignalUngueltig (QU_FN_FDR_SignalUngueltig) (BNE original name: Signal ungültig)
  compu method QU_FN_VIB_EPS: 1=Funktion_verfuegbar_nicht_aktiv (QU_FN_VIB_EPS_Funktion_verfuegbar_nicht_aktiv) (Funktion EPS-Lenkradvibration ist verfügbar, Vibration ist aber nicht aktiv.), 9=Funktion_verfuegbar_aktiv (QU_FN_VIB_EPS_Funktion_verfuegbar_aktiv) (Funktion EPS-Lenkradvibration ist verfügbar und Vibration ist aktiv), 14=Funktion_nicht_verfuegbar (QU_FN_VIB_EPS_Funktion_nicht_verfuegbar) (Funktion EPS-Lenkradvibration ist temporär nicht verfügbar Dieser Zustand stellt sich dann ein, wenn die Funktion aufgrund eines EPS-internen Fehlers oder einer Degradation vorübergehend nicht zur Verfügung gestellt werden kann.), 6=Fehler (QU_FN_VIB_EPS_Fehler) (Funktion EPS-Lenkradvibration ist dauerhaft nicht verfügbar Dieser Zustand stellt sich dann ein, wenn die Funktion aufgrund eines EPS-internen Fehlers oder einer Degradation in dem aktuellen Klemme15-Zyklus nicht mehr zur Verfügung gestellt werden kann.), 15=Signal_unbefuellt (QU_FN_VIB_EPS_Signal_unbefuellt) (Sendefunktion nicht in Betrieb)
  compu method QU_SER_STMOM_STMOM_DV_ACT: 128=SchnittstelleWirdInitialisiert (QU_SER_STMOM_STMOM_DV_ACT_SchnittstelleWirdInitialisiert) (BNE original name: Schnittstelle wird initialisiert), 32=SchnittstelleVerfuegbarSlashFunktionsbereitOhneZusatzdaempfung (QU_SER_STMOM_STMOM_DV_ACT_SchnittstelleVerfuegbarSlashFunktionsbereitOhneZusatzdaempfung) (BNE original name: Schnittstelle verfügbar / funktionsbereit ohne Zusatzdämpfung), 34=SchnittstelleVerfuegbarSlashFunktionsbereitMitZusatzdaempfung (QU_SER_STMOM_STMOM_DV_ACT_SchnittstelleVerfuegbarSlashFunktionsbereitMitZusatzdaempfung) (BNE original name: Schnittstelle verfügbar / funktionsbereit mit Zusatzdämpfung), 33=SchnittstelleAktiv_ZusatzdaempfungNichtVerfuegbar (QU_SER_STMOM_STMOM_DV_ACT_SchnittstelleAktiv_ZusatzdaempfungNichtVerfuegbar) (BNE original name: Schnittstelle aktiv - Zusatzdämpfung nicht verfügbar), 35=SchnittstelleAktiv_ZusatzdaempfungVerfuegbar (QU_SER_STMOM_STMOM_DV_ACT_SchnittstelleAktiv_ZusatzdaempfungVerfuegbar) (BNE original name: Schnittstelle aktiv - Zusatzdämpfung verfügbar), 96=ServiceNichtVerfuegbar_Fehler (QU_SER_STMOM_STMOM_DV_ACT_ServiceNichtVerfuegbar_Fehler) (BNE original name: Service nicht verfügbar - Fehler), 224=ServiceNichtVerfuegbar_Standby_PMA (QU_SER_STMOM_STMOM_DV_ACT_ServiceNichtVerfuegbar_Standby_PMA) (BNE original name: Service nicht verfügbar - Standby - PMA), 225=ServiceNichtVerfuegbar_Standby_EPSStatus (QU_SER_STMOM_STMOM_DV_ACT_ServiceNichtVerfuegbar_Standby_EPSStatus) (BNE original name: Service nicht verfügbar - Standby - EPS Status), 255=SignalUngueltig (QU_SER_STMOM_STMOM_DV_ACT_SignalUngueltig) (BNE original name: Signal ungültig)
  compu method QU_SUM_AVL_I_DRDY_SFY: 1=Wert_gueltig_abgesichert (QU_SUM_AVL_I_DRDY_SFY_Wert_gueltig_abgesichert) (Stromwert gueltig und abgesichert), 3=Wert_gueltig_eingeschraenkt (QU_SUM_AVL_I_DRDY_SFY_Wert_gueltig_eingeschraenkt) (Stromwert nicht abgesichert), 6=Wert_nicht_verfuegbar_Fehler (QU_SUM_AVL_I_DRDY_SFY_Wert_nicht_verfuegbar_Fehler) (Sendefunktion in Betrieb, Werte nicht verfügbar), 14=Wert_nicht_verfuegbar (QU_SUM_AVL_I_DRDY_SFY_Wert_nicht_verfuegbar) (Sendefunktion in Betrieb, meldet Fehler), 15=Signal_unbefuellt (QU_SUM_AVL_I_DRDY_SFY_Signal_unbefuellt) (Sendefunktion nicht in Betrieb)
  compu method QU_TAR_DMPNG_ADDON_STMOM_FTAX: 1=SollwertZusatzdaempfungNichtUmsetzen (QU_TAR_DMPNG_ADDON_STMOM_FTAX_SollwertZusatzdaempfungNichtUmsetzen) (BNE original name: Sollwert Zusatzdämpfung nicht umsetzen), 2=SollwertZusatzdaempfungUmsetzen (QU_TAR_DMPNG_ADDON_STMOM_FTAX_SollwertZusatzdaempfungUmsetzen) (BNE original name: Sollwert Zusatzdämpfung umsetzen), 15=SignalUnbefuellt (QU_TAR_DMPNG_ADDON_STMOM_FTAX_SignalUnbefuellt) (BNE original name: Signal unbefüllt)
  compu method QU_TAR_FACT_STMOM_FTAX: 2=SollwerteUmsetzen (QU_TAR_FACT_STMOM_FTAX_SollwerteUmsetzen) (BNE original name: Sollwerte umsetzen), 7=SollwerteNichtVorhanden (QU_TAR_FACT_STMOM_FTAX_SollwerteNichtVorhanden) (BNE original name: Sollwerte nicht vorhanden), 14=StandbyColonSollwerteNichtUmsetzen (QU_TAR_FACT_STMOM_FTAX_StandbyColonSollwerteNichtUmsetzen) (BNE original name: Standby: Sollwerte nicht umsetzen), 15=SignalUngueltig (QU_TAR_FACT_STMOM_FTAX_SignalUngueltig) (BNE original name: Signal ungültig)
  compu method QU_TAR_QTA_STMOM_DV: 2=SollwerteUmsetzen (QU_TAR_QTA_STMOM_DV_SollwerteUmsetzen) (BNE original name: Sollwerte umsetzen), 7=SollwerteNichtVorhanden (QU_TAR_QTA_STMOM_DV_SollwerteNichtVorhanden) (BNE original name: Sollwerte nicht vorhanden), 14=SollwerteNichtUmsetzen_Standby (QU_TAR_QTA_STMOM_DV_SollwerteNichtUmsetzen_Standby) (BNE original name: Sollwerte nicht umsetzen - Standby), 15=SignalUngueltig (QU_TAR_QTA_STMOM_DV_SignalUngueltig) (BNE original name: Signal ungültig)
  compu method QU_TAR_STMOM_DV_ACT: 2=SollwerteUmsetzen (QU_TAR_STMOM_DV_ACT_SollwerteUmsetzen) (BNE original name: Sollwerte umsetzen), 7=SollwerteNichtVorhanden (QU_TAR_STMOM_DV_ACT_SollwerteNichtVorhanden) (BNE original name: Sollwerte nicht vorhanden), 14=StandbyColonSollwerteNichtUmsetzen (QU_TAR_STMOM_DV_ACT_StandbyColonSollwerteNichtUmsetzen) (BNE original name: Standby: Sollwerte nicht umsetzen), 15=SignalUngueltig (QU_TAR_STMOM_DV_ACT_SignalUngueltig) (BNE original name: Signal ungültig)
  compu method QU_VYAW_VEH: 8=Initialisierung (QU_VYAW_VEH_Initialisierung) (Tritt während der Initialisierungsphase auf bis Ist-Wert verfügbar (Vorbefüllung). Nutzsignal wird permanent mit Nutzwert 0 befüllt.), 1=SignalwertIstGueltigUndAbgesichertUndPlausibilisiert (QU_VYAW_VEH_SignalwertIstGueltigUndAbgesichertUndPlausibilisiert) (BNE original name: Signalwert ist gültig und abgesichert und plausibilisiert), 9=SignalwertIstGueltigUndAbgesichertZustandSlashStatusTemporaer (QU_VYAW_VEH_SignalwertIstGueltigUndAbgesichertZustandSlashStatusTemporaer) (BNE original name: Signalwert ist gültig und abgesichert, Zustand/Status temporär), 2=SignalwertIstGueltig (QU_VYAW_VEH_SignalwertIstGueltig) (BNE original name: Signalwert ist gültig), 10=SignalwertIstGueltigZustandSlashStatusTemporaer (QU_VYAW_VEH_SignalwertIstGueltigZustandSlashStatusTemporaer) (BNE original name: Signalwert ist gültig, Zustand/Status temporär), 3=SignalqualitaetBzwDotUeberwachungEingeschraenkt (QU_VYAW_VEH_SignalqualitaetBzwDotUeberwachungEingeschraenkt) (BNE original name: Signalqualität bzw. Überwachung eingeschränkt), 11=SignalqualitaetBzwDotUeberwachungEingeschraenktZustandSlashStatusTemporaer (QU_VYAW_VEH_SignalqualitaetBzwDotUeberwachungEingeschraenktZustandSlashStatusTemporaer) (BNE original name: Signalqualität bzw. Überwachung eingeschränkt, Zustand/Status temporär), 4=Reserved (QU_VYAW_VEH_Reserved), 12=ErsatzwertColonAbgleichwertIstImNutzsignalGesetztZustandSlashStatusTemporaer (QU_VYAW_VEH_ErsatzwertColonAbgleichwertIstImNutzsignalGesetztZustandSlashStatusTemporaer) (BNE original name: Ersatzwert: Abgleichwert ist im Nutzsignal gesetzt, Zustand/Status temporär), 6=SignalwertIstUngueltig (QU_VYAW_VEH_SignalwertIstUngueltig) (BNE original name: Signalwert ist ungültig), 14=SignalwertIstUngueltigZustandSlashStatusTemporaer (QU_VYAW_VEH_SignalwertIstUngueltigZustandSlashStatusTemporaer) (BNE original name: Signalwert ist ungültig, Zustand/Status temporär), 7=Reserved_bne_7C322122A3AD4C1BBA9012320D4729F1_7 (QU_VYAW_VEH_Reserved_bne_7C322122A3AD4C1BBA9012320D4729F1_7) (BNE original name: Reserved), 15=SignalUngueltig (QU_VYAW_VEH_SignalUngueltig) (BNE original name: Signal ungültig)
  compu method RQ_CULI: 0=Keine_Strombegrenzung (RQ_CULI_Keine_Strombegrenzung) (Keine Strombegrenzung angefordert.), 10=Maximale_Strombegrenzung (RQ_CULI_Maximale_Strombegrenzung) (Sicherheits-Strombegrenzung angefordert.), 13=Reserviert_nicht_verfuegbar (RQ_CULI_Reserviert_nicht_verfuegbar) (Hinweis: Reserviert für funktionale Kennung Signal-Tag.), 14=Reserviert_Fehler (RQ_CULI_Reserviert_Fehler) (Hinweis: Reserviert für funktionale Kennung Signal-Tag.), 15=Signal_unbefuellt (RQ_CULI_Signal_unbefuellt) (Sendefunktion nicht in Betrieb)
  compu method RQ_CULI_EST_SFY: 0=Keine_Strombegrenzung (RQ_CULI_EST_SFY_Keine_Strombegrenzung) (Keine Strombegrenzung angefordert.), 1=Komfort_Strombegrenzung (RQ_CULI_EST_SFY_Komfort_Strombegrenzung) (Strombegrenzung über ELMa angefordert.), 10=Maximale_Strombegrenzung (RQ_CULI_EST_SFY_Maximale_Strombegrenzung) (Sicherheits-Strombegrenzung angefordert.), 13=Reserviert_nicht_verfuegbar (RQ_CULI_EST_SFY_Reserviert_nicht_verfuegbar) (Hinweis: Reserviert für funktionale Kennung Signal-Tag.), 14=Reserviert_Fehler (RQ_CULI_EST_SFY_Reserviert_Fehler) (Hinweis: Reserviert für funktionale Kennung Signal-Tag.), 15=Signal_unbefuellt (RQ_CULI_EST_SFY_Signal_unbefuellt) (Sendefunktion nicht in Betrieb)
  compu method RQ_RST_OBD_DIAG: 0=KeineAnforderungResetOBD_Diagnose (RQ_RST_OBD_DIAG_KeineAnforderungResetOBD_Diagnose) (BNE original name: Keine Anforderung Reset OBD_Diagnose), 2=AnforderungResetOBD_Diagnose (RQ_RST_OBD_DIAG_AnforderungResetOBD_Diagnose) (BNE original name: Anforderung Reset OBD_Diagnose), 3=SignalUngueltig (RQ_RST_OBD_DIAG_SignalUngueltig) (BNE original name: Signal ungültig)
  compu method RQ_STG_EFAN: 0=AUS (RQ_STG_EFAN_AUS), 1=Stufe (RQ_STG_EFAN_Stufe), 15=SignalUngueltig (RQ_STG_EFAN_SignalUngueltig) (BNE original name: Signal ungültig)  # Automatisch generiert (Migration 2004-10-30)
  compu method SECU_CHAL: identical
  compu method SSS_IDENT: 0=ZGWVIN (SSS_IDENT_ZGWVIN) (BNE original name: ZGW VIN), 255=SignalUngueltig (SSS_IDENT_SignalUngueltig) (BNE original name: Signal ungültig)
  compu method SSV_IDENT: 0=REF_BAC4CAN_VIN (SSV_IDENT_REF_BAC4CAN_VIN), 1=DME1VIN (SSV_IDENT_DME1VIN) (BNE original name: DME1 VIN), 2=DME2VIN (SSV_IDENT_DME2VIN) (BNE original name: DME2 VIN), 3=RSEVIN (SSV_IDENT_RSEVIN) (BNE original name: RSE VIN), 4=KAFASVIN (SSV_IDENT_KAFASVIN) (BNE original name: KAFAS, VIN), 5=DSC_ModulVIN (SSV_IDENT_DSC_ModulVIN) (BNE original name: DSC_Modul VIN), 6=VDPVIN (SSV_IDENT_VDPVIN) (BNE original name: VDP VIN), 7=SASVIN (SSV_IDENT_SASVIN) (BNE original name: SAS VIN), 8=NiViVIN (SSV_IDENT_NiViVIN) (BNE original name: NiVi VIN), 9=HU_VIN (SSV_IDENT_HU_VIN) (Alle HUs), 10=EPS_VIN (SSV_IDENT_EPS_VIN) (Vorhalt), 11=REF_BAC4_FR_VIN (SSV_IDENT_REF_BAC4_FR_VIN), 19=MRR_VIN (SSV_IDENT_MRR_VIN), 20=ATM2_VIN (SSV_IDENT_ATM2_VIN), 21=Kombi_VIN (SSV_IDENT_Kombi_VIN), 255=SignalUngueltig (SSV_IDENT_SignalUngueltig) (BNE original name: Signal ungültig)
  compu method ST_ANO_MSA_ENG_STOP: 0=KeinAnkuendigung (ST_ANO_MSA_ENG_STOP_KeinAnkuendigung) (BNE original name: Kein Ankündigung), 1=AnkuendigungMSA_Motorstopp (ST_ANO_MSA_ENG_STOP_AnkuendigungMSA_Motorstopp) (BNE original name: Ankündigung MSA-Motorstopp), 3=SignalUngueltig (ST_ANO_MSA_ENG_STOP_SignalUngueltig) (BNE original name: Signal ungültig)
  compu method ST_CENG_DRV: 0=MotorSteht (ST_CENG_DRV_MotorSteht) (BNE original name: Motor steht), 1=MotorStartet (ST_CENG_DRV_MotorStartet) (BNE original name: Motor startet), 2=MotorLaeuft (ST_CENG_DRV_MotorLaeuft) (BNE original name: Motor läuft), 3=MotorImAuslauf (ST_CENG_DRV_MotorImAuslauf) (BNE original name: Motor im Auslauf), 13=Funktionsschnittstelle_ist_nicht_verfuegbar (ST_CENG_DRV_Funktionsschnittstelle_ist_nicht_verfuegbar) (DME in der Initialisierung (z.B. nach Reset)), 14=Reserviert (ST_CENG_DRV_Reserviert) (Hinweis: Reserviert für funktionale Kennung Signal-Tag.), 15=Signal_unbefuellt (ST_CENG_DRV_Signal_unbefuellt) (Sendefunktion nicht in Betrieb)
  compu method ST_CULI_EST: 0=Keine_Strombegrenzung (ST_CULI_EST_Keine_Strombegrenzung) (Keine Strombegrenzung aktiv.), 1=Komfort_Strombegrenzung (ST_CULI_EST_Komfort_Strombegrenzung) (Strombegrenzung über ELMa aktiv.), 10=Maximale_Strombegrenzung (ST_CULI_EST_Maximale_Strombegrenzung) (Sicherheits-Strombegrenzung aktiv), 13=Reserviert_nicht_verfuegbar (ST_CULI_EST_Reserviert_nicht_verfuegbar) (Hinweis: Reserviert für funktionale Kennung Signal-Tag.), 14=Reserviert_Fehler (ST_CULI_EST_Reserviert_Fehler) (Hinweis: Reserviert für funktionale Kennung Signal-Tag.), 15=Signal_unbefuellt (ST_CULI_EST_Signal_unbefuellt) (Sendefunktion nicht in Betrieb)
  compu method ST_DCSW: 0=TrennelementAuf24V (ST_DCSW_TrennelementAuf24V) (BNE original name: Trennelement auf 24V), 1=TrennelementWirdAuf12VUmgeschaltetWerden (ST_DCSW_TrennelementWirdAuf12VUmgeschaltetWerden) (BNE original name: Trennelement wird auf 12V umgeschaltet werden), 2=TrennelementAuf12V (ST_DCSW_TrennelementAuf12V) (BNE original name: Trennelement auf 12V), 3=SignalUngueltig (ST_DCSW_SignalUngueltig) (BNE original name: Signal ungültig)
  compu method ST_DIAG_OBD_MUX_IMME: phys=raw for raw 4..60, 1=Cal_ID_softwareCalibrationIdentification_ (ST_DIAG_OBD_MUX_IMME_Cal_ID_softwareCalibrationIdentification_) (BNE original name: Cal-ID (software calibration identification)), 2=CVN_softwareCalibrationVerificationNumber_ (ST_DIAG_OBD_MUX_IMME_CVN_softwareCalibrationVerificationNumber_) (BNE original name: CVN (software calibration verification number)), 63=Ungueltig (ST_DIAG_OBD_MUX_IMME_Ungueltig) (BNE original name: Ungültig)
  compu method ST_DIAG_OBD_MUX_MAX: identical
  compu method ST_ENERG_SUPY: mask 255: 0=KeinSpannungseinbruch (ST_ENERG_SUPY_KeinSpannungseinbruch) (BNE original name: Kein Spannungseinbruch), mask 255: 253=Reserviert (ST_ENERG_SUPY_Reserviert) (Hinweis: Reserviert für funktionale Kennung Signal-Tag), mask 255: 254=Reserviert_bne_D985F50C03774E8D88B7B0039518781F_254 (ST_ENERG_SUPY_Reserviert_bne_D985F50C03774E8D88B7B0039518781F_254) (BNE original name: Reserviert), mask 255: 255=Signal_unbefuellt (ST_ENERG_SUPY_Signal_unbefuellt) (Sendefunktion nicht in Betrieb), mask 129: 1=StartspannungseinbruchAufVersorgungszweig1 (ST_ENERG_SUPY_StartspannungseinbruchAufVersorgungszweig1) (BNE original name: Startspannungseinbruch auf Versorgungszweig 1), mask 130: 2=StartspannungseinbruchAufVersorgungszweig2 (ST_ENERG_SUPY_StartspannungseinbruchAufVersorgungszweig2) (BNE original name: Startspannungseinbruch auf Versorgungszweig 2), mask 132: 4=Spannungsversorgung48Volt (ST_ENERG_SUPY_Spannungsversorgung48Volt) (BNE original name: Spannungsversorgung 48 Volt)
  compu method ST_LDREL_GEN: 0=KeineEntlastungsfktDotAktivSlashRuecknahme (ST_LDREL_GEN_KeineEntlastungsfktDotAktivSlashRuecknahme) (BNE original name: Keine Entlastungsfkt. Aktiv / Rücknahme), 1=iGR_High (ST_LDREL_GEN_iGR_High) (BNE original name: iGR-High), 2=SULEV_Fkt (ST_LDREL_GEN_SULEV_Fkt) (BNE original name: SULEV-Fkt), 3=EntlastungNachMotorstart (ST_LDREL_GEN_EntlastungNachMotorstart) (BNE original name: Entlastung nach Motorstart), 4=RennstartMitOderOhneAGMBatterie (ST_LDREL_GEN_RennstartMitOderOhneAGMBatterie) (BNE original name: Rennstart mit oder ohne AGM Batterie), 5=ELMOTENTLHitze (ST_LDREL_GEN_ELMOTENTLHitze) (BNE original name: ELMOTENTL Hitze), 6=ELMOTENTLKaelte (ST_LDREL_GEN_ELMOTENTLKaelte) (BNE original name: ELMOTENTL Kälte), 7=EntlastungAnfahrschwaecheWieP66P85 (ST_LDREL_GEN_EntlastungAnfahrschwaecheWieP66P85) (BNE original name: Entlastung Anfahrschwäche wie P66,P85), 8=UebertemperaturGenerator (ST_LDREL_GEN_UebertemperaturGenerator) (BNE original name: Übertemperatur Generator), 9=EntlastungAusSicherheitsgruenden (ST_LDREL_GEN_EntlastungAusSicherheitsgruenden) (BNE original name: Entlastung aus Sicherheitsgründen), 10=EntlastungBegrenzungLagerkraefte (ST_LDREL_GEN_EntlastungBegrenzungLagerkraefte) (BNE original name: Entlastung Begrenzung Lagerkräfte), 11=EntlastungAusKomfortgruenden (ST_LDREL_GEN_EntlastungAusKomfortgruenden) (BNE original name: Entlastung aus Komfortgründen), 12=EntlastungAusFunktionalenGruenden (ST_LDREL_GEN_EntlastungAusFunktionalenGruenden) (BNE original name: Entlastung aus funktionalen Gründen), 15=SignalUngueltig (ST_LDREL_GEN_SignalUngueltig) (BNE original name: Signal ungültig)
  compu method ST_MOT_DRV: 0=KeinE_MaschineVerfuegbar (ST_MOT_DRV_KeinE_MaschineVerfuegbar) (BNE original name: Kein E-Maschine verfügbar), 1=E_MaschineIstElektrischFahrbereitOderBereitsAktiv (ST_MOT_DRV_E_MaschineIstElektrischFahrbereitOderBereitsAktiv) (BNE original name: E-Maschine ist elektrisch fahrbereit oder bereits aktiv), 3=SignalUngueltig (ST_MOT_DRV_SignalUngueltig) (BNE original name: Signal ungültig)
  compu method ST_OBD_CYC: mask 9: 0=Warm_Up_ZyklusNichtAktiv (ST_OBD_CYC_Warm_Up_ZyklusNichtAktiv) (BNE original name: Warm-Up-Zyklus nicht aktiv), mask 9: 1=Warm_Up_ZyklusAktiv (ST_OBD_CYC_Warm_Up_ZyklusAktiv) (BNE original name: Warm-Up-Zyklus aktiv), mask 10: 0=Driving_ZyklusNichtAktiv (ST_OBD_CYC_Driving_ZyklusNichtAktiv) (BNE original name: Driving-Zyklus nicht aktiv), mask 10: 2=Driving_ZyklusAktiv (ST_OBD_CYC_Driving_ZyklusAktiv) (BNE original name: Driving-Zyklus aktiv), mask 44: 0=RBM_ZyklusNichtAktiv (ST_OBD_CYC_RBM_ZyklusNichtAktiv) (BNE original name: RBM-Zyklus nicht aktiv), mask 44: 4=RBM_ZyklusAktiv (ST_OBD_CYC_RBM_ZyklusAktiv) (BNE original name: RBM-Zyklus aktiv), mask 44: 32=RBM_ZyklusNichtErfuellbar (ST_OBD_CYC_RBM_ZyklusNichtErfuellbar) (BNE original name: RBM-Zyklus nicht erfüllbar), mask 24: 0=KeinPFC_Zyklus (ST_OBD_CYC_KeinPFC_Zyklus) (BNE original name: Kein PFC-Zyklus), mask 24: 16=PFC_ZyklusErfuellt (ST_OBD_CYC_PFC_ZyklusErfuellt) (BNE original name: PFC-Zyklus erfüllt), mask 63: 63=SignalUngueltig (ST_OBD_CYC_SignalUngueltig) (BNE original name: Signal ungültig)
  compu method ST_UDP: 0=KeinSpannungseinbruch (ST_UDP_KeinSpannungseinbruch) (BNE original name: Kein Spannungseinbruch), 1=StartspannungseinbruchBisMaximalSpannungsschwelle1 (ST_UDP_StartspannungseinbruchBisMaximalSpannungsschwelle1) (BNE original name: Startspannungseinbruch bis maximal Spannungsschwelle 1), 2=StartspannungseinbruchBisMaximalSpannungsschwelle2 (ST_UDP_StartspannungseinbruchBisMaximalSpannungsschwelle2) (BNE original name: Startspannungseinbruch bis maximal Spannungsschwelle 2), 13=Funktionsschnittstelle_ist_nicht_verfuegbar (ST_UDP_Funktionsschnittstelle_ist_nicht_verfuegbar) (DME in der Initialisierung (z.B. nach Reset)), 14=Reserviert (ST_UDP_Reserviert) (Hinweis: Reserviert für funktionale Kennung Signal-Tag.), 15=Signal_unbefuellt (ST_UDP_Signal_unbefuellt) (Sendefunktion nicht in Betrieb)
  compu method STU_8_BYTE: identical
  compu method STU_RESP: identical
  compu method SU_CLU_STMOM_SFE_DXP: 1=Ultrahart (SU_CLU_STMOM_SFE_DXP_Ultrahart), 2=SportlichAusgewogen (SU_CLU_STMOM_SFE_DXP_SportlichAusgewogen) (BNE original name: Sportlich ausgewogen), 3=Ausgewogen (SU_CLU_STMOM_SFE_DXP_Ausgewogen), 4=Weich (SU_CLU_STMOM_SFE_DXP_Weich), 13=Funktionsschnittstelle_ist_nicht_verfuegbar (SU_CLU_STMOM_SFE_DXP_Funktionsschnittstelle_ist_nicht_verfuegbar) (Sendefunktion in Betrieb, Werte nicht verfügbar), 14=Funktion_meldet_Fehler (SU_CLU_STMOM_SFE_DXP_Funktion_meldet_Fehler) (Sendefunktion in Betrieb, meldet Fehler), 15=Signal_unbefuellt (SU_CLU_STMOM_SFE_DXP_Signal_unbefuellt) (Sendefunktion nicht in Betrieb)
  compu method TEMP_CPO_HET_MNG: phys=raw-48 for raw 48..300, 253=Reserviert (TEMP_CPO_HET_MNG_Reserviert) (Hinweis: Reserviert für funktionale Kennung Signal-Tag.), 254=Reserviert_bne_13E59F6816364760A116813207E86FA4_254 (TEMP_CPO_HET_MNG_Reserviert_bne_13E59F6816364760A116813207E86FA4_254) (BNE original name: Reserviert), 255=Signal_unbefuellt (TEMP_CPO_HET_MNG_Signal_unbefuellt) (Sendefunktion nicht in Betrieb); unit degC
  compu method UI_32_noIniVal_noDflVal_4294967295_1_0_noEnc_hasRng: identical; unit sec  # Automatisch generiert (Migration 2004-10-30)
  compu method UI_8_noIniVal_noDflVal_255_0_50s_MI_40_noEnc_hasRng: phys=raw*0.5-40 for raw 80..580; unit degC  # Automatisch generiert (Migration 2004-10-30) Transp.MOST-GW-Migration, 01.09.2006: Zusammenführung der Signalklasse UI_8_noIniVal_noDflVal_255_0.50s_-40_noEnc_hasRng [1] mit den Parametern TemperatureExterior [2].
  compu method UINT1: identical
  compu method UINT28: identical
  compu method UN_TOT_STR_EPS: 0=Ritzelschnittstelle (UN_TOT_STR_EPS_Ritzelschnittstelle) (Die Position wird in Grad übertragen), 1=Zahnstangenhubschnittstelle (UN_TOT_STR_EPS_Zahnstangenhubschnittstelle) (Die Position wird in Millimeter übertragen (Einheit: 0.2mm)), 3=SignalUngueltig (UN_TOT_STR_EPS_SignalUngueltig) (BNE original name: Signal ungültig)
  compu method V_VEH_COG: phys=raw/64 for raw 0..1433600; unit km/h  # Transp.MOST-GW-Migration, 01.09.2006: Zusammenführung der Signalklasse Geschwindigkeit_Fahrzeug_Schwerpunkt [2] mit den Parametern CarSpeedExt [1].
  compu method VYAW_VEH: phys=raw*0.005-163.84 for raw 32768..13139568; unit °/s  # Transp.MOST-GW-Migration, 01.09.2006: Zusammenführung der Signalklasse Giergeschwindigkeit_Fahrzeug [1] mit den Parametern YawVelocityVehicle [1].
  compu method VYAW_VEH_ERR_AMP: phys=raw*0.0125 for raw 0..320000; unit °/s  # Quantisierung ist temporär
package /BMW/Boardnet/CodingDatatypes/DataConstraints
  range ACLNY_COG: phys 0..65000  # Codierung zu überarbeiten. Transp.MOST-GW-Migration, 01.09.2006: Zusammenführung der Signalklasse Querbeschleunigung_Schwerpunkt [1] mit den Parametern LateralAccelerationMassCenter [1].
  range AVL_RPM_WHL: phys 7167..58367
  range COU_BS_RESP: phys 0..16777214
  range CRC8: phys 0..255  # Standartabsicherung Apllikations-CRC.
  range DBG_16Bit: phys 0..65535
  range DBG_32Bit: phys 0..4294967295
  range DIAG_ST_OBD: phys 0..63
  range MILE_KM: phys 0..16777214  # Automatisch generiert (Migration 2004-10-30) Transp.MOST-GW-Migration, 01.09.2006: Zusammenführung der Signalklasse Wegstrecke_Kilometer [1] mit den Parametern MileageKM [2].
  range SECU_CHAL: phys 0..1099511627775
  range ST_DIAG_OBD_MUX_IMME: phys 4..60
  range ST_DIAG_OBD_MUX_MAX: phys 4..60
  range STU_8_BYTE: phys 0..18446744073709551615
  range STU_RESP: phys 0..16777215
  range TEMP_CPO_HET_MNG: phys 0..252
  range UI_32_noIniVal_noDflVal_4294967295_1_0_noEnc_hasRng: phys 0..4294967294  # Automatisch generiert (Migration 2004-10-30)
  range UI_8_noIniVal_noDflVal_255_0_50s_MI_40_noEnc_hasRng: phys 0..250  # Automatisch generiert (Migration 2004-10-30) Transp.MOST-GW-Migration, 01.09.2006: Zusammenführung der Signalklasse UI_8_noIniVal_noDflVal_255_0.50s_-40_noEnc_hasRng [1] mit den Parametern TemperatureExterior [2].
  range UINT28: phys 0..268435455
  range VYAW_VEH: phys 0..65534  # Transp.MOST-GW-Migration, 01.09.2006: Zusammenführung der Signalklasse Giergeschwindigkeit_Fahrzeug [1] mit den Parametern YawVelocityVehicle [1].
  range VYAW_VEH_ERR_AMP: phys 0..4000  # Quantisierung ist temporär
package /BMW/Boardnet/CodingDatatypes/SwBaseTypes
  base type ascii8: category=FIXED_LENGTH, base-type-size=8, base-type-encoding=ISO-8859-1, mem-alignment=8, byte-order=big-endian, native-declaration=unsigned char
package /BMW/Platform/Auth/Dcm/ImplementationDataTypes
  8 x impl type:
    Dcm_NegativeResponseCodeType: compu {0=DCM_E_POSITIVERESPONSE, 16=DCM_E_GENERALREJECT, 17=DCM_E_SERVICENOTSUPPORTED, 18=DCM_E_SUBFUNCTIONNOTSUPPORTED, 20=DCM_E_RESPONSETOOLONG, 19=DCM_E_INCORRECTMESSAGELENGTHORINVALIDFORMAT, 33=DCM_E_BUSYREPEATREQUEST, 34=DCM_E_CONDITIONSNOTCORRECT, 36=DCM_E_REQUESTSEQUENCEERROR, 37=DCM_E_NORESPONSEFROMSUBNETCOMPONENT, 38=DCM_E_FAILUREPREVENTSEXECUTIONOFREQUESTEDACTION, 49=DCM_E_REQUESTOUTOFRANGE, 51=DCM_E_SECURITYACCESSDENIED, 53=DCM_E_INVALIDKEY, 54=DCM_E_EXCEEDNUMBEROFATTEMPTS, 55=DCM_E_REQUIREDTIMEDELAYNOTEXPIRED, 112=DCM_E_UPLOADDOWNLOADNOTACCEPTED, 113=DCM_E_TRANSFERDATASUSPENDED, 114=DCM_E_GENERALPROGRAMMINGFAILURE, 115=DCM_E_WRONGBLOCKSEQUENCECOUNTER, 120=DCM_E_REQUESTCORRECTLYRECEIVEDRESPONSEPENDING, 126=DCM_E_SUBFUNCTIONNOTSUPPORTEDINACTIVESESSION, 127=DCM_E_SERVICENOTSUPPORTEDINACTIVESESSION, 129=DCM_E_RPMTOOHIGH, 130=DCM_E_RPMTOOLOW, 131=DCM_E_ENGINEISRUNNING, 132=DCM_E_ENGINEISNOTRUNNING, 133=DCM_E_ENGINERUNTIMETOOLOW, 134=DCM_E_TEMPERATURETOOHIGH, 135=DCM_E_TEMPERATURETOOLOW, 136=DCM_E_VEHICLESPEEDTOOHIGH, 137=DCM_E_VEHICLESPEEDTOOLOW, 138=DCM_E_THROTTLE_PEDALTOOHIGH, 139=DCM_E_THROTTLE_PEDALTOOLOW, 140=DCM_E_TRANSMISSIONRANGENOTINNEUTRAL, 141=DCM_E_TRANSMISSIONRANGENOTINGEAR, 143=DCM_E_BRAKESWITCH_NOTCLOSED, 144=DCM_E_SHIFTERLEVERNOTINPARK, 145=DCM_E_TORQUECONVERTERCLUTCHLOCKED, 146=DCM_E_VOLTAGETOOHIGH, 147=DCM_E_VOLTAGETOOLOW}, implementation-data-type=uint8
    Dcm_OpStatusType: compu {0=DCM_INITIAL, 1=DCM_PENDING, 2=DCM_CANCEL, 3=DCM_FORCE_RCRRP_OK}, implementation-data-type=uint8
    Dcm_SecAccDataRecCoding_ArrayType: category=ARRAY
      element AuxU8_Dcm_SecAccDataRecCoding_ArrayType: array-size=4, array-size-semantics=FIXED-SIZE, implementation-data-type=uint8
    Dcm_SecAccDataRecSwt_ArrayType: category=ARRAY
      element AuxU8_Dcm_SecAccDataRecSwt_ArrayType: array-size=4, array-size-semantics=FIXED-SIZE, implementation-data-type=uint8
    Dcm_SecKeyCoding_ArrayType: category=ARRAY
      element AuxU8_Dcm_SecKeyCoding_ArrayType: array-size=132, array-size-semantics=FIXED-SIZE, implementation-data-type=uint8
    Dcm_SecKeySwt_ArrayType: category=ARRAY
      element AuxU8_Dcm_SecKeySwt_ArrayType: array-size=132, array-size-semantics=FIXED-SIZE, implementation-data-type=uint8
    Dcm_SecSeedCoding_ArrayType: category=ARRAY
      element AuxU8_Dcm_SecSeedCoding_ArrayType: array-size=8, array-size-semantics=FIXED-SIZE, implementation-data-type=uint8
    Dcm_SecSeedSwt_ArrayType: category=ARRAY
      element AuxU8_Dcm_SecSeedSwt_ArrayType: array-size=8, array-size-semantics=FIXED-SIZE, implementation-data-type=uint8
package /BMW/Platform/Auth/Dlog/ImplementationDataTypes
  impl type Dlog_RandomSeedType: category=ARRAY
    element Dlog_RandomSeedSubType: array-size=4, array-size-semantics=FIXED-SIZE, implementation-data-type=uint32
  impl type Dlog_SgbmIdArrayType: category=ARRAY
    element SubSgbmIdType: array-size=8, array-size-semantics=FIXED-SIZE, implementation-data-type=uint8
package /BMW/Platform/Coding/DataTypeMappingSets
  data type mapping set Coding_DataTypeMappingSets
    mode-request-type-maps:
      implementation-data-type=uint8, mode-group=Coding_BusComMode
      implementation-data-type=uint8, mode-group=Coding_ConditionMode
      implementation-data-type=uint8, mode-group=Coding_DataMode
      implementation-data-type=uint8, mode-group=Coding_SessionMode
      implementation-data-type=Coding_LifeCycleRequestType, mode-group=Coding_LifeCycle
package /BMW/Platform/Coding/Dcm/ImplementationDataTypes
  8 x impl type:
    Dcm_ConfirmationStatusType: compu {0=DCM_RES_POS_OK, 1=DCM_RES_POS_NOT_OK, 2=DCM_RES_NEG_OK, 3=DCM_RES_NEG_NOT_OK}, implementation-data-type=uint8
    Dcm_Data1014ByteType: category=ARRAY, sw-calibration-access=READ-ONLY
      element Dcm_Data1014ByteTypeElement: array-size=1014, array-size-semantics=FIXED-SIZE, implementation-data-type=uint8
    Dcm_Data1024ByteType: category=ARRAY
      element Dcm_Data1024ByteTypeElement: array-size=1024, array-size-semantics=FIXED-SIZE, implementation-data-type=uint8
    Dcm_Data18ByteType: category=ARRAY, sw-calibration-access=READ-ONLY
      element Dcm_Data18ByteTypeElement: array-size=18, array-size-semantics=FIXED-SIZE, implementation-data-type=uint8
    Dcm_Data6ByteType: category=ARRAY, sw-calibration-access=READ-ONLY
      element Dcm_Data6ByteTypeElement: array-size=6, array-size-semantics=FIXED-SIZE, implementation-data-type=uint8
    Dcm_Data9ByteType: category=ARRAY, sw-calibration-access=READ-ONLY
      element Dcm_Data9ByteTypeElement: array-size=9, array-size-semantics=FIXED-SIZE, implementation-data-type=uint8
    Dcm_NegativeResponseCodeType:
      compu {143=DCM_E_BRAKESWITCH_NOTCLOSED, 33=DCM_E_BUSYREPEATREQUEST, 34=DCM_E_CONDITIONSNOTCORRECT, 132=DCM_E_ENGINEISNOTRUNNING, 131=DCM_E_ENGINEISRUNNING, 133=DCM_E_ENGINERUNTIMETOOLOW, 54=DCM_E_EXCEEDNUMBEROFATTEMPTS, 38=DCM_E_FAILUREPREVENTSEXECUTIONOFREQUESTEDACTION, 114=DCM_E_GENERALPROGRAMMINGFAILURE, 16=DCM_E_GENERALREJECT, 19=DCM_E_INCORRECTMESSAGELENGTHORINVALIDFORMAT, 53=DCM_E_INVALIDKEY, 37=DCM_E_NORESPONSEFROMSUBNETCOMPONENT, 49=DCM_E_REQUESTOUTOFRANGE, 36=DCM_E_REQUESTSEQUENCEERROR, 55=DCM_E_REQUIREDTIMEDELAYNOTEXPIRED, 20=DCM_E_RESPONSETOOLONG, 129=DCM_E_RPMTOOHIGH, 130=DCM_E_RPMTOOLOW, 51=DCM_E_SECURITYACCESSDENIED, 17=DCM_E_SERVICENOTSUPPORTED, 127=DCM_E_SERVICENOTSUPPORTEDINACTIVESESSION, 144=DCM_E_SHIFTERLEVERNOTINPARK, 18=DCM_E_SUBFUNCTIONNOTSUPPORTED, 126=DCM_E_SUBFUNCTIONNOTSUPPORTEDINACTIVESESSION, 134=DCM_E_TEMPERATURETOOHIGH, 135=DCM_E_TEMPERATURETOOLOW, 138=DCM_E_THROTTLE_PEDALTOOHIGH, 139=DCM_E_THROTTLE_PEDALTOOLOW, 145=DCM_E_TORQUECONVERTERCLUTCHLOCKED, 113=DCM_E_TRANSFERDATASUSPENDED, 141=DCM_E_TRANSMISSIONRANGENOTINGEAR, 140=DCM_E_TRANSMISSIONRANGENOTINNEUTRAL, 112=DCM_E_UPLOADDOWNLOADNOTACCEPTED, 136=DCM_E_VEHICLESPEEDTOOHIGH, 137=DCM_E_VEHICLESPEEDTOOLOW, 146=DCM_E_VOLTAGETOOHIGH, 147=DCM_E_VOLTAGETOOLOW, 115=DCM_E_WRONGBLOCKSEQUENCECOUNTER, 240..249=DCM_E_VMSCNC_0..DCM_E_VMSCNC_9, 250=DCM_E_VMSCNC_A, 251=DCM_E_VMSCNC_B, 252=DCM_E_VMSCNC_C, 253=DCM_E_VMSCNC_D, 254=DCM_E_VMSCNC_E}
      range raw 16..254
      implementation-data-type=uint8
    Dcm_OpStatusType: compu {0=DCM_INITIAL, 1=DCM_PENDING, 2=DCM_CANCEL, 3=DCM_FORCE_RCRRP_OK}, range raw 0..3, implementation-data-type=uint8
package /BMW/Platform/Coding/Dem/ImplementationDataTypes
  impl type Dem_EventStatusType: compu {0=DEM_EVENT_STATUS_PASSED, 1=DEM_EVENT_STATUS_FAILED, 2=DEM_EVENT_STATUS_PREPASSED, 3=DEM_EVENT_STATUS_PREFAILED, 4=DEM_EVENT_STATUS_FDC_THRESHOLD_REACHED}, range raw 0..4, implementation-data-type=uint8
package /BMW/Platform/Coding/Dlog/ImplementationDataTypes
  impl type Dlog_ProgIdArrayType: category=ARRAY
    element Dlog_ProgIdSubArrayType: array-size=8, array-size-semantics=FIXED-SIZE, implementation-data-type=uint8
package /BMW/Platform/Coding/ImplementationDataTypes
  impl type Coding_CafIdArrayType: category=ARRAY
    element Coding_CafIdSubarrayType: array-size=8, array-size-semantics=FIXED-SIZE, implementation-data-type=uint8
  impl type Coding_LifeCycleRequestType: compu {0=CODING_INITIALIZED, 1=CODING_RUNNING, 2=CODING_STOPPED}, implementation-data-type=uint8
package /BMW/Platform/Coding/NvM/ImplementationDataTypes
  impl type ConstVoidPtr: category=DATA_REFERENCE, sw-pointer-target-props={target-category=VALUE, base-type=dtRef_VOID, sw-impl-policy=CONST}
  impl type NvM_RequestResultType: compu {0=NVM_REQ_OK, 1=NVM_REQ_NOT_OK, 2=NVM_REQ_PENDING, 3=NVM_REQ_INTEGRITY_FAILED, 4=NVM_REQ_BLOCK_SKIPPED, 5=NVM_REQ_NV_INVALIDATED, 6=NVM_REQ_CANCELED, 7=NVM_REQ_REDUNDANCY_FAILED, 8=NVM_REQ_RESTORED_FROM_ROM}, range raw 0..8, implementation-data-type=uint8
  impl type VoidPtr: category=DATA_REFERENCE, sw-pointer-target-props={target-category=VALUE, base-type=dtRef_VOID}
package /BMW/Platform/Coding/Vin/ImplementationDataTypes
  impl type Vin_QualifierType: compu {0=VIN_QUAL_INIT, 1=VIN_QUAL_RECEIVED, 2=VIN_QUAL_EQ_INTERNAL, 4=VIN_QUAL_SECURE_PENDING, 8=VIN_QUAL_SECURE_FINISHED, 16=VIN_QUAL_SECURE_OK, 28=VIN_QUAL_SECURE_MASK, else VIN_QUAL_INIT}, implementation-data-type=uint8
  impl type Vin_VinType: category=STRUCTURE, dynamic-array-size-profile=None
    element Vin: implementation-data-type=ImplementationDataTypes/VinArrayType
    element Qualifier: implementation-data-type=ImplementationDataTypes/Vin_QualifierType
  impl type VinArrayType: category=ARRAY
    element idteVinSubArray: array-size=7, array-size-semantics=FIXED-SIZE, implementation-data-type=uint8
package /BMW/Platform/Darh/DataTypeMappingSets
  data type mapping set Darh_ModeRequestTypeMappings
    mode-request-type-maps:
      implementation-data-type=uint8, mode-group=DarhReportErrorMode
      implementation-data-type=Darh_LifeCycleRequestType, mode-group=Darh_LifeCycle
package /BMW/Platform/Darh/Dcm/DataTypeMappingSets
  data type mapping set Dcm_ModeRequestTypeMappings: mode-request-type-map{implementation-data-type=uint8, mode-group=DcmResponseOnEvent}
package /BMW/Platform/Darh/Dcm/ImplementationDataTypes
  7 x impl type:
    Darh_ActivelyReportedErrorListType: category=ARRAY
      element AuxU8_Darh_ActivelyReportedError: array-size=39, array-size-semantics=FIXED-SIZE, implementation-data-type=uint8
    Darh_ErrorQueueDataType: category=ARRAY
      element AuxU8_Darh_ErrorQueueDataType: array-size=21, array-size-semantics=FIXED-SIZE, implementation-data-type=uint8
    Darh_RoeState_ReadData_Data_ArrayType: category=ARRAY
      element AuxU8_Darh_RoeState_ReadData_Data_ArrayType: array-size=1, array-size-semantics=FIXED-SIZE, implementation-data-type=uint8
    Dcm_ConfirmationStatusType: compu {0=DCM_RES_POS_OK, 1=DCM_RES_POS_NOT_OK, 2=DCM_RES_NEG_OK, 3=DCM_RES_NEG_NOT_OK}, range raw 0..3, implementation-data-type=uint8
    Dcm_NegativeResponseCodeType:
      compu {143=DCM_E_BRAKESWITCH_NOTCLOSED, 33=DCM_E_BUSYREPEATREQUEST, 34=DCM_E_CONDITIONSNOTCORRECT, 132=DCM_E_ENGINEISNOTRUNNING, 131=DCM_E_ENGINEISRUNNING, 133=DCM_E_ENGINERUNTIMETOOLOW, 54=DCM_E_EXCEEDNUMBEROFATTEMPTS, 38=DCM_E_FAILUREPREVENTSEXECUTIONOFREQUESTEDACTION, 114=DCM_E_GENERALPROGRAMMINGFAILURE, 16=DCM_E_GENERALREJECT, 19=DCM_E_INCORRECTMESSAGELENGTHORINVALIDFORMAT, 53=DCM_E_INVALIDKEY, 37=DCM_E_NORESPONSEFROMSUBNETCOMPONENT, 49=DCM_E_REQUESTOUTOFRANGE, 36=DCM_E_REQUESTSEQUENCEERROR, 55=DCM_E_REQUIREDTIMEDELAYNOTEXPIRED, 20=DCM_E_RESPONSETOOLONG, 129=DCM_E_RPMTOOHIGH, 130=DCM_E_RPMTOOLOW, 51=DCM_E_SECURITYACCESSDENIED, 17=DCM_E_SERVICENOTSUPPORTED, 127=DCM_E_SERVICENOTSUPPORTEDINACTIVESESSION, 144=DCM_E_SHIFTERLEVERNOTINPARK, 18=DCM_E_SUBFUNCTIONNOTSUPPORTED, 126=DCM_E_SUBFUNCTIONNOTSUPPORTEDINACTIVESESSION, 134=DCM_E_TEMPERATURETOOHIGH, 135=DCM_E_TEMPERATURETOOLOW, 138=DCM_E_THROTTLE_PEDALTOOHIGH, 139=DCM_E_THROTTLE_PEDALTOOLOW, 145=DCM_E_TORQUECONVERTERCLUTCHLOCKED, 113=DCM_E_TRANSFERDATASUSPENDED, 141=DCM_E_TRANSMISSIONRANGENOTINGEAR, 140=DCM_E_TRANSMISSIONRANGENOTINNEUTRAL, 112=DCM_E_UPLOADDOWNLOADNOTACCEPTED, 136=DCM_E_VEHICLESPEEDTOOHIGH, 137=DCM_E_VEHICLESPEEDTOOLOW, 146=DCM_E_VOLTAGETOOHIGH, 147=DCM_E_VOLTAGETOOLOW, 115=DCM_E_WRONGBLOCKSEQUENCECOUNTER, 240..249=DCM_E_VMSCNC_0..DCM_E_VMSCNC_9, 250=DCM_E_VMSCNC_A, 251=DCM_E_VMSCNC_B, 252=DCM_E_VMSCNC_C, 253=DCM_E_VMSCNC_D, 254=DCM_E_VMSCNC_E}
      range raw 16..254
      implementation-data-type=uint8
    Dcm_OpStatusType: compu {0=DCM_INITIAL, 1=DCM_PENDING, 2=DCM_CANCEL, 3=DCM_FORCE_RCRRP_OK}, range raw 0..3, implementation-data-type=uint8
    Dcm_RequestData_ArrayType: category=ARRAY
      element AuxU8_Dcm_RequestData_ArrayType: array-size=1024, array-size-semantics=FIXED-SIZE, implementation-data-type=uint8
package /BMW/Platform/Darh/Dem/ImplementationDataTypes
  4 x impl type:
    Dem_DTCFormatType: compu {0=DEM_DTC_FORMAT_OBD, 1=DEM_DTC_FORMAT_UDS, 2=DEM_DTC_FORMAT_J1939}, range raw 0..2, implementation-data-type=uint8
    Dem_EventIdType: range raw 1..72, implementation-data-type=uint16
    Dem_EventStatusType: compu {0=DEM_EVENT_STATUS_PASSED, 1=DEM_EVENT_STATUS_FAILED, 2=DEM_EVENT_STATUS_PREPASSED, 3=DEM_EVENT_STATUS_PREFAILED, 4=DEM_EVENT_STATUS_FDC_THRESHOLD_REACHED}, range raw 0..4, implementation-data-type=uint8
    Dem_MaxDataValueType: category=ARRAY
      element Dem_MaxDataValueElement: array-size=4, array-size-semantics=FIXED-SIZE, implementation-data-type=uint8
package /BMW/Platform/Darh/ImplementationDataTypes
  4 x impl type, all with category=TYPE_REFERENCE, implementation-data-type=uint8:
    Darh_DcmIndicationType: compu {0=DARH_DCM_NOINDICATION, 1=DARH_DCM_ACTIVATED, 2=DARH_DCM_STOPPED}
    Darh_LifeCycleRequestType: compu {0=DARH_INITIALIZED, 1=DARH_RUNNING, 2=DARH_STOPPED}
    Darh_RoeStateType: compu {0=DARH_ROE_STOPPED, 1=DARH_ROE_STARTED, 2=DARH_ROE_UNKNOWN}
    Darh_SuspendedStateType: compu {0=DARH_NOT_SUSPENDED, 1=DARH_SUSPENDED}
package /BMW/Platform/Darh/NvM/ImplementationDataTypes
  impl type ErrorQueueType: category=STRUCTURE, dynamic-array-size-profile=None
    element queue: category=ARRAY
      element Darh_QueueElementType: category=STRUCTURE, array-size=5, array-size-semantics=FIXED-SIZE
        element timestamp: implementation-data-type=uint32
        element EventId: implementation-data-type=uint32
    element first: implementation-data-type=uint16
    element size: implementation-data-type=uint16
  impl type NvM_RequestResultType: compu {0=NVM_REQ_OK, 1=NVM_REQ_NOT_OK, 2=NVM_REQ_PENDING, 3=NVM_REQ_INTEGRITY_FAILED, 4=NVM_REQ_BLOCK_SKIPPED, 5=NVM_REQ_NV_INVALIDATED, 6=NVM_REQ_CANCELED, 7=NVM_REQ_REDUNDANCY_FAILED, 8=NVM_REQ_RESTORED_FROM_ROM}, range raw 0..8, implementation-data-type=uint8
  impl type NvM_SrcPtrType: category=DATA_REFERENCE, sw-pointer-target-props={target-category=VALUE, base-type=dtRef_VOID, sw-impl-policy=CONST}
package /BMW/Platform/Darh/Tp/ImplementationDataTypes
  impl type Darh_TransmissionArrayType: category=STRUCTURE, dynamic-array-size-profile=VSA_LINEAR
    element size: implementation-data-type=uint16
    element payload: category=ARRAY
      element payloadArray: array-size=23, array-size-handling=ALL-INDICES-SAME-ARRAY-SIZE, array-size-semantics=VARIABLE-SIZE, implementation-data-type=uint8
package /BMW/Platform/Dlog/Coding/PortInterfaces
  impl type Coding_CafIdArrayType: category=ARRAY
    element Coding_CafIdSubarrayType: array-size=8, array-size-semantics=FIXED-SIZE, implementation-data-type=uint8
package /BMW/Platform/Dlog/CompuMethods
  compu method CM_DlogHistoryType: 0=DLOG_HISTORY_SYSTEMSUPPLIER, 1=DLOG_HISTORY_PLANT, else DLOG_HISTORY_SYSTEMSUPPLIER
package /BMW/Platform/Dlog/DataTypeMappingSets
  data type mapping set DlogTypeMappings: mode-request-type-map{implementation-data-type=Dlog_LifeCycleRequestType, mode-group=Dlog_LifeCycle}
package /BMW/Platform/Dlog/Dcm/ImplementationDataTypes
  17 x impl type:
    Dcm_NegativeResponseCodeType: compu {16=DCM_E_GENERALREJECT, 19=DCM_E_INCORRECTMESSAGELENGTHORINVALIDFORMAT, 33=DCM_E_BUSYREPEATREQUEST, 34=DCM_E_CONDITIONSNOTCORRECT, 36=DCM_E_REQUESTSEQUENCEERROR, 49=DCM_E_REQUESTOUTOFRANGE, 51=DCM_E_SECURITYACCESSDENIED, 114=DCM_E_GENERALPROGRAMMINGFAILURE, 126=DCM_E_SUBFUNCTIONNOTSUPPORTEDINACTIVESESSION, 129=DCM_E_RPMTOOHIGH, 130=DCM_E_RPMTOOLOW, 131=DCM_E_ENGINEISRUNNING, 132=DCM_E_ENGINEISNOTRUNNING, 133=DCM_E_ENGINERUNTIMETOOLOW, 134=DCM_E_TEMPERATURETOOHIGH, 135=DCM_E_TEMPERATURETOOLOW, 136=DCM_E_VEHICLESPEEDTOOHIGH, 137=DCM_E_VEHICLESPEEDTOOLOW, 138=DCM_E_THROTTLE_PEDALTOOHIGH, 139=DCM_E_THROTTLE_PEDALTOOLOW, 140=DCM_E_TRANSMISSIONRANGENOTINNEUTRAL, 141=DCM_E_TRANSMISSIONRANGENOTINGEAR, 143=DCM_E_BRAKESWITCH_NOTCLOSED, 144=DCM_E_SHIFTERLEVERNOTINPARK, 145=DCM_E_TORQUECONVERTERCLUTCHLOCKED, 146=DCM_E_VOLTAGETOOHIGH, 147=DCM_E_VOLTAGETOOLOW}, implementation-data-type=uint8
    Dcm_OpStatusType: compu {0=DCM_INITIAL, 1=DCM_PENDING, 2=DCM_CANCEL, 3=DCM_FORCE_RCRRP_OK}, implementation-data-type=uint8
    DevInfoArrayType: category=ARRAY
      element SubDevInfoArrayType: array-size=11, array-size-semantics=FIXED-SIZE, implementation-data-type=uint8
    Dlog_EcuUidArrayType: category=ARRAY
      element Dlog_EcuUidSubArrayType: array-size=16, array-size-semantics=FIXED-SIZE, implementation-data-type=uint8
    Dlog_HWModificationIndexArrayType: category=ARRAY
      element Dlog_HWModificationIndexSubArrayType: array-size=2, array-size-semantics=FIXED-SIZE, implementation-data-type=uint8
    Dlog_SwfkDeleteSupportedArrayType: category=ARRAY
      element Dlog_SwfkDeleteSupportedSubArrayType: array-size=1, array-size-semantics=FIXED-SIZE, implementation-data-type=uint8
    Dlog_VinArrayType: category=ARRAY
      element SubVinArrayType: array-size=17, array-size-semantics=FIXED-SIZE, implementation-data-type=uint8
    ManufacturingDataArrayType: category=ARRAY
      element SubManufacturingDataArrayType: array-size=3, array-size-semantics=FIXED-SIZE, implementation-data-type=uint8
    ProgCounterArrayType: category=ARRAY
      element SubProgCounterArrayType: array-size=4, array-size-semantics=FIXED-SIZE, implementation-data-type=uint8
    ProgCounterMaxArrayType: category=ARRAY
      element SubProgCounterMaxArrayType: array-size=2, array-size-semantics=FIXED-SIZE, implementation-data-type=uint8
    RSInputArrayType: category=ARRAY
      element SubRSInputArrayType: array-size=8, array-size-semantics=FIXED-SIZE, implementation-data-type=uint8
    RSOutputArrayType: category=ARRAY
      element SubRSOutputArrayType: array-size=8, array-size-semantics=FIXED-SIZE, implementation-data-type=uint8
    SerialNumberArrayType: category=ARRAY
      element SubSerialNumberArrayType: array-size=10, array-size-semantics=FIXED-SIZE, implementation-data-type=uint8
    SgbdIdArrayType: category=ARRAY
      element SubSgbdIdArrayType: array-size=3, array-size-semantics=FIXED-SIZE, implementation-data-type=uint8
    SvkDataArrayType: category=ARRAY
      element SubSvkDataArrayType: array-size=100, array-size-semantics=FIXED-SIZE, implementation-data-type=uint8
    SvkHistoryDataArrayType: category=ARRAY
      element SubSvkHistoryDataArrayType: array-size=48, array-size-semantics=FIXED-SIZE, implementation-data-type=uint8
    TimingParametersArrayType: category=ARRAY
      element SubTimingParametersArrayType: array-size=12, array-size-semantics=FIXED-SIZE, implementation-data-type=uint8
package /BMW/Platform/Dlog/ImplementationDataTypes
  6 x impl type:
    Coding_SgbmIdType: category=ARRAY
      element SubSgbmIdType: array-size=8, array-size-semantics=FIXED-SIZE, implementation-data-type=uint8
    Dlog_LifeCycleRequestType: compu {0=DLOG_INITIALIZED, 1=DLOG_RUNNING, 2=DLOG_STOPPED}, implementation-data-type=uint8
    Dlog_ProgIdArrayType: category=ARRAY
      element Dlog_ProgIdSubArrayType: array-size=8, array-size-semantics=FIXED-SIZE, implementation-data-type=uint8
    Dlog_RandomSeedType: category=ARRAY
      element Dlog_RandomSeedSubType: array-size=4, array-size-semantics=FIXED-SIZE, implementation-data-type=uint32
    Dlog_SgbmIdArrayType: category=ARRAY
      element SubSgbmIdType: array-size=8, array-size-semantics=FIXED-SIZE, implementation-data-type=uint8
    Dlog_SignatureArrayType: category=ARRAY
      element SubSignatureArrayType: array-size=260, array-size-semantics=FIXED-SIZE, implementation-data-type=uint8
package /BMW/Platform/Dlog/NvM/ImplementationDataTypes
  impl type NvM_DstPtrType: category=DATA_REFERENCE, sw-pointer-target-props={target-category=VALUE, base-type=dtRef_VOID}
  impl type NvM_RequestResultType: compu {0=NVM_REQ_OK, 1=NVM_REQ_NOT_OK, 2=NVM_REQ_PENDING, 3=NVM_REQ_INTEGRITY_FAILED, 4=NVM_REQ_BLOCK_SKIPPED, 5=NVM_REQ_NV_INVALIDATED, 6=NVM_REQ_CANCELED, 7=NVM_REQ_REDUNDANCY_FAILED, 8=NVM_REQ_RESTORED_FROM_ROM}, implementation-data-type=uint8
  impl type NvM_SrcPtrType: category=DATA_REFERENCE, sw-pointer-target-props={target-category=VALUE, base-type=dtRef_VOID, sw-impl-policy=CONST}
package /BMW/Platform/Omc/DataTypeMappingSets
  data type mapping set Omc_DataTypeMappingSets
    mode-request-type-maps:
      implementation-data-type=ImplementationDataTypes/Omc_ExtendedOperatingModeType, mode-group=OmcExtendedOperatingMode
      implementation-data-type=Omc_LifeCycleRequestType, mode-group=Omc_LifeCycle
      implementation-data-type=ImplementationDataTypes/Omc_OperatingModeType, mode-group=OmcOperatingMode
package /BMW/Platform/Omc/Dcm/CompuMethods
  compu method CM_NegativeResponseType: 16=DCM_E_GENERALREJECT, 33=DCM_E_BUSYREPEATREQUEST, 34=DCM_E_CONDITIONSNOTCORRECT, 36=DCM_E_REQUESTSEQUENCEERROR, 49=DCM_E_REQUESTOUTOFRANGE, 51=DCM_E_SECURITYACCESSDENIED, 114=DCM_E_GENERALPROGRAMMINGFAILURE, 126=DCM_E_SUBFUNCTIONNOTSUPPORTEDINACTIVESESSION, 129=DCM_E_RPMTOOHIGH, 130=DCM_E_RPMTOOLOW, 131=DCM_E_ENGINEISRUNNING, 132=DCM_E_ENGINEISNOTRUNNING, 133=DCM_E_ENGINERUNTIMETOOLOW, 134=DCM_E_TEMPERATURETOOHIGH, 135=DCM_E_TEMPERATURETOOLOW, 136=DCM_E_VEHICLESPEEDTOOHIGH, 137=DCM_E_VEHICLESPEEDTOOLOW, 138=DCM_E_THROTTLE_PEDALTOOHIGH, 139=DCM_E_THROTTLE_PEDALTOOLOW, 140=DCM_E_TRANSMISSIONRANGENOTINNEUTRAL, 141=DCM_E_TRANSMISSIONRANGENOTINGEAR, 143=DCM_E_BRAKESWITCH_NOTCLOSED, 144=DCM_E_SHIFTERLEVERNOTINPARK, 145=DCM_E_TORQUECONVERTERCLUTCHLOCKED, 146=DCM_E_VOLTAGETOOHIGH, 147=DCM_E_VOLTAGETOOLOW
package /BMW/Platform/Omc/Dcm/ImplementationDataTypes
  4 x impl type:
    Dcm_NegativeResponseCodeType: compu-method=CM_NegativeResponseType, implementation-data-type=uint8
    NegativeResponseCodeType: compu-method=CM_NegativeResponseType, implementation-data-type=uint8
    OpStatusType: compu {0=DCM_INITIAL, 1=DCM_PENDING, 2=DCM_CANCEL, 3=DCM_FORCE_RCRRP_OK}, implementation-data-type=uint8
    UInt8_Array1: category=ARRAY
      element data: array-size=1, array-size-semantics=FIXED-SIZE, implementation-data-type=uint8
package /BMW/Platform/Omc/Dem/ImplementationDataTypes
  impl type Dem_EventStatusType: compu {0=DEM_EVENT_STATUS_PASSED, 1=DEM_EVENT_STATUS_FAILED, 2=DEM_EVENT_STATUS_PREPASSED, 3=DEM_EVENT_STATUS_PREFAILED, 4=DEM_EVENT_STATUS_FDC_THRESHOLD_REACHED}, implementation-data-type=uint8
package /BMW/Platform/Omc/ImplementationDataTypes
  impl type Omc_ExtendedOperatingModeType: compu {0=OMC_MODE_EXTENSION_NORMAL, 1..14=OMC_MODE_EXTENSION_1..OMC_MODE_EXTENSION_14, 15=OMC_MODE_EXTENSION_SAVE_ENERGY, 255=OMC_MODE_EXTENSION_INVALID}, implementation-data-type=uint8
  impl type Omc_LifeCycleRequestType: compu {0=OMC_INITIALIZED, 1=OMC_RUNNING, 2=OMC_STOPPED}, implementation-data-type=uint8
  impl type Omc_OperatingModeType: compu {0=OMC_MODE_NORMAL, 1=OMC_MODE_ASSEMBLY, 2=OMC_MODE_TRANSPORT, 3=OMC_MODE_BMW_FLASH}, implementation-data-type=uint8
package /BMW/Platform/Omc/NvM/ImplementationDataTypes
  impl type DstPtrType: category=DATA_REFERENCE, sw-pointer-target-props={target-category=VALUE, base-type=dtRef_VOID}
  impl type RequestResultType: compu {0=NVM_REQ_OK, 1=NVM_REQ_NOT_OK, 2=NVM_REQ_PENDING, 3=NVM_REQ_INTEGRITY_FAILED, 4=NVM_REQ_BLOCK_SKIPPED, 5=NVM_REQ_NV_INVALIDATED, 6=NVM_REQ_CANCELED, 7=NVM_REQ_REDUNDANCY_FAILED, 8=NVM_REQ_RESTORED_FROM_ROM}, implementation-data-type=uint8
  impl type SrcPtrType: category=DATA_REFERENCE, sw-pointer-target-props={target-category=VALUE, base-type=dtRef_VOID, sw-impl-policy=CONST}
package /BMW/Platform/StdDiag/Coding/DataTypeMappingSets
  data type mapping set Coding_DataTypeMappingSets: mode-request-type-map{implementation-data-type=Coding_ConditionModeType, mode-group=Coding_ConditionMode}
package /BMW/Platform/StdDiag/Coding/ImplementationDataTypes
  impl type Coding_ConditionModeType: compu {0=CODING_ALLOWED, 1=CODING_NOT_ALLOWED}, implementation-data-type=uint8
package /BMW/Platform/StdDiag/Darh/ImplementationDataTypes
  impl type Darh_RoeStateType: compu {0=DARH_ROE_STOPPED, 1=DARH_ROE_STARTED, 2=DARH_ROE_UNKNOWN}, implementation-data-type=uint8
package /BMW/Platform/StdDiag/DataTypeMappingSets
  data type mapping set StdDiag_DataTypeMappingSet
    mode-request-type-maps:
      implementation-data-type=uint8, mode-group=StdDiag_SessionModeGroup
      implementation-data-type=NormalCommunicationModeType, mode-group=StdDiag_NormalCommunicationModeGroup
      implementation-data-type=StdDiag_LifeCycleRequestType, mode-group=StdDiag_LifeCycle
package /BMW/Platform/StdDiag/Dcm/ImplementationDataTypes
  12 x impl type:
    ActiveDiagSession_ArrayType: category=ARRAY
      element data: array-size=1, array-size-semantics=FIXED-SIZE, implementation-data-type=uint8
    ActiveSessionState_ArrayType: category=ARRAY
      element data: array-size=4, array-size-semantics=FIXED-SIZE, implementation-data-type=uint8
    CheckProgrammingPreconditions_ArrayType: category=ARRAY
      element data: array-size=256, array-size-semantics=FIXED-SIZE, implementation-data-type=uint8
    Dcm_ConfirmationStatusType: compu {0=DCM_RES_POS_OK, 1=DCM_RES_POS_NOT_OK, 2=DCM_RES_NEG_OK, 3=DCM_RES_NEG_NOT_OK}, range raw 0..3, implementation-data-type=uint8
    Dcm_NegativeResponseCodeType:
      compu {143=DCM_E_BRAKESWITCH_NOTCLOSED, 33=DCM_E_BUSYREPEATREQUEST, 34=DCM_E_CONDITIONSNOTCORRECT, 132=DCM_E_ENGINEISNOTRUNNING, 131=DCM_E_ENGINEISRUNNING, 133=DCM_E_ENGINERUNTIMETOOLOW, 54=DCM_E_EXCEEDNUMBEROFATTEMPTS, 38=DCM_E_FAILUREPREVENTSEXECUTIONOFREQUESTEDACTION, 114=DCM_E_GENERALPROGRAMMINGFAILURE, 16=DCM_E_GENERALREJECT, 19=DCM_E_INCORRECTMESSAGELENGTHORINVALIDFORMAT, 53=DCM_E_INVALIDKEY, 37=DCM_E_NORESPONSEFROMSUBNETCOMPONENT, 49=DCM_E_REQUESTOUTOFRANGE, 36=DCM_E_REQUESTSEQUENCEERROR, 55=DCM_E_REQUIREDTIMEDELAYNOTEXPIRED, 20=DCM_E_RESPONSETOOLONG, 129=DCM_E_RPMTOOHIGH, 130=DCM_E_RPMTOOLOW, 51=DCM_E_SECURITYACCESSDENIED, 17=DCM_E_SERVICENOTSUPPORTED, 127=DCM_E_SERVICENOTSUPPORTEDINACTIVESESSION, 144=DCM_E_SHIFTERLEVERNOTINPARK, 18=DCM_E_SUBFUNCTIONNOTSUPPORTED, 126=DCM_E_SUBFUNCTIONNOTSUPPORTEDINACTIVESESSION, 134=DCM_E_TEMPERATURETOOHIGH, 135=DCM_E_TEMPERATURETOOLOW, 138=DCM_E_THROTTLE_PEDALTOOHIGH, 139=DCM_E_THROTTLE_PEDALTOOLOW, 145=DCM_E_TORQUECONVERTERCLUTCHLOCKED, 113=DCM_E_TRANSFERDATASUSPENDED, 141=DCM_E_TRANSMISSIONRANGENOTINGEAR, 140=DCM_E_TRANSMISSIONRANGENOTINNEUTRAL, 112=DCM_E_UPLOADDOWNLOADNOTACCEPTED, 136=DCM_E_VEHICLESPEEDTOOHIGH, 137=DCM_E_VEHICLESPEEDTOOLOW, 146=DCM_E_VOLTAGETOOHIGH, 147=DCM_E_VOLTAGETOOLOW, 115=DCM_E_WRONGBLOCKSEQUENCECOUNTER, 240..249=DCM_E_VMSCNC_0..DCM_E_VMSCNC_9, 250=DCM_E_VMSCNC_A, 251=DCM_E_VMSCNC_B, 252=DCM_E_VMSCNC_C, 253=DCM_E_VMSCNC_D, 254=DCM_E_VMSCNC_E}
      range raw 16..254
      implementation-data-type=uint8
    Dcm_OpStatusType: compu {0=DCM_INITIAL, 1=DCM_PENDING, 2=DCM_CANCEL, 3=DCM_FORCE_RCRRP_OK}, range raw 0..3, implementation-data-type=uint8
    Dcm_SecLevelType: compu {0=DCM_SEC_LEV_LOCKED, 1=DcmDspSecurityRow_Coding}, range raw 0..1, implementation-data-type=uint8
    Dcm_SesCtrlType: compu {1=DCM_DEFAULT_SESSION, 2=DCM_PROGRAMMING_SESSION, 3=DCM_EXTENDED_DIAGNOSTIC_SESSION, 4=DCM_SAFETY_SYSTEM_DIAGNOSTIC_SESSION, 65=DCM_CODING_SESSION, 66=DCM_SWT_SESSION}, range raw 1..66, implementation-data-type=uint8
    DiagCommLoopback_ArrayType: category=ARRAY
      element data: array-size=1024, array-size-semantics=FIXED-SIZE, implementation-data-type=uint8
    RequestDataArray: category=ARRAY
      element RequestDataArray: array-size=1024, array-size-semantics=FIXED-SIZE, implementation-data-type=uint8
    SgbdIndex_ArrayType: category=ARRAY
      element data: array-size=3, array-size-semantics=FIXED-SIZE, implementation-data-type=uint8
    UpDownloadPrePostProcessing_ArrayType: category=ARRAY
      element data: array-size=273, array-size-semantics=FIXED-SIZE, implementation-data-type=uint8
package /BMW/Platform/StdDiag/Dem/ImplementationDataTypes
  impl type Dem_DTCFormatType: compu {0=DEM_DTC_FORMAT_OBD, 1=DEM_DTC_FORMAT_UDS, 2=DEM_DTC_FORMAT_J1939}, range raw 0..2, implementation-data-type=uint8
  impl type Dem_DTCOriginType: compu {1=DEM_DTC_ORIGIN_PRIMARY_MEMORY, 2=DEM_DTC_ORIGIN_MIRROR_MEMORY, 3=DEM_DTC_ORIGIN_PERMANENT_MEMORY, 4=DEM_DTC_ORIGIN_USERDEFINED_MEMORY_BMWSecondaryErrorMemory}, range raw 1..4, implementation-data-type=uint8
package /BMW/Platform/StdDiag/ImplementationDataTypes
  4 x impl type:
    AdtApplicationParameter_ArrayType: category=ARRAY
      element data: array-size=255, array-size-semantics=FIXED-SIZE, implementation-data-type=uint8
    NormalCommunicationModeType: compu {0=DISABLE_RX_AND_TX_NORMAL, 1=DISABLE_RX_ENABLE_TX_NORMAL, 2=ENABLE_RX_AND_TX_NORMAL, 3=ENABLE_RX_DISABLE_TX_NORMAL}, implementation-data-type=uint8
    StdDiag_LifeCycleRequestType: compu {0=STDDIAG_INITIALIZED, 1=STDDIAG_RUNNING, 2=STDDIAG_STOPPED}, implementation-data-type=uint8
    UpDownload_ArrayType: category=ARRAY
      element data: array-size=4096, array-size-semantics=FIXED-SIZE, implementation-data-type=uint8
package /BMW/Platform/StdDiag/Omc/DataTypeMappingSets
  data type mapping set Omc_DataTypeMappingSets
    mode-request-type-maps:
      implementation-data-type=ImplementationDataTypes/Omc_ExtendedOperatingModeType, mode-group=OmcExtendedOperatingMode
      implementation-data-type=ImplementationDataTypes/Omc_OperatingModeType, mode-group=OmcOperatingMode
package /BMW/Platform/StdDiag/Omc/ImplementationDataTypes
  impl type Omc_ExtendedOperatingModeType: compu {0=OMC_MODE_EXTENSION_NORMAL, 1..14=OMC_MODE_EXTENSION_1..OMC_MODE_EXTENSION_14, 15=OMC_MODE_EXTENSION_SAVE_ENERGY, 255=OMC_MODE_EXTENSION_INVALID}, implementation-data-type=uint8
  impl type Omc_OperatingModeType: compu {0=OMC_MODE_NORMAL, 1=OMC_MODE_ASSEMBLY, 2=OMC_MODE_TRANSPORT, 3=OMC_MODE_BMW_FLASH}, implementation-data-type=uint8
package /BMW/Platform/StdDiag/Stm/DataTypeMappingSets
  data type mapping set Stm_VehicleStatModeRequestTypeMap: mode-request-type-map{implementation-data-type=ImplementationDataTypes/Stm_VehicleStateType, mode-group=Stm_VehicleStateMode}
package /BMW/Platform/StdDiag/Stm/ImplementationDataTypes
  impl type Stm_VehicleStateType: compu {1=STM_VEHICLE_STATE_PARKING_BN_NOK, 2=STM_VEHICLE_STATE_PARKING_BN_OK, 3=STM_VEHICLE_STATE_CUSTOMER_ABSENT, 5=STM_VEHICLE_STATE_LIVING, 7=STM_VEHICLE_STATE_CHECK_ANALYS_DIAGNOSTICS, 8=STM_VEHICLE_STATE_READINESS_TO_DRIVE_INIT, 10=STM_VEHICLE_STATE_DRIVE, 12=STM_VEHICLE_STATE_READINESS_TO_DRIVE_STOP, 14=STM_VEHICLE_STATE_UNAVAILABLE, 15=STM_VEHICLE_STATE_INVALID}, implementation-data-type=uint8
package /BMW/Platform/Stm/DataTypeMappingSets
  5 x data type mapping set:
    Stm_CentralErrorLockModeRequestTypeMap: mode-request-type-map{implementation-data-type=Stm_CentralErrorLockType, mode-group=Stm_CentralErrorLockMode}
    Stm_EMLS_Mapping: mode-request-type-map{implementation-data-type=uint8, mode-group=ErrorMemoryLockSignalReceptionMode}
    Stm_EnergyStateModeRequestTypeMap: mode-request-type-map{implementation-data-type=Stm_EnergyStateType, mode-group=Stm_EnergyStateMode}
    Stm_VehicleStatModeRequestTypeMap: mode-request-type-map{implementation-data-type=ImplementationDataTypes/Stm_VehicleStateType, mode-group=Stm_VehicleStateMode}
    Stm_VehicleStatSP2015ModeRequestTypeMap: mode-request-type-map{implementation-data-type=Stm_VehicleStateSP2015Type, mode-group=Stm_VehicleStateSP2015Mode}
package /BMW/Platform/Stm/ImplementationDataTypes
  4 x impl type, all with category=TYPE_REFERENCE, implementation-data-type=uint8:
    Stm_CentralErrorLockType: compu {0=STM_CEL_UNLOCKED, 1=STM_CEL_LOCKED, 3=STM_CEL_INVALID}
    Stm_EnergyStateType: compu {0=STM_ENERGY_GOOD, 1=STM_ENERGY_OK, 2=STM_ENERGY_SHORTAGE, 3=STM_ENERGY_SEVERE_SHORTAGE, 15=STM_ENERGY_INVALID}
    Stm_VehicleStateSP2015Type: compu {1=STM_VEHICLE_STATE_SP2015_PARKING_BN_NOK, 2=STM_VEHICLE_STATE_SP2015_PARKING_BN_OK, 3=STM_VEHICLE_STATE_SP2015_CUSTOMER_ABSENT, 5=STM_VEHICLE_STATE_SP2015_LIVING, 7=STM_VEHICLE_STATE_SP2015_CHECK_ANALYS_DIAGNOSTICS, 8=STM_VEHICLE_STATE_SP2015_READINESS_TO_DRIVE_INIT, 10=STM_VEHICLE_STATE_SP2015_DRIVE, 12=STM_VEHICLE_STATE_SP2015_READINESS_TO_DRIVE_STOP, 14=STM_VEHICLE_STATE_SP2015_UNAVAILABLE, 15=STM_VEHICLE_STATE_SP2015_INVALID}
    Stm_VehicleStateType: compu {1=STM_VEHICLE_STATE_PARKING_BN_NOK, 2=STM_VEHICLE_STATE_PARKING_BN_OK, 3=STM_VEHICLE_STATE_CUSTOMER_ABSENT, 5=STM_VEHICLE_STATE_LIVING, 7=STM_VEHICLE_STATE_CHECK_ANALYS_DIAGNOSTICS, 8=STM_VEHICLE_STATE_READINESS_TO_DRIVE_INIT, 10=STM_VEHICLE_STATE_DRIVE, 12=STM_VEHICLE_STATE_READINESS_TO_DRIVE_STOP, 14=STM_VEHICLE_STATE_UNAVAILABLE, 15=STM_VEHICLE_STATE_INVALID}
package /BMW/Platform/SysTime/DataTypeMappingSets
  data type mapping set DataTMappingSet1: mode-request-type-map{implementation-data-type=SysTime_LifeCycleRequestType, mode-group=SysTime_LifeCycle}
package /BMW/Platform/SysTime/Dcm/ImplementationDataTypes
  impl type Array4: category=ARRAY
    element data: array-size=4, array-size-semantics=FIXED-SIZE, implementation-data-type=uint8
package /BMW/Platform/SysTime/ImplementationDataTypes
  impl type SysTime_LifeCycleRequestType: compu {0=SYSTIME_INITIALIZED, 1=SYSTIME_RUNNING, 2=SYSTIME_STOPPED}, implementation-data-type=uint8
package /BMW/Platform/Vin/DataTypeMappingSets
  data type mapping set dtms_VinLifeCycleMode
    mode-request-type-maps:
      implementation-data-type=uint8, mode-group=Vin_ChangeIndicator
      implementation-data-type=uint8, mode-group=Vin_VinComMode
      implementation-data-type=Vin_LifeCycleRequestType, mode-group=Vin_LifeCycle
package /BMW/Platform/Vin/Dem/ImplementationDataTypes
  impl type Dem_EventStatusType: compu {0=DEM_EVENT_STATUS_PASSED, 1=DEM_EVENT_STATUS_FAILED, 2=DEM_EVENT_STATUS_PREPASSED, 3=DEM_EVENT_STATUS_PREFAILED}, range raw 0..3, implementation-data-type=uint8
package /BMW/Platform/Vin/Dlog/ImplementationDataTypes
  impl type Dlog_VinArrayType: category=ARRAY
    element SubVinArrayType: array-size=17, array-size-semantics=FIXED-SIZE, implementation-data-type=uint8
package /BMW/Platform/Vin/ImplementationDataTypes
  5 x impl type:
    Vin_ComVinType: category=STRUCTURE, dynamic-array-size-profile=None
      7 x element, all with category=TYPE_REFERENCE, implementation-data-type=uint8:
        Vin{1..7}
    Vin_LifeCycleRequestType: compu {0=VIN_INITIALIZED, 1=VIN_RUNNING, 2=VIN_STOPPED, else VIN_STOPPED}, implementation-data-type=uint8
    Vin_QualifierType: compu {0=VIN_QUAL_INIT, 1=VIN_QUAL_RECEIVED, 2=VIN_QUAL_EQ_INTERNAL, 4=VIN_QUAL_SECURE_PENDING, 8=VIN_QUAL_SECURE_FINISHED, 16=VIN_QUAL_SECURE_OK, 28=VIN_QUAL_SECURE_MASK, else VIN_QUAL_INIT}, implementation-data-type=uint8
    Vin_VinType: category=STRUCTURE, dynamic-array-size-profile=None
      element Vin: implementation-data-type=ImplementationDataTypes/VinArrayType
      element Qualifier: implementation-data-type=ImplementationDataTypes/Vin_QualifierType
    VinArrayType: category=ARRAY
      element idteVinSubArray: array-size=7, array-size-semantics=FIXED-SIZE, implementation-data-type=uint8
package /BMW/Platform/Vin/NvM/ImplementationDataTypes
  impl type NvM_DstPtrType: category=DATA_REFERENCE, sw-pointer-target-props={target-category=VALUE, base-type=dtRef_VOID}
  impl type NvM_RequestResultType: compu {0=NVM_REQ_OK, 1=NVM_REQ_NOT_OK, 2=NVM_REQ_PENDING, 3=NVM_REQ_INTEGRITY_FAILED, 4=NVM_REQ_BLOCK_SKIPPED, 5=NVM_REQ_NV_INVALIDATED, 6=NVM_REQ_CANCELED, 7=NVM_REQ_REDUNDANCY_FAILED, 8=NVM_REQ_RESTORED_FROM_ROM}, implementation-data-type=uint8
  impl type NvM_SrcPtrType: category=DATA_REFERENCE, sw-pointer-target-props={target-category=VALUE, base-type=dtRef_VOID, sw-impl-policy=CONST}
package /BMW/SystemDescription/Units
  13 x unit, all with factor-si-to-unit=1, offset-si-to-unit=0:
    ampere: display-name=A
    degree_celsius: display-name=°C
    degree_per_second: display-name=°/s
    kilometer: display-name=km
    kilometer_per_hour: display-name=km/h
    kilonewton: display-name=kN
    kilowatt: display-name=kW
    meter_per_second_squared: display-name=m/s²
    newton_meter: display-name=Nm
    no_unit
    percent: display-name=%
    radian_per_second: display-name=rad/s
    second: display-name=s
package /BMW/Units
  5 x unit, all with offset-si-to-unit=0:
    ampere: display-name=A, factor-si-to-unit=1
    degree_per_second: display-name=°/s, factor-si-to-unit=3.1415926535897931
    kilometer_per_hour: display-name=km/h, factor-si-to-unit=1000
    kilonewton: display-name=kN, factor-si-to-unit=1000
    kilowatt: display-name=kW, factor-si-to-unit=1000
package /DataDictionary/ComponentTypes/DataTypeMappingSets
  data type mapping set Cals
    data-type-maps:
      application-data-type=AssiPahSumHysCmpLimDataType, implementation-data-type=float32
      application-data-type=AssiSumLimNtc0x0C4FailStepDataType, implementation-data-type=uint16
      application-data-type=AssiSumLimNtc0x0C4PassStepDataType, implementation-data-type=uint16
      application-data-type=AssiSumLimPullCmpLimDataType, implementation-data-type=float32
      application-data-type=BattVltgCorrlnAllwdVltgDifDataType, implementation-data-type=float32
      application-data-type=BattVltgCorrlnNtc0x03C0x0440x04CFailStepDataType, implementation-data-type=uint16
      application-data-type=BattVltgCorrlnNtc0x03C0x0440x04CPassStepDataType, implementation-data-type=uint16
      application-data-type=BattVltgSwdMaxDataType, implementation-data-type=float32
      application-data-type=CmnMfgSrvCal0RelNrDataType, implementation-data-type=uint32
      application-data-type=CurrMeasArbnDaxQaxScagFacDataType, implementation-data-type=float32
      application-data-type=CurrMeasArbnMaxStallCntrDataType, implementation-data-type=uint8
      application-data-type=CurrMeasCorrlnErrNstepDataType, implementation-data-type=uint16
      application-data-type=CurrMeasCorrlnErrPstepDataType, implementation-data-type=uint16
      application-data-type=CurrMeasCorrlnMaxErrCurrDataType, implementation-data-type=float32
      application-data-type=CurrMeasCorrlnMaxStallCntrDataType, implementation-data-type=uint8
      application-data-type=CurrMeasEolFixdPwmPerdDataType, implementation-data-type=uint32
      application-data-type=CurrMeasEolGainMaxDataType, implementation-data-type=float32
      application-data-type=CurrMeasEolGainMinDataType, implementation-data-type=float32
      application-data-type=CurrMeasEolGainNrOfSampleDataType, implementation-data-type=uint16
      application-data-type=CurrMeasEolGainNumerDataType, implementation-data-type=float32
      application-data-type=CurrMeasEolMaxMotVelDataType, implementation-data-type=float32
      application-data-type=CurrMeasEolOffsHiBrdgVltgMinDataType, implementation-data-type=uint32
      application-data-type=CurrMeasEolOffsHiCmuOffsDataType, implementation-data-type=uint32
      application-data-type=CurrMeasEolOffsLoCmuOffsDataType, implementation-data-type=uint32
      application-data-type=CurrMeasEolOffsMaxDataType, implementation-data-type=float32
      application-data-type=CurrMeasEolOffsMinDataType, implementation-data-type=float32
      application-data-type=CurrMeasEolOffsNrOfSampleDataType, implementation-data-type=uint16
      application-data-type=CurrMeasEolTranCntrThdDataType, implementation-data-type=uint8
      application-data-type=CurrMeasMinRqrdPhaOnTiDataType, implementation-data-type=uint32
      application-data-type=CurrMeasMotAgCompuDlyDataType, implementation-data-type=uint32
      application-data-type=CurrMeasMotCurrAdcVlyEnadMaxDataType, implementation-data-type=float32
      application-data-type=CurrMeasMotCurrAdcVlyEnadMinDataType, implementation-data-type=float32
      application-data-type=CurrMeasMotCurrAdcVlyWrmIninMaxDataType, implementation-data-type=float32
      application-data-type=CurrMeasMotCurrAdcVlyWrmIninMinDataType, implementation-data-type=float32
      application-data-type=CurrMeasNtc0x05DFailStepDataType, implementation-data-type=uint16
      application-data-type=CurrMeasNtc0x05DPassStepDataType, implementation-data-type=uint16
      application-data-type=CurrMeasNtc0x06DFailStepDataType, implementation-data-type=uint16
      application-data-type=CurrMeasNtc0x06DPassStepDataType, implementation-data-type=uint16
      application-data-type=CurrMeasNtc0x1ECFailStepDataType, implementation-data-type=uint16
      application-data-type=CurrMeasNtc0x1ECPassStepDataType, implementation-data-type=uint16
      application-data-type=CurrMeasNtc0x1EDFailStepDataType, implementation-data-type=uint16
      application-data-type=CurrMeasNtc0x1EDPassStepDataType, implementation-data-type=uint16
      application-data-type=DampgHydBasCoeff{1..4}DataType, implementation-data-type=float32
      application-data-type=DampgHydOutpLimDataType, implementation-data-type=float32
      application-data-type=DampgMotVelLpFilFrqDataType, implementation-data-type=float32
      application-data-type=DampgQuad13MplrDataType, implementation-data-type=float32
      application-data-type=DampgQuad24MplrDataType, implementation-data-type=float32
      application-data-type=DampgQuadHwTqBacklshDataType, implementation-data-type=float32
      application-data-type=DampgQuadHwTqLpFilFrqDataType, implementation-data-type=float32
      application-data-type=DampgQuadMotVelBacklshDataType, implementation-data-type=float32
      application-data-type=DampgQuadMotVelLpFilFrqDataType, implementation-data-type=float32
      application-data-type=DampgQuadScaLpFilFrqDataType, implementation-data-type=float32
      application-data-type=EcuTMeasDftTDataType, implementation-data-type=float32
      application-data-type=EcuTMeasFilTauDataType, implementation-data-type=float32
      application-data-type=EcuTMeasNtc0x045FailStepDataType, implementation-data-type=uint16
      application-data-type=EcuTMeasNtc0x045PassStepDataType, implementation-data-type=uint16
      application-data-type=EcuTMeasRngDiagcMaxDataType, implementation-data-type=float32
      application-data-type=EcuTMeasRngDiagcMinDataType, implementation-data-type=float32
      application-data-type=EcuTMeasScagDataType, implementation-data-type=float32
      application-data-type=EcuTMeasScagOffsDataType, implementation-data-type=float32
      application-data-type=GateDrvCtrlNtcNr0x050FailStepDataType, implementation-data-type=uint16
      application-data-type=GateDrvCtrlNtcNr0x060FailStepDataType, implementation-data-type=uint16
      application-data-type=GateDrvCtrlUnit0Cfg{2..4}WrValDataType, implementation-data-type=uint16
      application-data-type=GateDrvCtrlUnit0Cfg7WrValDataType, implementation-data-type=uint16
      application-data-type=GateDrvCtrlUnit1Cfg{2..4}WrValDataType, implementation-data-type=uint16
      application-data-type=GateDrvCtrlUnit1Cfg7WrValDataType, implementation-data-type=uint16
      application-data-type=HwAg0MeasNtc0x093FailStepDataType, implementation-data-type=uint16
      application-data-type=HwAg0MeasNtc0x093PassStepDataType, implementation-data-type=uint16
      application-data-type=HwAg0MeasNtc0x094FailStepDataType, implementation-data-type=uint16
      application-data-type=HwAg0MeasNtc0x094PassStepDataType, implementation-data-type=uint16
      application-data-type=HwAg0MeasNtc0x095FailStepDataType, implementation-data-type=uint16
      application-data-type=HwAg0MeasNtc0x095PassStepDataType, implementation-data-type=uint16
      application-data-type=HwAg0MeasVrnrErrThdDataType, implementation-data-type=uint8
      application-data-type=HwAg1MeasNtc0x097FailStepDataType, implementation-data-type=uint16
      application-data-type=HwAg1MeasNtc0x097PassStepDataType, implementation-data-type=uint16
      application-data-type=HwAg1MeasNtc0x098FailStepDataType, implementation-data-type=uint16
      application-data-type=HwAg1MeasNtc0x098PassStepDataType, implementation-data-type=uint16
      application-data-type=HwAg1MeasNtc0x099FailStepDataType, implementation-data-type=uint16
      application-data-type=HwAg1MeasNtc0x099PassStepDataType, implementation-data-type=uint16
      application-data-type=HwAg1MeasVrnrErrThdDataType, implementation-data-type=uint8
      application-data-type=HwTq0MeasNtc0x073FailStepDataType, implementation-data-type=uint16
      application-data-type=HwTq0MeasNtc0x073PassStepDataType, implementation-data-type=uint16
      application-data-type=HwTqArbnMaxStallTqADataType, implementation-data-type=uint8
      application-data-type=HwTqArbnMaxStallTqBDataType, implementation-data-type=uint8
      application-data-type=HwTqArbnMaxStallTqCDataType, implementation-data-type=uint8
      application-data-type=HwTqArbnMaxStallTqDDataType, implementation-data-type=uint8
      application-data-type=MotCtrlPrmEstimnFetRNomDataType, implementation-data-type=float32
      application-data-type=MotCtrlPrmEstimnFetThermCoeffDataType, implementation-data-type=float32
      application-data-type=MotCtrlPrmEstimnMagThermCoeffDataType, implementation-data-type=float32
      application-data-type=MotCtrlPrmEstimnMotBackEmfConHiLimDataType, implementation-data-type=float32
      application-data-type=MotCtrlPrmEstimnMotBackEmfConLoLimDataType, implementation-data-type=float32
      application-data-type=MotCtrlPrmEstimnMotBackEmfConNomDataType, implementation-data-type=float32
      application-data-type=MotCtrlPrmEstimnMotInduDaxHiLimDataType, implementation-data-type=float32
      application-data-type=MotCtrlPrmEstimnMotInduDaxLoLimDataType, implementation-data-type=float32
      application-data-type=MotCtrlPrmEstimnMotInduDaxNomDataType, implementation-data-type=float32
      application-data-type=MotCtrlPrmEstimnMotInduQaxHiLimDataType, implementation-data-type=float32
      application-data-type=MotCtrlPrmEstimnMotInduQaxLoLimDataType, implementation-data-type=float32
      application-data-type=MotCtrlPrmEstimnMotInduQaxNomDataType, implementation-data-type=float32
      application-data-type=MotCtrlPrmEstimnMotRHiLimDataType, implementation-data-type=float32
      application-data-type=MotCtrlPrmEstimnMotRLoLimDataType, implementation-data-type=float32
      application-data-type=MotCtrlPrmEstimnMotRNomDataType, implementation-data-type=float32
      application-data-type=MotCtrlPrmEstimnMotWidgThermCoeffDataType, implementation-data-type=float32
      application-data-type=MotCtrlPrmEstimnTNomDataType, implementation-data-type=float32
      application-data-type=MotCurrRegCfgCtrlrDynGainVehSpdCutOffDataType, implementation-data-type=float32
      application-data-type=MotCurrRegCfgCurrLoopSecOrderTrfFcnEnaDataType, implementation-data-type=uint8
      application-data-type=MotCurrRegCfgIntgrlGainSampleTiDataType, implementation-data-type=float32
      application-data-type=MotCurrRegCfgMotAgCompuDlyDataType, implementation-data-type=float32
      application-data-type=MotCurrRegCfgMotDampgRatDaxDataType, implementation-data-type=float32
      application-data-type=MotCurrRegCfgMotDampgRatQaxDataType, implementation-data-type=float32
      application-data-type=MotCurrRegCfgMotRVirtDaxDataType, implementation-data-type=float32
      application-data-type=MotCurrRegCfgMotRVirtQaxDataType, implementation-data-type=float32
      application-data-type=MotCurrRegCfgMotVelFilFrqDataType, implementation-data-type=float32
      application-data-type=MotCurrRegVltgLimrCurrLoaScarSlewRateDataType, implementation-data-type=float32
      application-data-type=MotCurrRegVltgLimrDaxAntiWdupCoeffDataType, implementation-data-type=float32
      application-data-type=MotCurrRegVltgLimrIvtrLoaScarSlewRateDataType, implementation-data-type=float32
      application-data-type=MotCurrRegVltgLimrQaxAntiWdupCoeffDataType, implementation-data-type=float32
      application-data-type=MotCurrRegVltgLimrQaxAntiWdupScagDiDataType, implementation-data-type=uint8
      application-data-type=MotQuadDetnMotDirHysInstsDataType, implementation-data-type=DataTypes/s18p13
      application-data-type=MotRefMdlCurrDaxBoostGainDataType, implementation-data-type=float32
      application-data-type=MotRefMdlCurrIterTolDataType, implementation-data-type=float32
      application-data-type=MotRefMdlFbCtrlDiDataType, implementation-data-type=uint8
      application-data-type=MotRefMdlIvtrDeadTiBrdgVltgScaDataType, implementation-data-type=float32
      application-data-type=MotRefMdlMinCurrIterLimDataType, implementation-data-type=uint8
      application-data-type=MotRefMdlMotCurrDaxMaxScaDataType, implementation-data-type=float32
      application-data-type=MotRefMdlMotVelLpFilFrqDataType, implementation-data-type=float32
      application-data-type=MotRefMdlMotVltgDerivtvTiConDataType, implementation-data-type=float32
      application-data-type=MotRefMdlRefLocnIterLimDataType, implementation-data-type=uint8
      application-data-type=MotRefMdlTqIterLimDataType, implementation-data-type=uint8
      application-data-type=MotRefMdlTqIterTolDataType, implementation-data-type=float32
      application-data-type=MotRefMdlVltgModDynCmpEnaDataType, implementation-data-type=uint8
      application-data-type=MotRefMdlVltgOvrRThdScaDataType, implementation-data-type=float32
      application-data-type=PwrDiscnctNtc0x042FailStepDataType, implementation-data-type=uint16
      application-data-type=PwrDiscnctNtc0x042PassStepDataType, implementation-data-type=uint16
      application-data-type=PwrDiscnctNtc0x04AFailStepDataType, implementation-data-type=uint16
      application-data-type=PwrDiscnctNtc0x04APassStepDataType, implementation-data-type=uint16
      application-data-type=PwrDiscnctOpenThdDataType, implementation-data-type=float32
      application-data-type=RtnHwAuthySlewDataType, implementation-data-type=float32
      application-data-type=RtnOffsRngDataType, implementation-data-type=float32
      application-data-type=RtnOffsSlewDataType, implementation-data-type=float32
      application-data-type=SinVltgGennDitherLpfCoeffDataType, implementation-data-type=float32
      application-data-type=SysGlbPrmMotPoleCntDataType, implementation-data-type=uint8
      application-data-type=SysGlbPrmSysKineRatDataType, implementation-data-type=float32
      application-data-type=SysGlbPrmSysTqRatDataType, implementation-data-type=float32
      application-data-type=SysGlbPrmTorsBarStfnDataType, implementation-data-type=float32
      application-data-type=TSG31CfgAndUseAdcStrtOfCnvn2OffsDataType, implementation-data-type=uint32
      application-data-type=TSG31CfgAndUseAdcStrtOfCnvnMotCtrlPeakOffsDataType, implementation-data-type=uint32
      application-data-type=TSG31CfgAndUseAdcStrtOfCnvnMotCtrlVlyOffsDataType, implementation-data-type=uint32
      application-data-type=TSG31CfgAndUseMtrAg0SPIStartDataType, implementation-data-type=uint32
      application-data-type=TSG31CfgAndUsePwmDbndDataType, implementation-data-type=uint32
      application-data-type=VehSigCdngDftLatADataType, implementation-data-type=float32
      application-data-type=VehSigCdngDftLgtADataType, implementation-data-type=float32
      application-data-type=VehSigCdngDftVehSpdDataType, implementation-data-type=float32
      application-data-type=VehSigCdngDftYawRateDataType, implementation-data-type=float32
      application-data-type=VehSigCdngLatADifThdDataType, implementation-data-type=float32
      application-data-type=VehSigCdngLatAFilFrqDataType, implementation-data-type=float32
      application-data-type=VehSigCdngLatASlewRateDataType, implementation-data-type=float32
      application-data-type=VehSigCdngLtgADifThdDataType, implementation-data-type=float32
      application-data-type=VehSigCdngLtgASlewRateDataType, implementation-data-type=float32
      application-data-type=VehSigCdngVehSpdDifThdDataType, implementation-data-type=float32
      application-data-type=VehSigCdngVehSpdSlewRateDataType, implementation-data-type=float32
      application-data-type=VehSigCdngVehYawSlewRateDataType, implementation-data-type=float32
      application-data-type=VehSigCdngYawRateDifThdDataType, implementation-data-type=float32
package /DataDictionary/DataTypes
  169 x app type, all with category=VALUE, sw-calibration-access=READ-ONLY:
    AssiPahSumHysCmpLimDataType: range phys 0..0.3, unit=MotNwtMtr
    AssiSumLimNtc0x0C4FailStepDataType: range phys 0..65535, unit=Cnt
    AssiSumLimNtc0x0C4PassStepDataType: range phys 0..65535, unit=Cnt
    AssiSumLimPullCmpLimDataType: range phys 0..8.8, unit=MotNwtMtr
    BattVltgCorrlnAllwdVltgDifDataType: range phys 0..1, unit=Volt
    BattVltgCorrlnNtc0x03C0x0440x04CFailStepDataType: range phys 0..65535, unit=Cnt
    BattVltgCorrlnNtc0x03C0x0440x04CPassStepDataType: range phys 0..65535, unit=Cnt
    BattVltgSwdMaxDataType: range phys 6..26.5, unit=Volt
    CmnMfgSrvCal0RelNrDataType: range phys 0..4294967295, unit=Cnt
    CurrMeasArbnDaxQaxScagFacDataType: range phys 0.5..1, unit=Uls
    CurrMeasArbnMaxStallCntrDataType: range phys 0..255, unit=Cnt
    CurrMeasCorrlnErrNstepDataType: range phys 0..65535, unit=Cnt
    CurrMeasCorrlnErrPstepDataType: range phys 0..65535, unit=Cnt
    CurrMeasCorrlnMaxErrCurrDataType: range phys 0..50, unit=Ampr
    CurrMeasCorrlnMaxStallCntrDataType: range phys 0..255, unit=Cnt
    CurrMeasEolFixdPwmPerdDataType: range phys 55555..71429, unit=NanoSec
    CurrMeasEolGainMaxDataType: range phys 70..76, unit=AmprPerVolt
    CurrMeasEolGainMinDataType: range phys 56..60, unit=AmprPerVolt
    CurrMeasEolGainNrOfSampleDataType: range phys 1..1000, unit=Cnt
    CurrMeasEolGainNumerDataType: range phys 10..100, unit=Ampr
    CurrMeasEolMaxMotVelDataType: range phys 0..1350, unit=MotRadPerSec
    CurrMeasEolOffsHiBrdgVltgMinDataType: range phys 233330..1325008, unit=VoltNanoSec
    CurrMeasEolOffsHiCmuOffsDataType: range phys 0..71429, unit=NanoSec
    CurrMeasEolOffsLoCmuOffsDataType: range phys 0..71429, unit=NanoSec
    CurrMeasEolOffsMaxDataType: range phys 2.8..3, unit=Volt
    CurrMeasEolOffsMinDataType: range phys 2..2.3, unit=Volt
    CurrMeasEolOffsNrOfSampleDataType: range phys 1..10000, unit=Cnt
    CurrMeasEolTranCntrThdDataType: range phys 0..255, unit=Cnt
    CurrMeasMinRqrdPhaOnTiDataType: range phys 6666..8572, unit=NanoSec
    CurrMeasMotAgCompuDlyDataType: range phys 0..30000, unit=NanoSec
    CurrMeasMotCurrAdcVlyEnadMaxDataType: range phys 2.5..4.8, unit=Volt
    CurrMeasMotCurrAdcVlyEnadMinDataType: range phys 0.3..2.5, unit=Volt
    CurrMeasMotCurrAdcVlyWrmIninMaxDataType: range phys 2.5..3, unit=Volt
    CurrMeasMotCurrAdcVlyWrmIninMinDataType: range phys 2..2.5, unit=Volt
    CurrMeasNtc0x05DFailStepDataType: range phys 0..65535, unit=Cnt
    CurrMeasNtc0x05DPassStepDataType: range phys 0..65535, unit=Cnt
    CurrMeasNtc0x06DFailStepDataType: range phys 0..65535, unit=Cnt
    CurrMeasNtc0x06DPassStepDataType: range phys 0..65535, unit=Cnt
    CurrMeasNtc0x1ECFailStepDataType: range phys 0..65535, unit=Cnt
    CurrMeasNtc0x1ECPassStepDataType: range phys 0..65535, unit=Cnt
    CurrMeasNtc0x1EDFailStepDataType: range phys 0..65535, unit=Cnt
    CurrMeasNtc0x1EDPassStepDataType: range phys 0..65535, unit=Cnt
    DampgHydBasCoeff{1..4}DataType: range phys 0..0.1, unit=MotNwtMtrPerMotRadPerSec
    DampgHydOutpLimDataType: range phys -8.8..8.8, unit=MotNwtMtr
    DampgMotVelLpFilFrqDataType: range phys 5..100, unit=Hz
    DampgQuad13MplrDataType: range phys 0..2, unit=Uls
    DampgQuad24MplrDataType: range phys 0..2, unit=Uls
    DampgQuadHwTqBacklshDataType: range phys 0..10, unit=HwNwtMtr
    DampgQuadHwTqLpFilFrqDataType: range phys 5..31.25, unit=Hz
    DampgQuadMotVelBacklshDataType: range phys 0..128, unit=MotRadPerSec
    DampgQuadMotVelLpFilFrqDataType: range phys 5..31.25, unit=Hz
    DampgQuadScaLpFilFrqDataType: range phys 0.0039..100, unit=Hz
    EcuTMeasDftTDataType: range phys -50..150, unit=DegCgrd
    EcuTMeasFilTauDataType: range phys 0.1..10, unit=Hz
    EcuTMeasNtc0x045FailStepDataType: range phys 0..65535, unit=Cnt
    EcuTMeasNtc0x045PassStepDataType: range phys 0..65535, unit=Cnt
    EcuTMeasRngDiagcMaxDataType: range phys -50..200, unit=DegCgrd
    EcuTMeasRngDiagcMinDataType: range phys -50..200, unit=DegCgrd
    EcuTMeasScagDataType: range phys 0..200, unit=DegCgrdPerVolt
    EcuTMeasScagOffsDataType: range phys -100..150, unit=DegCgrd
    GateDrvCtrlNtcNr0x050FailStepDataType: range phys 0..65535, unit=Cnt
    GateDrvCtrlNtcNr0x060FailStepDataType: range phys 0..65535, unit=Cnt
    GateDrvCtrlUnit0Cfg{2..4}WrValDataType: range phys 0..65535, unit=Cnt
    GateDrvCtrlUnit0Cfg7WrValDataType: range phys 0..65535, unit=Cnt
    GateDrvCtrlUnit1Cfg{2..4}WrValDataType: range phys 0..65535, unit=Cnt
    GateDrvCtrlUnit1Cfg7WrValDataType: range phys 0..65535, unit=Cnt
    HwAg0MeasNtc0x093FailStepDataType: range phys 0..65535, unit=Cnt
    HwAg0MeasNtc0x093PassStepDataType: range phys 0..65535, unit=Cnt
    HwAg0MeasNtc0x094FailStepDataType: range phys 0..65535, unit=Cnt
    HwAg0MeasNtc0x094PassStepDataType: range phys 0..65535, unit=Cnt
    HwAg0MeasNtc0x095FailStepDataType: range phys 0..65535, unit=Cnt
    HwAg0MeasNtc0x095PassStepDataType: range phys 0..65535, unit=Cnt
    HwAg0MeasVrnrErrThdDataType: range phys 0..20, unit=Cnt
    HwAg1MeasNtc0x097FailStepDataType: range phys 0..65535, unit=Cnt
    HwAg1MeasNtc0x097PassStepDataType: range phys 0..65535, unit=Cnt
    HwAg1MeasNtc0x098FailStepDataType: range phys 0..65535, unit=Cnt
    HwAg1MeasNtc0x098PassStepDataType: range phys 0..65535, unit=Cnt
    HwAg1MeasNtc0x099FailStepDataType: range phys 0..65535, unit=Cnt
    HwAg1MeasNtc0x099PassStepDataType: range phys 0..65535, unit=Cnt
    HwAg1MeasVrnrErrThdDataType: range phys 0..20, unit=Cnt
    HwTq0MeasNtc0x073FailStepDataType: range phys 0..65535, unit=Cnt
    HwTq0MeasNtc0x073PassStepDataType: range phys 0..65535, unit=Cnt
    HwTqArbnMaxStallTqADataType: range phys 0..255, unit=Cnt
    HwTqArbnMaxStallTqBDataType: range phys 0..255, unit=Cnt
    HwTqArbnMaxStallTqCDataType: range phys 0..255, unit=Cnt
    HwTqArbnMaxStallTqDDataType: range phys 0..255, unit=Cnt
    MotCtrlPrmEstimnFetRNomDataType: range phys 0..0.1, unit=Ohm
    MotCtrlPrmEstimnFetThermCoeffDataType: range phys 0..0.006, unit=OhmPerDegCgrd
    MotCtrlPrmEstimnMagThermCoeffDataType: range phys -0.0015..0, unit=VoltPerMotRadPerSecPerDegCgrd
    MotCtrlPrmEstimnMotBackEmfConHiLimDataType: range phys 0.025..0.075, unit=VoltPerMotRadPerSec
    MotCtrlPrmEstimnMotBackEmfConLoLimDataType: range phys 0.025..0.075, unit=VoltPerMotRadPerSec
    MotCtrlPrmEstimnMotBackEmfConNomDataType: range phys 0.025..0.075, unit=VoltPerMotRadPerSec
    MotCtrlPrmEstimnMotInduDaxHiLimDataType: range phys 3e-05..0.00041, unit=Henry
    MotCtrlPrmEstimnMotInduDaxLoLimDataType: range phys 3e-05..0.00041, unit=Henry
    MotCtrlPrmEstimnMotInduDaxNomDataType: range phys 3e-05..0.00041, unit=Henry
    MotCtrlPrmEstimnMotInduQaxHiLimDataType: range phys 3e-05..0.00041, unit=Henry
    MotCtrlPrmEstimnMotInduQaxLoLimDataType: range phys 3e-05..0.00041, unit=Henry
    MotCtrlPrmEstimnMotInduQaxNomDataType: range phys 3e-05..0.00041, unit=Henry
    MotCtrlPrmEstimnMotRHiLimDataType: range phys 0.005..0.12565, unit=Ohm
    MotCtrlPrmEstimnMotRLoLimDataType: range phys 0.005..0.12565, unit=Ohm
    MotCtrlPrmEstimnMotRNomDataType: range phys 0.005..0.12565, unit=Ohm
    MotCtrlPrmEstimnMotWidgThermCoeffDataType: range phys 0..0.0045, unit=OhmPerDegCgrd
    MotCtrlPrmEstimnTNomDataType: range phys -40..150, unit=DegCgrd
    MotCurrRegCfgCtrlrDynGainVehSpdCutOffDataType: range phys 0..255, unit=Kph
    MotCurrRegCfgCurrLoopSecOrderTrfFcnEnaDataType: range phys 0..1, unit=Cnt
    MotCurrRegCfgIntgrlGainSampleTiDataType: range phys 9.1e-05..0.000143, unit=Sec
    MotCurrRegCfgMotAgCompuDlyDataType: range phys 0..0.0002, unit=Sec
    MotCurrRegCfgMotDampgRatDaxDataType: range phys 0..20, unit=Uls
    MotCurrRegCfgMotDampgRatQaxDataType: range phys 0..20, unit=Uls
    MotCurrRegCfgMotRVirtDaxDataType: range phys 0..0.2, unit=Ohm
    MotCurrRegCfgMotRVirtQaxDataType: range phys 0..0.2, unit=Ohm
    MotCurrRegCfgMotVelFilFrqDataType: range phys 1..200, unit=Hz
    MotCurrRegVltgLimrCurrLoaScarSlewRateDataType: range phys 0..1000, unit=UlsPerSec
    MotCurrRegVltgLimrDaxAntiWdupCoeffDataType: range phys -25..25, unit=Uls
    MotCurrRegVltgLimrIvtrLoaScarSlewRateDataType: range phys 0..1000, unit=UlsPerSec
    MotCurrRegVltgLimrQaxAntiWdupCoeffDataType: range phys -25..25, unit=Uls
    MotCurrRegVltgLimrQaxAntiWdupScagDiDataType: range phys 0..1, unit=Cnt
    MotQuadDetnMotDirHysInstsDataType: range phys 0..6.25, unit=MotDeg
    MotRefMdlCurrDaxBoostGainDataType: range phys 0..1, unit=Uls
    MotRefMdlCurrIterTolDataType: range phys 0.01..20, unit=Ampr
    MotRefMdlFbCtrlDiDataType: range phys 0..1, unit=Cnt
    MotRefMdlIvtrDeadTiBrdgVltgScaDataType: range phys 0.98..1, unit=Uls
    MotRefMdlMinCurrIterLimDataType: range phys 1..5, unit=Cnt
    MotRefMdlMotCurrDaxMaxScaDataType: range phys 1..2, unit=Uls
    MotRefMdlMotVelLpFilFrqDataType: range phys 1..200, unit=Hz
    MotRefMdlMotVltgDerivtvTiConDataType: range phys 0..0.05, unit=Sec
    MotRefMdlRefLocnIterLimDataType: range phys 1..20, unit=Cnt
    MotRefMdlTqIterLimDataType: range phys 1..5, unit=Cnt
    MotRefMdlTqIterTolDataType: range phys 0.001..0.1, unit=MotRad
    MotRefMdlVltgModDynCmpEnaDataType: range phys 0..1, unit=Cnt
    MotRefMdlVltgOvrRThdScaDataType: range phys 0..1, unit=Uls
    PwrDiscnctNtc0x042FailStepDataType: range phys 0..65535, unit=Cnt
    PwrDiscnctNtc0x042PassStepDataType: range phys 0..65535, unit=Cnt
    PwrDiscnctNtc0x04AFailStepDataType: range phys 0..65535, unit=Cnt
    PwrDiscnctNtc0x04APassStepDataType: range phys 0..65535, unit=Cnt
    PwrDiscnctOpenThdDataType: range phys 0..26.5, unit=Volt
    RtnHwAuthySlewDataType: range phys 0.1..10, unit=UlsPerSec
    RtnOffsRngDataType: range phys 0..20, unit=HwDeg
    RtnOffsSlewDataType: range phys 0..0.5, unit=HwDegPerSec
    SinVltgGennDitherLpfCoeffDataType: range phys 0..1, unit=Uls
    SysGlbPrmMotPoleCntDataType: range phys 2..12, unit=Cnt
    SysGlbPrmSysKineRatDataType: range phys 10..40, unit=MotDegPerHwDeg
    SysGlbPrmSysTqRatDataType: range phys 10..40, unit=HwNwtMtrPerMotNwtMtr
    SysGlbPrmTorsBarStfnDataType: range phys 0.5..10, unit=HwNwtMtrPerHwDeg
    TSG31CfgAndUseAdcStrtOfCnvn2OffsDataType: range phys 0..25000, unit=NanoSec
    TSG31CfgAndUseAdcStrtOfCnvnMotCtrlPeakOffsDataType: range phys 0..25000, unit=NanoSec
    TSG31CfgAndUseAdcStrtOfCnvnMotCtrlVlyOffsDataType: range phys 0..25000, unit=NanoSec
    TSG31CfgAndUseMtrAg0SPIStartDataType: range phys 0..71429, unit=NanoSec
    TSG31CfgAndUsePwmDbndDataType: range phys 1..1000, unit=NanoSec
    VehSigCdngDftLatADataType: range phys -10..10, unit=MtrPerSecSqd
    VehSigCdngDftLgtADataType: range phys -50..50, unit=KphPerSec
    VehSigCdngDftVehSpdDataType: range phys 0..511, unit=Kph
    VehSigCdngDftYawRateDataType: range phys -120..120, unit=VehDegPerSec
    VehSigCdngLatADifThdDataType: range phys 0.1..10, unit=MtrPerSecSqd
    VehSigCdngLatAFilFrqDataType: range phys 1..100, unit=Hz
    VehSigCdngLatASlewRateDataType: range phys 0.1..400, unit=MtrPerSecSqd
    VehSigCdngLtgADifThdDataType: range phys 0.1..10, unit=KphPerSec
    VehSigCdngLtgASlewRateDataType: range phys 0.1..500, unit=KphPerSecSqd
    VehSigCdngVehSpdDifThdDataType: range phys 0.1..511, unit=Kph
    VehSigCdngVehSpdSlewRateDataType: range phys 1..50, unit=KphPerSec
    VehSigCdngVehYawSlewRateDataType: range phys 1..1200, unit=VehDegPerSecSqd
    VehSigCdngYawRateDifThdDataType: range phys 0.1..120, unit=VehDegPerSec
  impl type s18p13: compu {raw=phys*8192 for phys >0..<255; unit FixdPt}, implementation-data-type=sint32, type-emitter=RTE
package /DataDictionary/Units
  35 x unit, all with factor-si-to-unit=1, offset-si-to-unit=0:
    Ampr: display-name=Ampr
    AmprPerVolt: display-name=AmprPerVolt
    Cnt: display-name=Cnt
    DegCgrd: display-name=DegCgrd
    DegCgrdPerVolt: display-name=DegCgrdPerVolt
    FixdPt: display-name=FixdPt
    Henry: display-name=Henry
    HwDeg: display-name=HwDeg
    HwDegPerSec: display-name=HwDegPerSec
    HwNwtMtr: display-name=HwNwtMtr
    HwNwtMtrPerHwDeg: display-name=HwNwtMtrPerHwDeg
    HwNwtMtrPerMotNwtMtr: display-name=HwNwtMtrPerMotNwtMtr
    Hz: display-name=Hz
    Kph: display-name=Kph
    KphPerSec: display-name=KphPerSec
    KphPerSecSqd: display-name=KphPerSecSqd
    MotDeg: display-name=MotDeg
    MotDegPerHwDeg: display-name=MotDegPerHwDeg
    MotNwtMtr: display-name=MotNwtMtr
    MotNwtMtrPerMotRadPerSec: display-name=MotNwtMtrPerMotRadPerSec
    MotRad: display-name=MotRad
    MotRadPerSec: display-name=MotRadPerSec
    MtrPerSecSqd: display-name=MtrPerSecSqd
    NanoSec: display-name=NanoSec
    Ohm: display-name=Ohm
    OhmPerDegCgrd: display-name=OhmPerDegCgrd
    Sec: display-name=Sec
    Uls: display-name=Uls
    UlsPerSec: display-name=UlsPerSec
    VehDegPerSec: display-name=VehDegPerSec
    VehDegPerSecSqd: display-name=VehDegPerSecSqd
    Volt: display-name=Volt
    VoltNanoSec: display-name=VoltNanoSec
    VoltPerMotRadPerSec: display-name=VoltPerMotRadPerSec
    VoltPerMotRadPerSecPerDegCgrd: display-name=VoltPerMotRadPerSecPerDegCgrd
package /DataTypes
  274 x impl type:
    ACLNY_COG: category=VALUE, base-type=uint16, compu-method=ACLNY_COG
    ACLNY_COG_ERR_AMP: category=VALUE, base-type=uint16, compu {phys=raw*0.005 for raw 0..800000; unit m/s^2}
    ACLNY_COG_ERR_AMP1: category=VALUE, base-type=uint16, compu {phys=raw*0.005 for raw 0..800000; unit m/s^2}
    ACLNY_COG1: category=VALUE, base-type=uint16, compu-method=ACLNY_COG
    ACLNY_MASSCNTR_dummy_12_15: category=VALUE, base-type=uint8, compu {identical}
    ACLNY_MASSCNTR_dummy_12_151: category=VALUE, base-type=uint8, compu {identical}
    ALIV_ACLNY_COG: category=VALUE, base-type=uint8, compu-method=ALIV_COU_4
    ALIV_ACLNY_COG1: category=VALUE, base-type=uint8, compu-method=ALIV_COU_4
    ALIV_AVL_FORC_GRD: category=VALUE, base-type=uint8, compu-method=ALIV_COU_4
    ALIV_AVL_FORC_GRD1: category=VALUE, base-type=uint8, compu-method=ALIV_COU_4
    ALIV_AVL_PO_EPS1: category=VALUE, base-type=uint8, compu-method=ALIV_COU_4
    ALIV_AVL_STMOM_DV_ACT: category=VALUE, base-type=uint8, compu-method=ALIV_COU_4
    ALIV_AVL_STMOM_DV_ACT1: category=VALUE, base-type=uint8, compu-method=ALIV_COU_4
    ALIV_CON_VEH1: category=VALUE, base-type=uint8
    ALIV_DISP_CC_EPS1: category=VALUE, base-type=uint8
    ALIV_DISP_CC_EPS1_01: category=VALUE, base-type=uint8, compu {identical}
    ALIV_DT_EST: category=VALUE, base-type=uint8, compu {identical}
    ALIV_DT_EST1: category=VALUE, base-type=uint8, compu {identical}
    ALIV_ENERG_DGR_DRDY: category=VALUE, base-type=uint8, compu {identical}
    ALIV_ENERG_DGR_DRDY1: category=VALUE, base-type=uint8, compu {identical}
    ALIV_OFFS_QUAD_EPS1: category=VALUE, base-type=uint8, compu-method=ALIV_COU_4
    ALIV_ST_CENG: category=VALUE, base-type=uint8, compu {identical}, range phys 0..14, invalid-value=15
    ALIV_ST_CENG1: category=VALUE, base-type=uint8, compu {identical}, range phys 0..14, invalid-value=15
    ALIV_ST_EST_FTAX: category=VALUE, base-type=uint8, compu-method=ALIV_COU_4
    ALIV_ST_EST_FTAX1: category=VALUE, base-type=uint8, compu-method=ALIV_COU_4
    ALIV_SU_EPS: category=VALUE, base-type=uint8, compu {identical}
    ALIV_SU_EPS1: category=VALUE, base-type=uint8, compu {identical}
    ALIV_TAR_QTA_STMOM_DV: category=VALUE, base-type=uint8, compu-method=ALIV_COU_4
    ALIV_TAR_QTA_STMOM_DV1: category=VALUE, base-type=uint8, compu-method=ALIV_COU_4
    ALIV_TAR_STMOM_DV_ACT: category=VALUE, base-type=uint8, compu-method=ALIV_COU_4
    ALIV_TAR_STMOM_DV_ACT1: category=VALUE, base-type=uint8, compu-method=ALIV_COU_4
    ALIV_VYAW_VEH: category=VALUE, base-type=uint8, compu-method=ALIV_COU_4
    ALIV_VYAW_VEH1: category=VALUE, base-type=uint8, compu-method=ALIV_COU_4
    Ary1D_u16_16: category=ARRAY, sw-calibration-access=READ-ONLY, type-emitter=RTE
      element Element: array-size=16, array-size-semantics=FIXED-SIZE, implementation-data-type=uint16
    Ary1D_u8_20: category=ARRAY, sw-calibration-access=READ-ONLY, type-emitter=RTE
      element Element: array-size=20, array-size-semantics=FIXED-SIZE, implementation-data-type=uint8
    Ary1D_u8_8: category=ARRAY, sw-calibration-access=READ-ONLY, type-emitter=RTE
      element Element: array-size=8, array-size-semantics=FIXED-SIZE, implementation-data-type=uint8
    AVL_FORC_GRD: category=VALUE, base-type=uint16, compu-method=AVL_FORC_GRD
    AVL_FORC_GRD_dummy_12_15: category=VALUE, base-type=uint8, compu {identical}
    AVL_FORC_GRD_dummy_12_151: category=VALUE, base-type=uint8, compu {identical}
    AVL_FORC_GRD1: category=VALUE, base-type=uint16, compu-method=AVL_FORC_GRD
    AVL_I_ACT_EST: category=VALUE, base-type=uint8, compu-method=I_SPEC_ARS
    AVL_I_ACT_EST1: category=VALUE, base-type=uint8, compu-method=I_SPEC_ARS
    AVL_PO_EPS1: category=VALUE, base-type=uint16
    AVL_PO_EPS1_01: category=VALUE, base-type=uint16, compu {phys=raw*0.0439453125-1439.956055 for raw 32767..1524029.5777777778}
    AVL_PO_IDX_EPS1: category=VALUE, base-type=uint16
    AVL_PO_IDX_EPS1_01: category=VALUE, base-type=uint16, compu {phys=raw*0.0439453125-1439.956055 for raw 32767..1524029.5777777778; unit Uls}
    AVL_PO_IDX_ICM1: category=VALUE, base-type=uint16
    AVL_PWR_EL_EPS_COOD: category=VALUE, base-type=uint8, compu {phys=raw*0.1-12 for raw 120..2520; unit kW}
    AVL_PWR_EL_EPS_COOD1: category=VALUE, base-type=uint8, compu {phys=raw*0.1-12 for raw 120..2520; unit kW}
    AVL_STEA_PNI_OFFS: category=VALUE, base-type=uint16, compu-method=AVL_STEA_PNI_OFFS, range phys 0..4092.025, invalid-value=4095
    AVL_STEA_PNI_OFFS1: category=VALUE, base-type=uint16, compu-method=AVL_STEA_PNI_OFFS, range phys 0..4092.025, invalid-value=4095
    AVL_STMOM_DV_ACT: category=VALUE, base-type=uint16, compu {phys=raw*0.005-10 for raw 2000..802000}
    AVL_STMOM_DV_ACT_dummy_12_15: category=VALUE, base-type=uint8, compu {identical}
    AVL_STMOM_DV_ACT_dummy_12_151: category=VALUE, base-type=uint8, compu {identical}
    AVL_STMOM_DV_ACT1: category=VALUE, base-type=uint16, compu {phys=raw*0.005-10 for raw 2000..802000}
    BATT_VLTG_EPS: category=VALUE, base-type=uint16, compu {identical}, range phys 0..65535
    BmwEpsDeactvnCtrl1: category=VALUE, base-type=uint8, sw-calibration-access=READ-ONLY, compu {0=BMWEPSDEACTVNCTRL_NODEACTVNEPSFCT, 1=BMWEPSDEACTVNCTRL_DEACTVNEPSFCTGROUP1, 2=BMWEPSDEACTVNCTRL_DEACTVNEPSFCTGROUP2, 13=BMWEPSDEACTVNCTRL_FCTIFNOTAVL, 14=BMWEPSDEACTVNCTRL_FCTRPRTERR, 15=BMWEPSDEACTVNCTRL_INVLDSIG}, type-emitter=RTE
    BmwMaxCurrLimrSts1: category=VALUE, base-type=uint8, sw-calibration-access=READ-ONLY, compu {1=BMWMAXCURRLIMRSTS_VLD, 2=BMWMAXCURRLIMRSTS_FCTIFNOTAVL, 3=BMWMAXCURRLIMRSTS_FCTRPRTERR, 4=BMWMAXCURRLIMRSTS_INVLD}, type-emitter=RTE
    BmwOvrlCmdQlfr1: category=VALUE, base-type=uint8, sw-calibration-access=READ-ONLY, compu {2=BMWOVRLCMDQLFR_IMPLSP, 7=BMWOVRLCMDQLFR_SPNOTAVL, 14=BMWOVRLCMDQLFR_STBDONOTCNVSP, 15=BMWOVRLCMDQLFR_INVLDSIG}, type-emitter=RTE
    BmwPinionAgOffsSts1: category=VALUE, base-type=uint8, sw-calibration-access=READ-ONLY, compu {1=BMWPINIONAGOFFSSTS_VLD, 2=BMWPINIONAGOFFSSTS_FCTIFNOTAVL, 3=BMWPINIONAGOFFSSTS_FCTRPRTERR, 4=BMWPINIONAGOFFSSTS_INVLD}, type-emitter=RTE
    BmwRqrdCurrLimEpsSfty1: category=VALUE, base-type=uint8, sw-calibration-access=READ-ONLY, compu {0=BMWRQRDCURRLIMEPSSFTY_NOCURRLIM, 1=BMWRQRDCURRLIMEPSSFTY_CMFTCURRLIM, 10=BMWRQRDCURRLIMEPSSFTY_MAXCURRLIM, 13=BMWRQRDCURRLIMEPSSFTY_RESDNOTAVL, 14=BMWRQRDCURRLIMEPSSFTY_RESDERR, 15=BMWRQRDCURRLIMEPSSFTY_INVLDSIG}, type-emitter=RTE
    BmwRtIdx1: category=VALUE, base-type=uint8, sw-calibration-access=READ-ONLY, compu {1=BMWRTIDX_ULTRAHARD, 2=BMWRTIDX_SPTBAL, 3=BMWRTIDX_BAL, 4=BMWRTIDX_SOFT, 13=BMWRTIDX_FCTLIFNOTAVL, 14=BMWRTIDX_FCTRPTERR, 15=BMWRTIDX_INVLD}, type-emitter=RTE
    BmwSteerMdfnFacSts1: category=VALUE, base-type=uint8, sw-calibration-access=READ-ONLY, compu {0=BMWSTEERMDFNFACSTS_OUTOFRNG, 1=BMWSTEERMDFNFACSTS_VLD, 2=BMWSTEERMDFNFACSTS_FCTIFNOTAVL, 3=BMWSTEERMDFNFACSTS_FCTRPRTERR, 4=BMWSTEERMDFNFACSTS_INVLDSIG}, type-emitter=RTE
    BmwTrfcJamAssiDampgStReq1: category=VALUE, base-type=uint8, sw-calibration-access=READ-ONLY, compu {1=BMWTRFCJAMASSIDAMPGSTREQ_DONOTCNVSPADDLDAMPG, 2=BMWTRFCJAMASSIDAMPGSTREQ_CNVSPADDLDAMPG, 15=BMWTRFCJAMASSIDAMPGSTREQ_INVLDSIG}, type-emitter=RTE
    BmwVehLatAQlfr1:
      category=VALUE
      base-type=uint8
      sw-calibration-access=READ-ONLY
      compu {1=BMWVEHLATAQLFR_SIGVALVLDANDPLAUS, 2=BMWVEHLATAQLFR_SIGVALVLD, 3=BMWVEHLATAQLFR_SIGQLTMONRSTRCTD, 4=BMWVEHLATAQLFR_RESD1, 6=BMWVEHLATAQLFR_SIGVALINVLD, 7=BMWVEHLATAQLFR_RESD2, 8=BMWVEHLATAQLFR_ININ, 9=BMWVEHLATAQLFR_SIGVALTMPVLDANDSECUR, 10=BMWVEHLATAQLFR_SIGVALTMPVLD, 11=BMWVEHLATAQLFR_SIGQLTMONTMPRSTRCTD, 12=BMWVEHLATAQLFR_SIGSUBVALVLDTMP, 14=BMWVEHLATAQLFR_SIGVALTMPINVLD, 15=BMWVEHLATAQLFR_INVLDSIG}
      type-emitter=RTE
    BmwVehYawQlfr1:
      category=VALUE
      base-type=uint8
      sw-calibration-access=READ-ONLY
      compu {1=BMWVEHYAWQLFR_SIGVALVLDANDPLAUS, 2=BMWVEHYAWQLFR_SIGVALVLD, 3=BMWVEHYAWQLFR_SIGQLTMONRSTRCTD, 4=BMWVEHYAWQLFR_RESD1, 6=BMWVEHYAWQLFR_SIGVALINVLD, 7=BMWVEHYAWQLFR_RESD2, 8=BMWVEHYAWQLFR_ININ, 9=BMWVEHYAWQLFR_SIGVALTMPVLDANDSECUR, 10=BMWVEHYAWQLFR_SIGVALTMPVLD, 11=BMWVEHYAWQLFR_SIGQLTMONTMPRSTRCTD, 12=2 (BMWVEHYAWQLFR_SIGSUBVALTMP), 14=BMWVEHYAWQLFR_SIGVALTMPINVLD, 15=BMWVEHYAWQLFR_INVLDSIG}
      type-emitter=RTE
    CHL_DISP_CC_EPS1: category=VALUE, base-type=uint8
    CHL_DISP_CC_EPS1_01: category=VALUE, base-type=uint8, compu {identical}
    CON_VEH_dummy_56_631: category=VALUE, base-type=uint8
    CRC_ACLNY_COG: category=VALUE, base-type=uint8, compu-method=CRC8
    CRC_ACLNY_COG1: category=VALUE, base-type=uint8, compu-method=CRC8
    CRC_AVL_FORC_GRD: category=VALUE, base-type=uint8, compu-method=CRC8
    CRC_AVL_FORC_GRD1: category=VALUE, base-type=uint8, compu-method=CRC8
    CRC_AVL_PO_EPS1: category=VALUE, base-type=uint8
    CRC_AVL_PO_EPS1_01: category=VALUE, base-type=uint8, compu-method=CRC8
    CRC_AVL_STMOM_DV_ACT: category=VALUE, base-type=uint8, compu-method=CRC8
    CRC_AVL_STMOM_DV_ACT1: category=VALUE, base-type=uint8, compu-method=CRC8
    CRC_CON_VEH1: category=VALUE, base-type=uint8
    CRC_DISP_CC_EPS1: category=VALUE, base-type=uint8
    CRC_DISP_CC_EPS1_01: category=VALUE, base-type=uint8, compu-method=CRC8
    CRC_DT_EST: category=VALUE, base-type=uint8, compu-method=CRC8
    CRC_DT_EST1: category=VALUE, base-type=uint8, compu-method=CRC8
    CRC_ENERG_DGR_DRDY: category=VALUE, base-type=uint8, compu-method=CRC8
    CRC_ENERG_DGR_DRDY1: category=VALUE, base-type=uint8, compu-method=CRC8
    CRC_OFFS_QUAD_EPS1: category=VALUE, base-type=uint8
    CRC_ST_EST_FTAX: category=VALUE, base-type=uint8, compu-method=CRC8
    CRC_ST_EST_FTAX1: category=VALUE, base-type=uint8, compu-method=CRC8
    CRC_SU_EPS: category=VALUE, base-type=uint8, compu-method=CRC8
    CRC_SU_EPS1: category=VALUE, base-type=uint8, compu-method=CRC8
    CRC_TAR_QTA_STMOM_DV: category=VALUE, base-type=uint8, compu-method=CRC8
    CRC_TAR_QTA_STMOM_DV1: category=VALUE, base-type=uint8, compu-method=CRC8
    CRC_TAR_STMOM_DV_ACT: category=VALUE, base-type=uint8, compu-method=CRC8
    CRC_TAR_STMOM_DV_ACT1: category=VALUE, base-type=uint8, compu-method=CRC8
    CRC_VYAW_VEH: category=VALUE, base-type=uint8, compu-method=CRC8
    CRC_VYAW_VEH1: category=VALUE, base-type=uint8, compu-method=CRC8
    CTR_BS_PRTNT1:
      category=VALUE
      base-type=uint8
      compu {0=KeineKommunikation (CTR_BS_PRTNT_KeineKommunikation) (BNE original name: Keine Kommunikation), 1=Kom_Parken_BN_niO (CTR_BS_PRTNT_Kom_Parken_BN_niO), 2=Kom_Parken_BN_iO (CTR_BS_PRTNT_Kom_Parken_BN_iO), 3=Kom_Standfunktionen_Kunde_nicht_im_FZG (CTR_BS_PRTNT_Kom_Standfunktionen_Kunde_nicht_im_FZG), 4=reserviert (CTR_BS_PRTNT_reserviert), 5=Kom_Wohnen (CTR_BS_PRTNT_Kom_Wohnen), 6=reserviert_bne_95F305A59796464C872A83A9688DA49E_6 (CTR_BS_PRTNT_reserviert_bne_95F305A59796464C872A83A9688DA49E_6) (BNE original name: reserviert), 7=Kom_Pruefen_Analyse_Diagnose (CTR_BS_PRTNT_Kom_Pruefen_Analyse_Diagnose), 8=Kom_Fahrbereitschaft_herstellen (CTR_BS_PRTNT_Kom_Fahrbereitschaft_herstellen), 9=reserviert_bne_95F305A59796464C872A83A9688DA49E_9 (CTR_BS_PRTNT_reserviert_bne_95F305A59796464C872A83A9688DA49E_9) (BNE original name: reserviert), 10=Kom_Fahren (CTR_BS_PRTNT_Kom_Fahren), 11=reserviert_bne_95F305A59796464C872A83A9688DA49E_11 (CTR_BS_PRTNT_reserviert_bne_95F305A59796464C872A83A9688DA49E_11) (BNE original name: reserviert), 12=Kom_Fahrbereitschaft_beenden (CTR_BS_PRTNT_Kom_Fahrbereitschaft_beenden), 13=reserviert_bne_95F305A59796464C872A83A9688DA49E_13 (CTR_BS_PRTNT_reserviert_bne_95F305A59796464C872A83A9688DA49E_13) (BNE original name: reserviert), 14=reserviert_bne_95F305A59796464C872A83A9688DA49E_14 (CTR_BS_PRTNT_reserviert_bne_95F305A59796464C872A83A9688DA49E_14) (BNE original name: reserviert), 15=Signal_unbefuellt (CTR_BS_PRTNT_Signal_unbefuellt)}
    CTR_DEAC_EPS_FNS: category=VALUE, base-type=uint8, compu-method=CTR_DEAC_EPS_FNS
    CTR_DEAC_EPS_FNS1: category=VALUE, base-type=uint8, compu-method=CTR_DEAC_EPS_FNS
    CTR_FKTN_PRTNT1: category=VALUE, base-type=uint32
    CTR_WARN_DIR_VIB_EPS: category=VALUE, base-type=uint8, compu-method=CTR_WARN_DIR_VIB_EPS, range raw 0..3, invalid-value=3
    CTR_WARN_DIR_VIB_EPS1: category=VALUE, base-type=uint8, compu-method=CTR_WARN_DIR_VIB_EPS, range raw 0..3, invalid-value=3
    CTR_WARN_ILVL_VIB_EPS: category=VALUE, base-type=uint8, compu-method=CTR_WARN_ILVL_VIB_EPS, range raw 0..15, invalid-value=15
    CTR_WARN_ILVL_VIB_EPS1: category=VALUE, base-type=uint8, compu-method=CTR_WARN_ILVL_VIB_EPS, range raw 0..15, invalid-value=15
    CTR_WARN_PTRN_VIB_EPS: category=VALUE, base-type=uint8, compu-method=CTR_WARN_PTRN_VIB_EPS, range raw 0..15, invalid-value=15
    CTR_WARN_PTRN_VIB_EPS1: category=VALUE, base-type=uint8, compu-method=CTR_WARN_PTRN_VIB_EPS, range raw 0..15, invalid-value=15
    DBG_EPS_BS_MOD_58_BYTE_ID2: category=VALUE, base-type=uint8
    DBG_EPS_MOD_EXT_120_BYTE: category=VALUE, base-type=uint8, compu {identical}, range phys 0..255
    DBG_EPS_MOD_EXT_120_BYTE_ID2: category=VALUE, base-type=uint8
    DrvgDynIfSt1: category=VALUE, base-type=uint8, sw-calibration-access=READ-ONLY, compu {32=DRVGDYNIFST_IFAVLRDYFOROPERWOADDLDAMPG, 33=DRVGDYNIFST_IFACTVADDLDAMPGNOTAVL, 34=DRVGDYNIFST_IFAVLRDYFOROPERADDLDAMPG, 35=DRVGDYNIFST_IFACTVADDLDAMPGAVL, 96=DRVGDYNIFST_SRVNOTAVLERR, 128=DRVGDYNIFST_IFINID, 224=DRVGDYNIFST_SRVNOTAVLSTBPMA, 225=DRVGDYNIFST_SRVNOTAVLSTBEPSSTS, 255=DRVGDYNIFST_INVLDSIG}, type-emitter=RTE
    DT_EST_dummy_12_15: category=VALUE, base-type=uint8, compu {identical}
    DT_EST_dummy_12_151: category=VALUE, base-type=uint8, compu {identical}
    DT_EST_dummy_16_47: category=VALUE, base-type=uint32, compu {identical}
    DT_EST_dummy_16_471: category=VALUE, base-type=uint32, compu {identical}
    DT_EST_dummy_64_95: category=VALUE, base-type=uint32, compu {identical}
    DT_EST_dummy_64_951: category=VALUE, base-type=uint32, compu {identical}
    DT_EST_dummy_96_127: category=VALUE, base-type=uint32, compu {identical}
    DT_EST_dummy_96_1271: category=VALUE, base-type=uint32, compu {identical}
    ECU_TEMP_EPS: category=VALUE, base-type=uint8, compu {identical}, range phys 0..255
    ENERG_AVAI_ARS: category=VALUE, base-type=uint8, compu-method=ENERG_AVAI_ARS
    ENERG_AVAI_ARS1: category=VALUE, base-type=uint8, compu-method=ENERG_AVAI_ARS
    ENERG_DGR_DRDY_dummy_12_15: category=VALUE, base-type=uint8, compu {identical}
    ENERG_DGR_DRDY_dummy_12_151: category=VALUE, base-type=uint8, compu {identical}
    ESTIMD_PEAK_MOT_CURR_EPS: category=VALUE, base-type=uint32, compu {identical}, range phys 0..4294967295
    FACT_ASS_STMOM_FTAX: category=VALUE, base-type=uint8, compu {phys=raw/256+1 for raw -256..64768}
    FACT_ASS_STMOM_FTAX1: category=VALUE, base-type=uint8, compu {phys=raw/256+1 for raw -256..64768}
    FACT_CTRR_STMOM_FTAX: category=VALUE, base-type=uint8, compu {phys=raw/256+0.0078125 for raw -2..65022}
    FACT_CTRR_STMOM_FTAX1: category=VALUE, base-type=uint8, compu {phys=raw/256+0.0078125 for raw -2..65022}
    FACT_DMPNG_ADDON_STMOM_FTAX: category=VALUE, base-type=uint8, compu-method=FACT_DMPNG_ADDON_STMOM_FTAX
    FACT_DMPNG_ADDON_STMOM_FTAX1: category=VALUE, base-type=uint8, compu-method=FACT_DMPNG_ADDON_STMOM_FTAX
    FACT_DMPNG_STMOM_FTAX: category=VALUE, base-type=uint8, compu {phys=raw/256+0.0078125 for raw -2..65022}
    FACT_DMPNG_STMOM_FTAX1: category=VALUE, base-type=uint8, compu {phys=raw/256+0.0078125 for raw -2..65022}
    FACT_MO_STE_SO_DXP: category=VALUE, base-type=uint8, compu-method=FACT_MO_STE_SO_DXP, range phys 0..250, invalid-value=255
    FACT_MO_STE_SO_DXP1: category=VALUE, base-type=uint8, compu-method=FACT_MO_STE_SO_DXP, range phys 0..250, invalid-value=255
    HaptcFbSt1: category=VALUE, base-type=uint8, sw-calibration-access=READ-ONLY, compu {1=HAPTCFBST_FCTAVLNOTACTV, 6=HAPTCFBST_ERR, 9=HAPTCFBST_FCTAVLACTV, 14=HAPTCFBST_FCTNOTAVL, 15=HAPTCFBST_INVLDSIG}, type-emitter=RTE
    IDX_TORQ_SEN1: category=VALUE, base-type=uint8, compu {0=Initialisierung (IDX_TORQ_SEN_Initialisierung), 1=KeineIndexFlanke (IDX_TORQ_SEN_KeineIndexFlanke) (BNE original name: Keine Index Flanke), 2=IndexFlanke (IDX_TORQ_SEN_IndexFlanke) (BNE original name: Index Flanke), 3=SignalUngueltig (IDX_TORQ_SEN_SignalUngueltig) (BNE original name: Signal ungültig)}
    MAX_I_LD_SPEC_ARS: category=VALUE, base-type=uint8, compu-method=I_SPEC_ARS
    MAX_I_LD_SPEC_ARS1: category=VALUE, base-type=uint8, compu-method=I_SPEC_ARS
    MAX_I_RECUP_SPEC_ARS: category=VALUE, base-type=uint8, compu-method=MIN_I_SPEC_ARS
    MAX_I_RECUP_SPEC_ARS1: category=VALUE, base-type=uint8, compu-method=MIN_I_SPEC_ARS
    MAX_I_SPEC_BAX_STE: category=VALUE, base-type=uint8, compu-method=I_SPEC_ARS
    MAX_I_SPEC_BAX_STE1: category=VALUE, base-type=uint8, compu-method=I_SPEC_ARS
    MAX_I_SPEC_EPS: category=VALUE, base-type=uint8, compu-method=I_SPEC_ARS
    MAX_I_SPEC_EPS1: category=VALUE, base-type=uint8, compu-method=I_SPEC_ARS
    MILE_KM: category=VALUE, base-type=uint32, compu-method=MILE_KM, data-constr=MILE_KM, invalid-value=16777215
    MILE_KM1: category=VALUE, base-type=uint32, compu-method=MILE_KM, data-constr=MILE_KM, invalid-value=16777215
    MOT_FET_TEMP_EPS: category=VALUE, base-type=uint8, compu {identical}, range phys 0..255
    MOT_MAG_TEMP_EPS: category=VALUE, base-type=uint8, compu {identical}, range phys 0..255
    MOT_TQ_CMD_EPS: category=VALUE, base-type=uint16, compu {identical}, range phys 0..65535
    MOT_TQ_CMD_LIMD_EPS: category=VALUE, base-type=uint16, compu {identical}, range phys 0..65535
    MOT_VEL_EPS: category=VALUE, base-type=uint16, compu {identical}, range phys 0..65535
    MOT_WIDG_TEMP_EPS: category=VALUE, base-type=uint16, compu {identical}, range phys 0..65535
    NO_CC_EPS1: category=VALUE, base-type=uint16
    NO_CC_EPS1_01: category=VALUE, base-type=uint16, compu {identical}
    NO_VECH_1: category=ARRAY
      element Element: array-size=1, array-size-semantics=FIXED-SIZE, implementation-data-type=uint8
    NO_VECH_2: category=ARRAY
      element Element: array-size=1, array-size-semantics=FIXED-SIZE, implementation-data-type=uint8
    NO_VECH_3: category=ARRAY
      element Element: array-size=1, array-size-semantics=FIXED-SIZE, implementation-data-type=uint8
    NO_VECH_4: category=ARRAY
      element Element: array-size=1, array-size-semantics=FIXED-SIZE, implementation-data-type=uint8
    NO_VECH_5: category=ARRAY
      element Element: array-size=1, array-size-semantics=FIXED-SIZE, implementation-data-type=uint8
    NO_VECH_6: category=ARRAY
      element Element: array-size=1, array-size-semantics=FIXED-SIZE, implementation-data-type=uint8
    NO_VECH_7: category=ARRAY
      element Element: array-size=1, array-size-semantics=FIXED-SIZE, implementation-data-type=uint8
    OFFS_GRD_MID_EPS1: category=VALUE, base-type=uint16
    OFFS_GRD_MID_EPS1_01: category=VALUE, base-type=uint16, compu {phys=raw*0.0439453125-89.95605469 for raw 2047..95208.24444444444}
    OFFS_QUAD_RTR_EPS1: category=VALUE, base-type=uint8
    PRIM_HW_TQ_SNSR_VLTG_EPS: category=VALUE, base-type=uint8, compu {identical}, range phys 0..255
    QU_ACLNY_COG: category=VALUE, base-type=uint8, compu-method=QU_ACLNY_COG
    QU_ACLNY_COG1: category=VALUE, base-type=uint8, compu-method=QU_ACLNY_COG
    QU_AVL_FORC_GRD: category=VALUE, base-type=uint8, compu-method=QU_AVL_FORC_GRD
    QU_AVL_FORC_GRD1: category=VALUE, base-type=uint8, compu-method=QU_AVL_FORC_GRD
    QU_AVL_I_ACT_EST: category=VALUE, base-type=uint8, compu-method=QU_SUM_AVL_I_DRDY_SFY
    QU_AVL_I_ACT_EST1: category=VALUE, base-type=uint8, compu-method=QU_SUM_AVL_I_DRDY_SFY
    QU_AVL_PO_EPS1:
      category=VALUE
      base-type=uint8
      compu {8=Initialisierung (QU_AVL_PINA_EPS_Initialisierung) (Nach jedem Reset und Aufstarten des EPS-Steuergeräts. Nutzsignal wird permanent mit Nutzwert 0 befüllt.), 1=SignalwertIstGueltigUndAbgesichertUndPlausibilisiert (QU_AVL_PINA_EPS_SignalwertIstGueltigUndAbgesichertUndPlausibilisiert) (BNE original name: Signalwert ist gültig und abgesichert und plausibilisiert), 2=SignalwertIstGueltig (QU_AVL_PINA_EPS_SignalwertIstGueltig) (BNE original name: Signalwert ist gültig), 4=ErsatzwertIstImNutzsignalGesetzt (QU_AVL_PINA_EPS_ErsatzwertIstImNutzsignalGesetzt) (BNE original name: Ersatzwert ist im Nutzsignal gesetzt), 9=SignalwertIstGueltigZustandSlashStatusTemporaer_mittlereSignalqualitaet_ (QU_AVL_PINA_EPS_SignalwertIstGueltigZustandSlashStatusTemporaer_mittlereSignalqualitaet_) (BNE original name: Signalwert ist gültig, Zustand/Status temporär (mittlere Signalqualität)), 10=SignalwertIstGueltigZustandSlashStatusTemporaer_geringeSignalqualitaet_ (QU_AVL_PINA_EPS_SignalwertIstGueltigZustandSlashStatusTemporaer_geringeSignalqualitaet_) (BNE original name: Signalwert ist gültig, Zustand/Status temporär (geringe Signalqualität)), 12=AbgleichwertIstImNutzsignalGesetztZustandSlashStatusTemporaer (QU_AVL_PINA_EPS_AbgleichwertIstImNutzsignalGesetztZustandSlashStatusTemporaer) (BNE original name: Abgleichwert ist im Nutzsignal gesetzt, Zustand/Status temporär), 14=SignalwertIstUngueltigZustandSlashStatusTemporaer (QU_AVL_PINA_EPS_SignalwertIstUngueltigZustandSlashStatusTemporaer) (BNE original name: Signalwert ist ungültig, Zustand/Status temporär), 15=SignalUngueltig (QU_AVL_PINA_EPS_SignalUngueltig) (BNE original name: Signal ungültig)}
    QU_AVL_STMOM_DV_ACT: category=VALUE, base-type=uint8, compu-method=QU_AVL_STMOM_DV_ACT
    QU_AVL_STMOM_DV_ACT1: category=VALUE, base-type=uint8, compu-method=QU_AVL_STMOM_DV_ACT
    QU_DGR_AISP_ENERG: category=VALUE, base-type=uint8, compu-method=QU_DGR_AISP_ENERG
    QU_DGR_AISP_ENERG1: category=VALUE, base-type=uint8, compu-method=QU_DGR_AISP_ENERG
    QU_FN_EST: category=VALUE, base-type=uint8, compu-method=QU_FN_EST
    QU_FN_EST1: category=VALUE, base-type=uint8, compu-method=QU_FN_EST
    QU_FN_VIB_EPS: category=VALUE, base-type=uint8, compu-method=QU_FN_VIB_EPS
    QU_FN_VIB_EPS1: category=VALUE, base-type=uint8, compu-method=QU_FN_VIB_EPS
    QU_SER_STMOM_DV_ACT: category=VALUE, base-type=uint8, compu-method=QU_SER_STMOM_STMOM_DV_ACT
    QU_SER_STMOM_DV_ACT1: category=VALUE, base-type=uint8, compu-method=QU_SER_STMOM_STMOM_DV_ACT
    QU_ST_CON_VEH1:
      category=VALUE
      base-type=uint8
      compu {2=SignalwertGueltig (QU_ST_CON_VEH_SignalwertGueltig) (BNE original name: Signalwert gültig), 3=SignalwertEingeschraenktGueltig (QU_ST_CON_VEH_SignalwertEingeschraenktGueltig) (BNE original name: Signalwert eingeschränkt gültig), 6=ReserviertFuerDieNichtUmgesetzteKennung_Fehler_ (QU_ST_CON_VEH_ReserviertFuerDieNichtUmgesetzteKennung_Fehler_) (BNE original name: Reserviert für die nicht umgesetzte Kennung "Fehler"), 14=Wert_nicht_verfuegbar (QU_ST_CON_VEH_Wert_nicht_verfuegbar) (Siehe Signalbeschreibung), 15=SignalUnbefuellt (QU_ST_CON_VEH_SignalUnbefuellt) (BNE original name: Signal unbefüllt)}
    QU_TAR_DMPNG_ADDON_STMOM_FTAX: category=VALUE, base-type=uint8, compu-method=QU_TAR_DMPNG_ADDON_STMOM_FTAX
    QU_TAR_DMPNG_ADDON_STMOM_FTAX1: category=VALUE, base-type=uint8, compu-method=QU_TAR_DMPNG_ADDON_STMOM_FTAX
    QU_TAR_FACT_STMOM_FTAX: category=VALUE, base-type=uint8, compu-method=QU_TAR_FACT_STMOM_FTAX
    QU_TAR_FACT_STMOM_FTAX1: category=VALUE, base-type=uint8, compu-method=QU_TAR_FACT_STMOM_FTAX
    QU_TAR_QTA_STMOM_DV: category=VALUE, base-type=uint8, compu-method=QU_TAR_QTA_STMOM_DV
    QU_TAR_QTA_STMOM_DV1: category=VALUE, base-type=uint8, compu-method=QU_TAR_QTA_STMOM_DV
    QU_TAR_STMOM_DV_ACT: category=VALUE, base-type=uint8, compu-method=QU_TAR_STMOM_DV_ACT
    QU_TAR_STMOM_DV_ACT1: category=VALUE, base-type=uint8, compu-method=QU_TAR_STMOM_DV_ACT
    QU_V_VEH_COG1:
      category=VALUE
      base-type=uint8
      compu {8=Initialisierung (QU_V_VEH_COG_Initialisierung) (Tritt während der Initialisierungsphase auf bis Ist-Wert verfügbar (Vorbefüllung). Nutzsignal wird permanent mit Nutzwert 0 befüllt.), 1=SignalwertIstGueltigUndAbgesichertUndPlausibilisiert (QU_V_VEH_COG_SignalwertIstGueltigUndAbgesichertUndPlausibilisiert) (BNE original name: Signalwert ist gültig und abgesichert und plausibilisiert), 9=Reserved (QU_V_VEH_COG_Reserved), 2=Reserved_bne_C9CB853E97D84E34ADF2107B01966081_2 (QU_V_VEH_COG_Reserved_bne_C9CB853E97D84E34ADF2107B01966081_2) (BNE original name: Reserved), 10=SignalwertIstGueltigZustandSlashStatusTemporaer (QU_V_VEH_COG_SignalwertIstGueltigZustandSlashStatusTemporaer) (BNE original name: Signalwert ist gültig, Zustand/Status temporär), 3=Reserved_bne_C9CB853E97D84E34ADF2107B01966081_3 (QU_V_VEH_COG_Reserved_bne_C9CB853E97D84E34ADF2107B01966081_3) (BNE original name: Reserved), 11=SignalqualitaetBzwDotUeberwachungEingeschraenktZustandSlashStatusTemporaer (QU_V_VEH_COG_SignalqualitaetBzwDotUeberwachungEingeschraenktZustandSlashStatusTemporaer) (BNE original name: Signalqualität bzw. Überwachung eingeschränkt, Zustand/Status temporär), 4=Reserved_bne_C9CB853E97D84E34ADF2107B01966081_4 (QU_V_VEH_COG_Reserved_bne_C9CB853E97D84E34ADF2107B01966081_4) (BNE original name: Reserved), 12=Reserved_bne_C9CB853E97D84E34ADF2107B01966081_12 (QU_V_VEH_COG_Reserved_bne_C9CB853E97D84E34ADF2107B01966081_12) (BNE original name: Reserved), 6=Reserved_bne_C9CB853E97D84E34ADF2107B01966081_6 (QU_V_VEH_COG_Reserved_bne_C9CB853E97D84E34ADF2107B01966081_6) (BNE original name: Reserved), 14=SignalwertIstUngueltigZustandSlashStatusTemporaer (QU_V_VEH_COG_SignalwertIstUngueltigZustandSlashStatusTemporaer) (BNE original name: Signalwert ist ungültig, Zustand/Status temporär), 7=Reserved_bne_C9CB853E97D84E34ADF2107B01966081_7 (QU_V_VEH_COG_Reserved_bne_C9CB853E97D84E34ADF2107B01966081_7) (BNE original name: Reserved), 15=SignalUngueltig (QU_V_VEH_COG_SignalUngueltig) (BNE original name: Signal ungültig)}
    QU_VYAW_VEH: category=VALUE, base-type=uint8, compu-method=QU_VYAW_VEH
    QU_VYAW_VEH1: category=VALUE, base-type=uint8, compu-method=QU_VYAW_VEH
    RQ_CULI_EST_SFY: category=VALUE, base-type=uint8, compu-method=RQ_CULI_EST_SFY
    RQ_CULI_EST_SFY1: category=VALUE, base-type=uint8, compu-method=RQ_CULI_EST_SFY
    SECDRY_HW_TQ_SNSR_VLTG_EPS: category=VALUE, base-type=uint8, compu {identical}, range phys 0..255
    sigGroup_ACLNY_MASSCNTR: category=STRUCTURE, dynamic-array-size-profile=None
      6 x element, all with category=TYPE_REFERENCE:
        ACLNY_MASSCNTR_dummy_12_15: range phys 0..15, implementation-data-type=ACLNY_MASSCNTR_dummy_12_15
        CRC_ACLNY_COG: data-constr=CRC8, implementation-data-type=CRC_ACLNY_COG
        ACLNY_COG_ERR_AMP: range phys 0..4000, implementation-data-type=ACLNY_COG_ERR_AMP
        QU_ACLNY_COG: range raw 0..15, implementation-data-type=QU_ACLNY_COG
        ACLNY_COG: data-constr=ACLNY_COG, implementation-data-type=ACLNY_COG
        ALIV_ACLNY_COG: range raw 0..15, implementation-data-type=ALIV_ACLNY_COG
    sigGroup_ACLNY_MASSCNTR1: category=STRUCTURE, dynamic-array-size-profile=None
      6 x element, all with category=TYPE_REFERENCE:
        ACLNY_MASSCNTR_dummy_12_15: range phys 0..15, implementation-data-type=ACLNY_MASSCNTR_dummy_12_151
        ACLNY_COG: data-constr=ACLNY_COG, implementation-data-type=ACLNY_COG1
        QU_ACLNY_COG: range raw 0..15, implementation-data-type=QU_ACLNY_COG1
        ACLNY_COG_ERR_AMP: range phys 0..4000, implementation-data-type=ACLNY_COG_ERR_AMP1
        ALIV_ACLNY_COG: range raw 0..15, implementation-data-type=ALIV_ACLNY_COG1
        CRC_ACLNY_COG: data-constr=CRC8, implementation-data-type=CRC_ACLNY_COG1
    sigGroup_AVL_FORC_GRD: category=STRUCTURE, dynamic-array-size-profile=None
      6 x element, all with category=TYPE_REFERENCE:
        QU_AVL_FORC_GRD: range raw 0..15, implementation-data-type=QU_AVL_FORC_GRD
        AVL_FORC_GRD_dummy_12_15: range phys 0..15, implementation-data-type=AVL_FORC_GRD_dummy_12_15
        ALIV_AVL_FORC_GRD: range raw 0..15, implementation-data-type=ALIV_AVL_FORC_GRD
        CRC_AVL_FORC_GRD: data-constr=CRC8, implementation-data-type=CRC_AVL_FORC_GRD
        AVL_FORC_GRD: range phys 0..4047.619, implementation-data-type=AVL_FORC_GRD
        AVL_PWR_EL_EPS_COOD: range phys 0..240, implementation-data-type=AVL_PWR_EL_EPS_COOD
    sigGroup_AVL_FORC_GRD1: category=STRUCTURE, dynamic-array-size-profile=None
      6 x element, all with category=TYPE_REFERENCE:
        AVL_FORC_GRD: range phys 0..4047.619, implementation-data-type=AVL_FORC_GRD1
        AVL_PWR_EL_EPS_COOD: range phys 0..240, implementation-data-type=AVL_PWR_EL_EPS_COOD1
        ALIV_AVL_FORC_GRD: range raw 0..15, implementation-data-type=ALIV_AVL_FORC_GRD1
        CRC_AVL_FORC_GRD: data-constr=CRC8, implementation-data-type=CRC_AVL_FORC_GRD1
        QU_AVL_FORC_GRD: range raw 0..15, implementation-data-type=QU_AVL_FORC_GRD1
        AVL_FORC_GRD_dummy_12_15: range phys 0..15, implementation-data-type=AVL_FORC_GRD_dummy_12_151
    sigGroup_AVL_PO_EPS1: category=STRUCTURE, dynamic-array-size-profile=None
      8 x element, all with category=TYPE_REFERENCE:
        AVL_PO_EPS: range phys 0..65534, implementation-data-type=AVL_PO_EPS1
        IDX_TORQ_SEN: range raw 0..3, implementation-data-type=IDX_TORQ_SEN1
        OFFS_GRD_MID_EPS: range phys 0..4094, implementation-data-type=OFFS_GRD_MID_EPS1
        AVL_PO_IDX_EPS: range phys 0..65534, implementation-data-type=AVL_PO_IDX_EPS1
        CRC_AVL_PO_EPS: data-constr=CRC8, implementation-data-type=CRC_AVL_PO_EPS1
        QU_AVL_PO_EPS: range raw 0..15, implementation-data-type=QU_AVL_PO_EPS1
        ALIV_AVL_PO_EPS: range raw 0..15, implementation-data-type=ALIV_AVL_PO_EPS1
        UN_PO_EPS: range raw 0..3, implementation-data-type=UN_PO_EPS1
    sigGroup_AVL_STMOM_DV_ACT: category=STRUCTURE, dynamic-array-size-profile=None
      5 x element, all with category=TYPE_REFERENCE:
        CRC_AVL_STMOM_DV_ACT: data-constr=CRC8, implementation-data-type=CRC_AVL_STMOM_DV_ACT
        QU_AVL_STMOM_DV_ACT: range raw 0..15, implementation-data-type=QU_AVL_STMOM_DV_ACT
        ALIV_AVL_STMOM_DV_ACT: range raw 0..15, implementation-data-type=ALIV_AVL_STMOM_DV_ACT
        AVL_STMOM_DV_ACT_dummy_12_15: range phys 0..15, implementation-data-type=AVL_STMOM_DV_ACT_dummy_12_15
        AVL_STMOM_DV_ACT: range phys 0..4000, implementation-data-type=AVL_STMOM_DV_ACT
    sigGroup_AVL_STMOM_DV_ACT1: category=STRUCTURE, dynamic-array-size-profile=None
      5 x element, all with category=TYPE_REFERENCE:
        AVL_STMOM_DV_ACT: range phys 0..4000, implementation-data-type=AVL_STMOM_DV_ACT1
        ALIV_AVL_STMOM_DV_ACT: range raw 0..15, implementation-data-type=ALIV_AVL_STMOM_DV_ACT1
        QU_AVL_STMOM_DV_ACT: range raw 0..15, implementation-data-type=QU_AVL_STMOM_DV_ACT1
        CRC_AVL_STMOM_DV_ACT: data-constr=CRC8, implementation-data-type=CRC_AVL_STMOM_DV_ACT1
        AVL_STMOM_DV_ACT_dummy_12_15: range phys 0..15, implementation-data-type=AVL_STMOM_DV_ACT_dummy_12_151
    sigGroup_CON_VEH1: category=STRUCTURE, dynamic-array-size-profile=None
      7 x element, all with category=TYPE_REFERENCE:
        CTR_FKTN_PRTNT: implementation-data-type=CTR_FKTN_PRTNT1
        QU_ST_CON_VEH: range raw 0..15, implementation-data-type=QU_ST_CON_VEH1
        CRC_CON_VEH: data-constr=CRC8, implementation-data-type=CRC_CON_VEH1
        ST_CON_VEH: range raw 0..15, implementation-data-type=ST_CON_VEH1
        CTR_BS_PRTNT: range raw 0..15, implementation-data-type=CTR_BS_PRTNT1
        ALIV_CON_VEH: range phys 0..14, implementation-data-type=ALIV_CON_VEH1
        CON_VEH_dummy_56_63: range phys 0..255, implementation-data-type=CON_VEH_dummy_56_631
    sigGroup_DISP_CC_EPS1: category=STRUCTURE, dynamic-array-size-profile=None
      7 x element, all with category=TYPE_REFERENCE:
        ST_CC_EPS: range raw 0..3, implementation-data-type=ST_CC_EPS1
        ALIV_DISP_CC_EPS: range phys 0..14, implementation-data-type=ALIV_DISP_CC_EPS1
        ST_IDC_CC_EPS: range raw 0..3, implementation-data-type=ST_IDC_CC_EPS1
        CRC_DISP_CC_EPS: data-constr=CRC8, implementation-data-type=CRC_DISP_CC_EPS1
        CHL_DISP_CC_EPS: range phys 0..14, implementation-data-type=CHL_DISP_CC_EPS1
        NO_CC_EPS: range phys 0..65534, implementation-data-type=NO_CC_EPS1
        TRANF_CC_EPS: range phys 0..14, implementation-data-type=TRANF_CC_EPS1
    sigGroup_DT_EST: category=STRUCTURE, dynamic-array-size-profile=None
      9 x element, all with category=TYPE_REFERENCE:
        CRC_DT_EST: data-constr=CRC8, implementation-data-type=CRC_DT_EST
        QU_AVL_I_ACT_EST: range raw 0..15, implementation-data-type=QU_AVL_I_ACT_EST
        ST_CULI_EST: range raw 0..15, implementation-data-type=ST_CULI_EST
        AVL_I_ACT_EST: range phys 0..252, implementation-data-type=AVL_I_ACT_EST
        DT_EST_dummy_16_47: range phys 0..4294967295, implementation-data-type=DT_EST_dummy_16_47
        DT_EST_dummy_12_15: range phys 0..15, implementation-data-type=DT_EST_dummy_12_15
        DT_EST_dummy_64_95: range phys 0..4294967295, implementation-data-type=DT_EST_dummy_64_95
        ALIV_DT_EST: range phys 0..14, implementation-data-type=ALIV_DT_EST
        DT_EST_dummy_96_127: range phys 0..4294967295, implementation-data-type=DT_EST_dummy_96_127
    sigGroup_DT_EST1: category=STRUCTURE, dynamic-array-size-profile=None
      9 x element, all with category=TYPE_REFERENCE:
        ST_CULI_EST: range raw 0..15, implementation-data-type=ST_CULI_EST1
        DT_EST_dummy_64_95: range phys 0..4294967295, implementation-data-type=DT_EST_dummy_64_951
        QU_AVL_I_ACT_EST: range raw 0..15, implementation-data-type=QU_AVL_I_ACT_EST1
        DT_EST_dummy_12_15: range phys 0..15, implementation-data-type=DT_EST_dummy_12_151
        AVL_I_ACT_EST: range phys 0..252, implementation-data-type=AVL_I_ACT_EST1
        ALIV_DT_EST: range phys 0..14, implementation-data-type=ALIV_DT_EST1
        CRC_DT_EST: data-constr=CRC8, implementation-data-type=CRC_DT_EST1
        DT_EST_dummy_96_127: range phys 0..4294967295, implementation-data-type=DT_EST_dummy_96_1271
        DT_EST_dummy_16_47: range phys 0..4294967295, implementation-data-type=DT_EST_dummy_16_471
    sigGroup_ENERG_DGR_DRDY: category=STRUCTURE, dynamic-array-size-profile=None
      10 x element, all with category=TYPE_REFERENCE:
        MAX_I_LD_SPEC_ARS: range phys 0..252, implementation-data-type=MAX_I_LD_SPEC_ARS
        MAX_I_SPEC_BAX_STE: range phys 0..252, implementation-data-type=MAX_I_SPEC_BAX_STE
        MAX_I_SPEC_EPS: range phys 0..252, implementation-data-type=MAX_I_SPEC_EPS
        MAX_I_RECUP_SPEC_ARS: range phys 0..252, implementation-data-type=MAX_I_RECUP_SPEC_ARS
        CRC_ENERG_DGR_DRDY: data-constr=CRC8, implementation-data-type=CRC_ENERG_DGR_DRDY
        ALIV_ENERG_DGR_DRDY: range phys 0..14, implementation-data-type=ALIV_ENERG_DGR_DRDY
        QU_DGR_AISP_ENERG: range raw 0..15, implementation-data-type=QU_DGR_AISP_ENERG
        ENERG_AVAI_ARS: range phys 0..100, implementation-data-type=ENERG_AVAI_ARS
        ENERG_DGR_DRDY_dummy_12_15: range phys 0..15, implementation-data-type=ENERG_DGR_DRDY_dummy_12_15
        RQ_CULI_EST_SFY: range raw 0..15, implementation-data-type=RQ_CULI_EST_SFY
    sigGroup_ENERG_DGR_DRDY1: category=STRUCTURE, dynamic-array-size-profile=None
      10 x element, all with category=TYPE_REFERENCE:
        MAX_I_LD_SPEC_ARS: range phys 0..252, implementation-data-type=MAX_I_LD_SPEC_ARS1
        MAX_I_RECUP_SPEC_ARS: range phys 0..252, implementation-data-type=MAX_I_RECUP_SPEC_ARS1
        RQ_CULI_EST_SFY: range raw 0..15, implementation-data-type=RQ_CULI_EST_SFY1
        ALIV_ENERG_DGR_DRDY: range phys 0..14, implementation-data-type=ALIV_ENERG_DGR_DRDY1
        ENERG_AVAI_ARS: range phys 0..100, implementation-data-type=ENERG_AVAI_ARS1
        QU_DGR_AISP_ENERG: range raw 0..15, implementation-data-type=QU_DGR_AISP_ENERG1
        CRC_ENERG_DGR_DRDY: data-constr=CRC8, implementation-data-type=CRC_ENERG_DGR_DRDY1
        MAX_I_SPEC_BAX_STE: range phys 0..252, implementation-data-type=MAX_I_SPEC_BAX_STE1
        ENERG_DGR_DRDY_dummy_12_15: range phys 0..15, implementation-data-type=ENERG_DGR_DRDY_dummy_12_151
        MAX_I_SPEC_EPS: range phys 0..252, implementation-data-type=MAX_I_SPEC_EPS1
    sigGroup_OFFS_QUAD_EPS1: category=STRUCTURE, dynamic-array-size-profile=None
      5 x element, all with category=TYPE_REFERENCE:
        AVL_PO_IDX_ICM: range phys 0..65534, implementation-data-type=AVL_PO_IDX_ICM1
        ST_OFFS_QUAD_EPS: range raw 0..15, implementation-data-type=ST_OFFS_QUAD_EPS1
        CRC_OFFS_QUAD_EPS: data-constr=CRC8, implementation-data-type=CRC_OFFS_QUAD_EPS1
        OFFS_QUAD_RTR_EPS: range phys 0..254, implementation-data-type=OFFS_QUAD_RTR_EPS1
        ALIV_OFFS_QUAD_EPS: range raw 0..15, implementation-data-type=ALIV_OFFS_QUAD_EPS1
    sigGroup_ST_EST: category=STRUCTURE, dynamic-array-size-profile=None
      6 x element, all with category=TYPE_REFERENCE:
        CRC_ST_EST_FTAX: data-constr=CRC8, implementation-data-type=CRC_ST_EST_FTAX
        QU_SER_STMOM_DV_ACT: implementation-data-type=QU_SER_STMOM_DV_ACT
        QU_FN_EST: implementation-data-type=QU_FN_EST
        QU_FN_VIB_EPS: range raw 0..15, implementation-data-type=QU_FN_VIB_EPS
        ST_EST_dummy_16_23: range phys 0..255, implementation-data-type=ST_EST_dummy_16_23
        ALIV_ST_EST_FTAX: range raw 0..15, implementation-data-type=ALIV_ST_EST_FTAX
    sigGroup_ST_EST1: category=STRUCTURE, dynamic-array-size-profile=None
      6 x element, all with category=TYPE_REFERENCE:
        QU_SER_STMOM_DV_ACT: implementation-data-type=QU_SER_STMOM_DV_ACT1
        QU_FN_VIB_EPS: range raw 0..15, implementation-data-type=QU_FN_VIB_EPS1
        ST_EST_dummy_16_23: range phys 0..255, implementation-data-type=ST_EST_dummy_16_231
        ALIV_ST_EST_FTAX: range raw 0..15, implementation-data-type=ALIV_ST_EST_FTAX1
        CRC_ST_EST_FTAX: data-constr=CRC8, implementation-data-type=CRC_ST_EST_FTAX1
        QU_FN_EST: implementation-data-type=QU_FN_EST1
    sigGroup_SU_EPS: category=STRUCTURE, dynamic-array-size-profile=None
      6 x element, all with category=TYPE_REFERENCE:
        ALIV_SU_EPS: range phys 0..14, implementation-data-type=ALIV_SU_EPS
        SU_EPS_dummy_20_51: range phys 0..4294967295, implementation-data-type=SU_EPS_dummy_20_51
        CRC_SU_EPS: data-constr=CRC8, implementation-data-type=CRC_SU_EPS
        UN_TOT_STR_EPS: range raw 0..3, implementation-data-type=UN_TOT_STR_EPS
        SU_EPS_dummy_14_19: range phys 0..63, implementation-data-type=SU_EPS_dummy_14_19
        TOT_STR_EPS: range phys 0..4093.998, implementation-data-type=TOT_STR_EPS
    sigGroup_SU_EPS1: category=STRUCTURE, dynamic-array-size-profile=None
      6 x element, all with category=TYPE_REFERENCE:
        CRC_SU_EPS: data-constr=CRC8, implementation-data-type=CRC_SU_EPS1
        UN_TOT_STR_EPS: range raw 0..3, implementation-data-type=UN_TOT_STR_EPS1
        ALIV_SU_EPS: range phys 0..14, implementation-data-type=ALIV_SU_EPS1
        TOT_STR_EPS: range phys 0..4093.998, implementation-data-type=TOT_STR_EPS1
        SU_EPS_dummy_20_51: range phys 0..4294967295, implementation-data-type=SU_EPS_dummy_20_511
        SU_EPS_dummy_14_19: range phys 0..63, implementation-data-type=SU_EPS_dummy_14_191
    sigGroup_TAR_QTA_STRMOM_DV: category=STRUCTURE, dynamic-array-size-profile=None
      10 x element, all with category=TYPE_REFERENCE:
        FACT_CTRR_STMOM_FTAX: range phys 0..254, implementation-data-type=FACT_CTRR_STMOM_FTAX
        QU_TAR_QTA_STMOM_DV: range raw 0..15, implementation-data-type=QU_TAR_QTA_STMOM_DV
        CRC_TAR_QTA_STMOM_DV: data-constr=CRC8, implementation-data-type=CRC_TAR_QTA_STMOM_DV
        FACT_ASS_STMOM_FTAX: range phys 0..254, implementation-data-type=FACT_ASS_STMOM_FTAX
        FACT_DMPNG_STMOM_FTAX: range phys 0..254, implementation-data-type=FACT_DMPNG_STMOM_FTAX
        ALIV_TAR_QTA_STMOM_DV: range raw 0..15, implementation-data-type=ALIV_TAR_QTA_STMOM_DV
        TAR_QTA_STMOM_DV: range phys 0..4000, implementation-data-type=TAR_QTA_STMOM_DV
        CTR_DEAC_EPS_FNS: range raw 0..15, implementation-data-type=CTR_DEAC_EPS_FNS
        TAR_QTA_STRMOM_DV_dummy_12_15: range phys 0..15, implementation-data-type=TAR_QTA_STRMOM_DV_dummy_12_15
        QU_TAR_FACT_STMOM_FTAX: range raw 0..15, implementation-data-type=QU_TAR_FACT_STMOM_FTAX
    sigGroup_TAR_QTA_STRMOM_DV1: category=STRUCTURE, dynamic-array-size-profile=None
      10 x element, all with category=TYPE_REFERENCE:
        FACT_DMPNG_STMOM_FTAX: range phys 0..254, implementation-data-type=FACT_DMPNG_STMOM_FTAX1
        QU_TAR_QTA_STMOM_DV: range raw 0..15, implementation-data-type=QU_TAR_QTA_STMOM_DV1
        ALIV_TAR_QTA_STMOM_DV: range raw 0..15, implementation-data-type=ALIV_TAR_QTA_STMOM_DV1
        QU_TAR_FACT_STMOM_FTAX: range raw 0..15, implementation-data-type=QU_TAR_FACT_STMOM_FTAX1
        CTR_DEAC_EPS_FNS: range raw 0..15, implementation-data-type=CTR_DEAC_EPS_FNS1
        FACT_CTRR_STMOM_FTAX: range phys 0..254, implementation-data-type=FACT_CTRR_STMOM_FTAX1
        TAR_QTA_STRMOM_DV_dummy_12_15: range phys 0..15, implementation-data-type=TAR_QTA_STRMOM_DV_dummy_12_151
        FACT_ASS_STMOM_FTAX: range phys 0..254, implementation-data-type=FACT_ASS_STMOM_FTAX1
        TAR_QTA_STMOM_DV: range phys 0..4000, implementation-data-type=TAR_QTA_STMOM_DV1
        CRC_TAR_QTA_STMOM_DV: data-constr=CRC8, implementation-data-type=CRC_TAR_QTA_STMOM_DV1
    sigGroup_TAR_STMOM_DV_ACT: category=STRUCTURE, dynamic-array-size-profile=None
      8 x element, all with category=TYPE_REFERENCE:
        QU_TAR_DMPNG_ADDON_STMOM_FTAX: range raw 0..15, implementation-data-type=QU_TAR_DMPNG_ADDON_STMOM_FTAX
        ALIV_TAR_STMOM_DV_ACT: range raw 0..15, implementation-data-type=ALIV_TAR_STMOM_DV_ACT
        FACT_DMPNG_ADDON_STMOM_FTAX: range phys 0..128, implementation-data-type=FACT_DMPNG_ADDON_STMOM_FTAX
        QU_TAR_STMOM_DV_ACT: range raw 0..15, implementation-data-type=QU_TAR_STMOM_DV_ACT
        TAR_STMOM_DV_ACT_dummy_12_15: range phys 0..15, implementation-data-type=TAR_STMOM_DV_ACT_dummy_12_15
        TAR_STMOM_DV_ACT: range phys 0..4000, implementation-data-type=TAR_STMOM_DV_ACT
        CRC_TAR_STMOM_DV_ACT: data-constr=CRC8, implementation-data-type=CRC_TAR_STMOM_DV_ACT
        TAR_STMOM_DV_ACT_dummy_32_51: range phys 0..1048575, implementation-data-type=TAR_STMOM_DV_ACT_dummy_32_51
    sigGroup_TAR_STMOM_DV_ACT1: category=STRUCTURE, dynamic-array-size-profile=None
      8 x element, all with category=TYPE_REFERENCE:
        TAR_STMOM_DV_ACT_dummy_12_15: range phys 0..15, implementation-data-type=TAR_STMOM_DV_ACT_dummy_12_151
        TAR_STMOM_DV_ACT_dummy_32_51: range phys 0..1048575, implementation-data-type=TAR_STMOM_DV_ACT_dummy_32_511
        QU_TAR_DMPNG_ADDON_STMOM_FTAX: range raw 0..15, implementation-data-type=QU_TAR_DMPNG_ADDON_STMOM_FTAX1
        FACT_DMPNG_ADDON_STMOM_FTAX: range phys 0..128, implementation-data-type=FACT_DMPNG_ADDON_STMOM_FTAX1
        TAR_STMOM_DV_ACT: range phys 0..4000, implementation-data-type=TAR_STMOM_DV_ACT1
        CRC_TAR_STMOM_DV_ACT: data-constr=CRC8, implementation-data-type=CRC_TAR_STMOM_DV_ACT1
        QU_TAR_STMOM_DV_ACT: range raw 0..15, implementation-data-type=QU_TAR_STMOM_DV_ACT1
        ALIV_TAR_STMOM_DV_ACT: range raw 0..15, implementation-data-type=ALIV_TAR_STMOM_DV_ACT1
    sigGroup_VYAW_VEH: category=STRUCTURE, dynamic-array-size-profile=None
      6 x element, all with category=TYPE_REFERENCE:
        VYAW_VEH_ERR_AMP: data-constr=VYAW_VEH_ERR_AMP, implementation-data-type=VYAW_VEH_ERR_AMP
        CRC_VYAW_VEH: data-constr=CRC8, implementation-data-type=CRC_VYAW_VEH
        ALIV_VYAW_VEH: range raw 0..15, implementation-data-type=ALIV_VYAW_VEH
        QU_VYAW_VEH: range raw 0..15, implementation-data-type=QU_VYAW_VEH
        VYAW_VEH_dummy_12_15: range phys 0..15, implementation-data-type=VYAW_VEH_dummy_12_15
        VYAW_VEH: data-constr=VYAW_VEH, implementation-data-type=VYAW_VEH
    sigGroup_VYAW_VEH1: category=STRUCTURE, dynamic-array-size-profile=None
      6 x element, all with category=TYPE_REFERENCE:
        QU_VYAW_VEH: range raw 0..15, implementation-data-type=QU_VYAW_VEH1
        VYAW_VEH_ERR_AMP: data-constr=VYAW_VEH_ERR_AMP, implementation-data-type=VYAW_VEH_ERR_AMP1
        VYAW_VEH: data-constr=VYAW_VEH, implementation-data-type=VYAW_VEH1
        VYAW_VEH_dummy_12_15: range phys 0..15, implementation-data-type=VYAW_VEH_dummy_12_151
        CRC_VYAW_VEH: data-constr=CRC8, implementation-data-type=CRC_VYAW_VEH1
        ALIV_VYAW_VEH: range raw 0..15, implementation-data-type=ALIV_VYAW_VEH1
    ST_ANO_MSA_ENG_STOP: category=VALUE, base-type=uint8, compu-method=ST_ANO_MSA_ENG_STOP, range raw 0..3, invalid-value=3
    ST_ANO_MSA_ENG_STOP1: category=VALUE, base-type=uint8, compu-method=ST_ANO_MSA_ENG_STOP, range raw 0..3, invalid-value=3
    ST_CC_EPS1: category=VALUE, base-type=uint8, compu {0=Ruecksetzen (ST_CC_EPS_Ruecksetzen) (BNE original name: Rücksetzen), 1=Setzen (ST_CC_EPS_Setzen) (CC-message display), 3=SignalUngueltig (ST_CC_EPS_SignalUngueltig) (BNE original name: Signal ungültig)}
    ST_CENG_DRV: category=VALUE, base-type=uint8, compu-method=ST_CENG_DRV, range raw 0..15, invalid-value=15
    ST_CENG_DRV1: category=VALUE, base-type=uint8, compu-method=ST_CENG_DRV, range raw 0..15, invalid-value=15
    ST_CON_VEH_EPS: category=VALUE, base-type=uint8, compu {identical}, range phys 0..255
    ST_CON_VEH1:
      category=VALUE
      base-type=uint8
      compu {0=reserviert (ST_CON_VEH_reserviert), 1=Parken_BN_niO (ST_CON_VEH_Parken_BN_niO), 2=Parken_BN_iO (ST_CON_VEH_Parken_BN_iO), 3=Standfunktionen_Kunde_nicht_im_FZG (ST_CON_VEH_Standfunktionen_Kunde_nicht_im_FZG), 5=Wohnen (ST_CON_VEH_Wohnen), 7=Pruefen_Analyse_Diagnose (ST_CON_VEH_Pruefen_Analyse_Diagnose), 8=Fahrbereitschaft_herstellen (ST_CON_VEH_Fahrbereitschaft_herstellen), 10=Fahren (ST_CON_VEH_Fahren), 12=Fahrbereitschaft_beenden (ST_CON_VEH_Fahrbereitschaft_beenden), 13=reserviert_bne_E673DEE4F91F432391662F6004C0175A_13 (ST_CON_VEH_reserviert_bne_E673DEE4F91F432391662F6004C0175A_13) (BNE original name: reserviert), 14=reserviert_bne_E673DEE4F91F432391662F6004C0175A_14 (ST_CON_VEH_reserviert_bne_E673DEE4F91F432391662F6004C0175A_14) (BNE original name: reserviert), 15=Signal_unbefuellt (ST_CON_VEH_Signal_unbefuellt)}
    ST_CULI_EST: category=VALUE, base-type=uint8, compu-method=ST_CULI_EST
    ST_CULI_EST1: category=VALUE, base-type=uint8, compu-method=ST_CULI_EST
    ST_ENERG_FZM1:
      category=VALUE
      base-type=uint8
      compu {0=ENSTATE_GOOD (ST_ENERG_FZM_ENSTATE_GOOD), 1=ENSTATE_OK (ST_ENERG_FZM_ENSTATE_OK), 2=ENSTATE_SHORTAGE (ST_ENERG_FZM_ENSTATE_SHORTAGE), 3=ENSTATE_SEVERE_SHORTAGE (ST_ENERG_FZM_ENSTATE_SEVERE_SHORTAGE), 15=SignalUngueltig (ST_ENERG_FZM_SignalUngueltig) (BNE original name: Signal ungültig)} "Transp.MOST-GW-Migration, 01.09.2006: Zusammenführung der Signalklasse Status_Energie_FZM [1] mit den Parametern EnergyStatus [2]."
      range raw 0..15
      invalid-value=15
    ST_ENERG_SUPY: category=VALUE, base-type=uint8, compu-method=ST_ENERG_SUPY, invalid-value=255
    ST_ENERG_SUPY1: category=VALUE, base-type=uint8, compu-method=ST_ENERG_SUPY, invalid-value=255
    ST_EST_dummy_16_23: category=VALUE, base-type=uint8, compu {identical}
    ST_EST_dummy_16_231: category=VALUE, base-type=uint8, compu {identical}
    ST_IDC_CC_EPS1: category=VALUE, base-type=uint8, compu {0=KeinBlinken (ST_IDC_CC_EPS_KeinBlinken) (BNE original name: Kein Blinken), 1=LangsamesBlinken (ST_IDC_CC_EPS_LangsamesBlinken) (BNE original name: Langsames Blinken), 2=SchnellesBlinken (ST_IDC_CC_EPS_SchnellesBlinken) (BNE original name: Schnelles Blinken), 3=SignalUngueltig (ST_IDC_CC_EPS_SignalUngueltig) (BNE original name: Signal ungültig)}
    ST_ILK_ERRM_FZM1:
      category=VALUE
      base-type=uint8
      compu {0=Fehlerspeicherfreigabe (ST_ILK_ERRM_FZM_Fehlerspeicherfreigabe) (Eintrag von Fehlern uneingeschränkt), 1=Fehlerspeichersperre (ST_ILK_ERRM_FZM_Fehlerspeichersperre) (Bereich Netzwerkfehler ist zu sperren), 2=Reserve (ST_ILK_ERRM_FZM_Reserve) (reserviert für zukünftige Erweiterungen), 3=SignalUngueltig (ST_ILK_ERRM_FZM_SignalUngueltig) (BNE original name: Signal ungültig)} "Automatisch generiert (Migration 2004-10-30) Transp.MOST-GW-Migration, 01.09.2006: Zusammenführung der Signalklasse Status_Sperre_Fehlerspeicher_FZM [2] mit den Parametern ErrorMemoryLock [1]."
      range raw 0..3
      invalid-value=3
    ST_MOT_DRV: category=VALUE, base-type=uint8, compu-method=ST_MOT_DRV, range raw 0..3, invalid-value=3
    ST_MOT_DRV1: category=VALUE, base-type=uint8, compu-method=ST_MOT_DRV, range raw 0..3, invalid-value=3
    ST_OFFS_QUAD_EPS1:
      category=VALUE
      base-type=uint8
      compu {0=Algorithmus_Funktion_ImSleep_Modus (ST_OFFS_QUAD_PINA_EPS_Algorithmus_Funktion_ImSleep_Modus) (BNE original name: Algorithmus (Funktion) im Sleep-Modus), 1=OffsetWirdErmittelt (ST_OFFS_QUAD_PINA_EPS_OffsetWirdErmittelt) (BNE original name: Offset wird ermittelt), 2=OffsetUebernehmenAufsetzenUeberIndex (ST_OFFS_QUAD_PINA_EPS_OffsetUebernehmenAufsetzenUeberIndex) (BNE original name: Offset übernehmen, Aufsetzen über Index), 3=OffsetUebernehmenAufsetzenUeberModelvergleich (ST_OFFS_QUAD_PINA_EPS_OffsetUebernehmenAufsetzenUeberModelvergleich) (BNE original name: Offset übernehmen, Aufsetzen über Modelvergleich), 4=OffsetUebernehmenAufsetzenUeberAnschlag_Anschlag (ST_OFFS_QUAD_PINA_EPS_OffsetUebernehmenAufsetzenUeberAnschlag_Anschlag) (BNE original name: Offset übernehmen, Aufsetzen über Anschlag-Anschlag), 5=OffsetUebernehmenAufsetzenUeberSummenlenkwinkel_imAFS_Fall_ (ST_OFFS_QUAD_PINA_EPS_OffsetUebernehmenAufsetzenUeberSummenlenkwinkel_imAFS_Fall_) (BNE original name: Offset übernehmen, Aufsetzen über Summenlenkwinkel (im AFS-Fall)), 6=OffsetInPruefung (ST_OFFS_QUAD_PINA_EPS_OffsetInPruefung) (BNE original name: Offset in Prüfung), 7=OffsetKorrigieren (ST_OFFS_QUAD_PINA_EPS_OffsetKorrigieren) (BNE original name: Offset korrigieren), 8=Initialisierung (ST_OFFS_QUAD_PINA_EPS_Initialisierung) (wird im aller ersten Rechenzyklus gesetzt (10ms)), 9=RestoffsetWirdErmittelt (ST_OFFS_QUAD_PINA_EPS_RestoffsetWirdErmittelt) (BNE original name: Restoffset wird ermittelt), 11=OffsetUebernehmenGroboffsetUeberModell (ST_OFFS_QUAD_PINA_EPS_OffsetUebernehmenGroboffsetUeberModell) (BNE original name: Offset übernehmen, Groboffset über Modell), 15=SignalUngueltig (ST_OFFS_QUAD_PINA_EPS_SignalUngueltig) (BNE original name: Signal ungültig)}
    ST_UDP: category=VALUE, base-type=uint8, compu-method=ST_UDP, range raw 0..15, invalid-value=15
    ST_UDP1: category=VALUE, base-type=uint8, compu-method=ST_UDP, range raw 0..15, invalid-value=15
    ST_V_VEH_NSS1:
      category=VALUE
      base-type=uint8
      compu {12=FahrzeugImStillstandsnahenBereich (ST_V_VEH_NSS_FahrzeugImStillstandsnahenBereich) (BNE original name: Fahrzeug im stillstandsnahen Bereich), 13=FahrzeugNichtImStillstandsnahenBereich (ST_V_VEH_NSS_FahrzeugNichtImStillstandsnahenBereich) (BNE original name: Fahrzeug nicht im stillstandsnahen Bereich), 15=SignalUngueltig (ST_V_VEH_NSS_SignalUngueltig) (BNE original name: Signal ungültig)}
    SU_CLU_STMOM_SFE_DXP: category=VALUE, base-type=uint8, compu-method=SU_CLU_STMOM_SFE_DXP, range raw 0..15, invalid-value=15
    SU_CLU_STMOM_SFE_DXP1: category=VALUE, base-type=uint8, compu-method=SU_CLU_STMOM_SFE_DXP, range raw 0..15, invalid-value=15
    SU_EPS_dummy_14_19: category=VALUE, base-type=uint8, compu {identical}
    SU_EPS_dummy_14_191: category=VALUE, base-type=uint8, compu {identical}
    SU_EPS_dummy_20_51: category=VALUE, base-type=uint32, compu {identical}
    SU_EPS_dummy_20_511: category=VALUE, base-type=uint32, compu {identical}
    SYS_ST_EPS: category=VALUE, base-type=uint8, compu {identical}, range phys 0..255
    TAR_QTA_STMOM_DV: category=VALUE, base-type=uint16, compu {phys=raw*0.005-10 for raw 2000..802000}
    TAR_QTA_STMOM_DV1: category=VALUE, base-type=uint16, compu {phys=raw*0.005-10 for raw 2000..802000}
    TAR_QTA_STRMOM_DV_dummy_12_15: category=VALUE, base-type=uint8, compu {identical}
    TAR_QTA_STRMOM_DV_dummy_12_151: category=VALUE, base-type=uint8, compu {identical}
    TAR_STMOM_DV_ACT: category=VALUE, base-type=uint16, compu {phys=raw*0.006-12 for raw 2000..668666.6666666666}
    TAR_STMOM_DV_ACT_dummy_12_15: category=VALUE, base-type=uint8, compu {identical}
    TAR_STMOM_DV_ACT_dummy_12_151: category=VALUE, base-type=uint8, compu {identical}
    TAR_STMOM_DV_ACT_dummy_32_51: category=VALUE, base-type=uint32, compu {identical}
    TAR_STMOM_DV_ACT_dummy_32_511: category=VALUE, base-type=uint32, compu {identical}
    TAR_STMOM_DV_ACT1: category=VALUE, base-type=uint16, compu {phys=raw*0.006-12 for raw 2000..668666.6666666666}
    TOT_STR_EPS: category=VALUE, base-type=uint16, compu {phys=raw*0.012213 for raw 0..335216.4250094811}
    TOT_STR_EPS1: category=VALUE, base-type=uint16, compu {phys=raw*0.012213 for raw 0..335216.4250094811}
    TRANF_CC_EPS1: category=VALUE, base-type=uint8
    TRANF_CC_EPS1_01: category=VALUE, base-type=uint8, compu {identical; unit sec}
    TRGG_ENGTORQ_EPS1:
      category=VALUE
      base-type=uint16
      compu {phys=raw*0.01-10 for raw 1000..201000, 4093=Funktionsschnittstelle_ist_nicht_verfuegbar (TRGG_ENGTORQ_EPS_Funktionsschnittstelle_ist_nicht_verfuegbar) (Sendefunktion in Betrieb, Werte nicht verfügbar), 4094=Funktion_meldet_Fehler (TRGG_ENGTORQ_EPS_Funktion_meldet_Fehler) (Sendefunktion in Betrieb, meldet Fehler), 4095=Signal_unbefuellt (TRGG_ENGTORQ_EPS_Signal_unbefuellt) (Sendefunktion nicht in Betrieb)}
      range phys 0..2000
      invalid-value=4095
    UN_PO_EPS1: category=VALUE, base-type=uint8, compu {0=Ritzelschnittstelle (UN_PO_EPS_Ritzelschnittstelle) (Die Position wird in Grad übertragen.), 1=Zahnstangenhubschnittstelle (UN_PO_EPS_Zahnstangenhubschnittstelle) (Die Position wird in Millimeter übertragen (Einheit=0.2mm).), 3=SignalUngueltig (UN_PO_EPS_SignalUngueltig) (BNE original name: Signal ungültig)}
    UN_TOT_STR_EPS: category=VALUE, base-type=uint8, compu-method=UN_TOT_STR_EPS
    UN_TOT_STR_EPS1: category=VALUE, base-type=uint8, compu-method=UN_TOT_STR_EPS
    VEH_SPD_EPS: category=VALUE, base-type=uint16, compu {identical}, range phys 0..65535
    VYAW_VEH: category=VALUE, base-type=uint16, compu-method=VYAW_VEH
    VYAW_VEH_dummy_12_15: category=VALUE, base-type=uint8, compu {identical}
    VYAW_VEH_dummy_12_151: category=VALUE, base-type=uint8, compu {identical}
    VYAW_VEH_ERR_AMP: category=VALUE, base-type=uint16, compu-method=VYAW_VEH_ERR_AMP
    VYAW_VEH_ERR_AMP1: category=VALUE, base-type=uint16, compu-method=VYAW_VEH_ERR_AMP
    VYAW_VEH1: category=VALUE, base-type=uint16, compu-method=VYAW_VEH
package /DataTypes/DataConstrs
  range T_SEC_COU_REL_DataConstr: raw 0..4294967294
package /MICROSAR/Dcm_swc/DataTypes
  impl type Dcm_Data140ByteType: category=ARRAY, sw-calibration-access=READ-ONLY
    element Dcm_Data140ByteTypeElement: array-size=140, array-size-semantics=FIXED-SIZE, implementation-data-type=uint8
package /Nexteer/ComponentTypes/DataTypeMappingSets
  data type mapping set Cals
