[part 2 of 2: packages /Nexteer/DataTypeMappingSets to /Systems/DiagnosticSwBaseTypes]
AUTOSAR XML (schema 4-2-2)
package /Nexteer/DataTypeMappingSets
  data type mapping set Nexteer
    data-type-maps:
      application-data-type=A{1..5}, implementation-data-type=float32
      application-data-type=Ag1, implementation-data-type=float32
      application-data-type=Ag{10..17}, implementation-data-type=float32
      application-data-type=Ag18, implementation-data-type=u12p4
      application-data-type=Ag19, implementation-data-type=float32
      application-data-type=Ag2, implementation-data-type=float32
      application-data-type=Ag3, implementation-data-type=float32
      application-data-type=Ag4, implementation-data-type=s2p13
      application-data-type=Ag5, implementation-data-type=u0p16
      application-data-type=Ag6, implementation-data-type=DataTypes/s18p13
      application-data-type=Ag7, implementation-data-type=DataTypes/s18p13
      application-data-type=Ag8, implementation-data-type=s15p16
      application-data-type=Ag9, implementation-data-type=u0p16
      application-data-type=AgAry1D1, implementation-data-type=Ary1D_s2p13_1024
      application-data-type=AgAry1D2, implementation-data-type=Ary1D_u0p16_8
      application-data-type=AgAry1D3, implementation-data-type=Ary1D_s2p13_1025
      application-data-type=AgAry1D4, implementation-data-type=Ary1D_f32_8
      application-data-type=AgAry1D5, implementation-data-type=Ary1D_u12p4_16
      application-data-type=AgAry2D1, implementation-data-type=Ary2D_u12p4_9_16
      application-data-type=Cnt1, implementation-data-type=uint8
      application-data-type=Cnt10, implementation-data-type=uint16
      application-data-type=Cnt11, implementation-data-type=uint16
      application-data-type=Cnt{12..14}, implementation-data-type=uint8
      application-data-type=Cnt15, implementation-data-type=uint32
      application-data-type=Cnt16, implementation-data-type=uint16
      application-data-type=Cnt17, implementation-data-type=uint32
      application-data-type=Cnt18, implementation-data-type=uint8
      application-data-type=Cnt19, implementation-data-type=uint8
      application-data-type=Cnt2, implementation-data-type=sint8
      application-data-type=Cnt20, implementation-data-type=sint16
      application-data-type=Cnt21, implementation-data-type=uint8
      application-data-type=Cnt22, implementation-data-type=uint8
      application-data-type=Cnt23, implementation-data-type=u16p0
      application-data-type=Cnt24, implementation-data-type=uint8
      application-data-type=Cnt25, implementation-data-type=uint8
      application-data-type=Cnt26, implementation-data-type=u16p0
      application-data-type=Cnt{27..29}, implementation-data-type=uint8
      application-data-type=Cnt3, implementation-data-type=uint16
      application-data-type=Cnt30, implementation-data-type=uint8
      application-data-type=Cnt31, implementation-data-type=uint16
      application-data-type=Cnt32, implementation-data-type=float32
      application-data-type=Cnt33, implementation-data-type=uint8
      application-data-type=Cnt34, implementation-data-type=float32
      application-data-type=Cnt35, implementation-data-type=sint16
      application-data-type=Cnt4, implementation-data-type=uint16
      application-data-type=Cnt5, implementation-data-type=uint16
      application-data-type=Cnt6, implementation-data-type=uint8
      application-data-type=Cnt7, implementation-data-type=uint8
      application-data-type=Cnt8, implementation-data-type=uint32
      application-data-type=Cnt9, implementation-data-type=uint16
      application-data-type=CntAry1D1, implementation-data-type=Ary1D_u16p0_2
      application-data-type=CntAry1D2, implementation-data-type=Ary1D_u32_8
      application-data-type=CntAry1D3, implementation-data-type=Ary1D_u16_257
      application-data-type=CntAry1D4, implementation-data-type=Ary1D_u16p0_2
      application-data-type=CntAry1D5, implementation-data-type=Ary1D_u8_22
      application-data-type=CntAry1D6, implementation-data-type=Ary1D_s16_22
      application-data-type=Curr{1..7}, implementation-data-type=float32
      application-data-type=Curr8, implementation-data-type=u9p7
      application-data-type=Curr9, implementation-data-type=float32
      application-data-type=CurrAry1D1, implementation-data-type=Ary1D_u9p7_16
      application-data-type=CurrAry1D2, implementation-data-type=Ary1D_u9p7_6
      application-data-type=CurrAry1D3, implementation-data-type=Ary1D_u9p7_7
      application-data-type=CurrSqd1, implementation-data-type=float32
      application-data-type=Frq1, implementation-data-type=float32
      application-data-type=Frq10, implementation-data-type=float32
      application-data-type=Frq2, implementation-data-type=float32
      application-data-type=Frq3, implementation-data-type=u10p6
      application-data-type=Frq4, implementation-data-type=u10p6
      application-data-type=Frq5, implementation-data-type=u9p7
      application-data-type=Frq6, implementation-data-type=u9p7
      application-data-type=Frq{7..9}, implementation-data-type=float32
      application-data-type=FrqAry1D1, implementation-data-type=Ary1D_u10p6_4
      application-data-type=FrqAry1D2, implementation-data-type=Ary1D_u10p6_4
      application-data-type=FrqAry1D3, implementation-data-type=Ary1D_u9p7_4
      application-data-type=FrqAry1D4, implementation-data-type=Ary1D_u9p7_4
      application-data-type=Gain{1..8}, implementation-data-type=float32
      application-data-type=HwAgOffsRecAppl1, implementation-data-type=HwAgOffsRec1
      application-data-type=Indu1, implementation-data-type=float32
      application-data-type=Indu2, implementation-data-type=float32
      application-data-type=Logl1, implementation-data-type=boolean
      application-data-type=MotCon1, implementation-data-type=float32
      application-data-type=MotPrmNomEolRecAppl2, implementation-data-type=MotPrmNomEolRec2
      application-data-type=MotPrmNomEolRecAppl3, implementation-data-type=MotPrmNomEolRec3
      application-data-type=R{1..8}, implementation-data-type=float32
      application-data-type=Rate1, implementation-data-type=float32
      application-data-type=Rate10, implementation-data-type=float32
      application-data-type=Rate{2..9}, implementation-data-type=float32
      application-data-type=Spd1, implementation-data-type=float32
      application-data-type=Spd2, implementation-data-type=u9p7
      application-data-type=Spd3, implementation-data-type=float32
      application-data-type=Spd4, implementation-data-type=float32
      application-data-type=SpdAry1D1, implementation-data-type=Ary1D_u9p7_12
      application-data-type=SpdAry1D2, implementation-data-type=Ary1D_u9p7_9
      application-data-type=T{1..5}, implementation-data-type=float32
      application-data-type=T6, implementation-data-type=s11p4
      application-data-type=T7, implementation-data-type=s8p7
      application-data-type=T8, implementation-data-type=float32
      application-data-type=TAry1D1, implementation-data-type=Ary1D_s11p4_14
      application-data-type=TAry1D2, implementation-data-type=Ary1D_s8p7_14
      application-data-type=Ti1, implementation-data-type=uint32
      application-data-type=Ti{10..12}, implementation-data-type=float32
      application-data-type=Ti{2..6}, implementation-data-type=uint32
      application-data-type=Ti7, implementation-data-type=float32
      application-data-type=Ti8, implementation-data-type=float32
      application-data-type=Ti9, implementation-data-type=uint32
      application-data-type=Tq1, implementation-data-type=float32
      application-data-type=Tq10, implementation-data-type=float32
      application-data-type=Tq11, implementation-data-type=s4p11
      application-data-type=Tq12, implementation-data-type=u5p11
      application-data-type=Tq13, implementation-data-type=u4p12
      application-data-type=Tq14, implementation-data-type=u5p11
      application-data-type=Tq{15..19}, implementation-data-type=float32
      application-data-type=Tq2, implementation-data-type=float32
      application-data-type=Tq3, implementation-data-type=float32
      application-data-type=Tq4, implementation-data-type=u5p11
      application-data-type=Tq5, implementation-data-type=s4p11
      application-data-type=Tq6, implementation-data-type=u8p8
      application-data-type=Tq7, implementation-data-type=u5p11
      application-data-type=Tq8, implementation-data-type=float32
      application-data-type=Tq9, implementation-data-type=float32
      application-data-type=TqAry1D1, implementation-data-type=Ary1D_s4p11_20
      application-data-type=TqAry1D10, implementation-data-type=Ary1D_u4p12_12
      application-data-type=TqAry1D11, implementation-data-type=Ary1D_u5p11_13
      application-data-type=TqAry1D2, implementation-data-type=Ary1D_u8p8_20
      application-data-type=TqAry1D3, implementation-data-type=Ary1D_u5p11_5
      application-data-type=TqAry1D4, implementation-data-type=Ary1D_s4p11_20
      application-data-type=TqAry1D5, implementation-data-type=Ary1D_u5p11_5
      application-data-type=TqAry1D6, implementation-data-type=Ary1D_u4p12_11
      application-data-type=TqAry1D7, implementation-data-type=Ary1D_u5p11_16
      application-data-type=TqAry1D8, implementation-data-type=Ary1D_u8p8_8
      application-data-type=TqAry1D9, implementation-data-type=Ary1D_u8p8_2
      application-data-type=TqAry2D1, implementation-data-type=Ary2D_s4p11_12_20
      application-data-type=TqAry2D2, implementation-data-type=Ary2D_u8p8_12_20
      application-data-type=TqAry2D3, implementation-data-type=Ary2D_u5p11_12_5
      application-data-type=TqAry2D4, implementation-data-type=Ary2D_s4p11_12_20
      application-data-type=TqAry2D5, implementation-data-type=Ary2D_u5p11_12_5
      application-data-type=TqAry2D6, implementation-data-type=Ary2D_u5p11_9_16
      application-data-type=TqAry2D7, implementation-data-type=Ary2D_u8p8_9_8
      application-data-type=TqAry2D8, implementation-data-type=Ary2D_u5p11_12_13
      application-data-type=Uls1, implementation-data-type=float32
      application-data-type=Uls10, implementation-data-type=float32
      application-data-type=Uls11, implementation-data-type=u2p14
      application-data-type=Uls{12..14}, implementation-data-type=float32
      application-data-type=Uls15, implementation-data-type=u1p15
      application-data-type=Uls16, implementation-data-type=float32
      application-data-type=Uls17, implementation-data-type=u8p8
      application-data-type=Uls18, implementation-data-type=u9p7
      application-data-type=Uls19, implementation-data-type=u8p8
      application-data-type=Uls2, implementation-data-type=float32
      application-data-type=Uls20, implementation-data-type=u4p12
      application-data-type=Uls21, implementation-data-type=float32
      application-data-type=Uls22, implementation-data-type=float32
      application-data-type=Uls23, implementation-data-type=u8p8
      application-data-type=Uls24, implementation-data-type=uint8
      application-data-type=Uls3, implementation-data-type=sint8
      application-data-type=Uls4, implementation-data-type=u2p14
      application-data-type=Uls{5..9}, implementation-data-type=float32
      application-data-type=UlsAry1D1, implementation-data-type=Ary1D_u2p14_5
      application-data-type=UlsAry1D10, implementation-data-type=Ary1D_u8p8_4
      application-data-type=UlsAry1D11, implementation-data-type=Ary1D_u8p8_14
      application-data-type=UlsAry1D12, implementation-data-type=Ary1D_u1p15_2
      application-data-type=UlsAry1D13, implementation-data-type=Ary1D_u4p12_12
      application-data-type=UlsAry1D14, implementation-data-type=Ary1D_u4p12_14
      application-data-type=UlsAry1D15, implementation-data-type=Ary1D_u8p8_14
      application-data-type=UlsAry1D2, implementation-data-type=Ary1D_u2p14_2
      application-data-type=UlsAry1D3, implementation-data-type=Ary1D_u2p14_16
      application-data-type=UlsAry1D4, implementation-data-type=Ary1D_u2p14_6
      application-data-type=UlsAry1D5, implementation-data-type=Ary1D_u1p15_11
      application-data-type=UlsAry1D6, implementation-data-type=Ary1D_f32_8
      application-data-type=UlsAry1D7, implementation-data-type=Ary1D_u8p8_4
      application-data-type=UlsAry1D8, implementation-data-type=Ary1D_u9p7_4
      application-data-type=UlsAry1D9, implementation-data-type=Ary1D_u8p8_8
      application-data-type=UlsAry2D1, implementation-data-type=Ary2D_u2p14_12_5
      application-data-type=UlsAry2D2, implementation-data-type=Ary2D_u2p14_7_6
      application-data-type=UlsAry2D3, implementation-data-type=Ary2D_u8p8_9_8
      application-data-type=UlsAry2D4, implementation-data-type=Ary2D_u8p8_9_4
      application-data-type=Vel{1..3}, implementation-data-type=float32
      application-data-type=Vel4, implementation-data-type=u11p5
      application-data-type=Vel5, implementation-data-type=float32
      application-data-type=Vel6, implementation-data-type=u7p9
      application-data-type=Vel7, implementation-data-type=u12p4
      application-data-type=Vel8, implementation-data-type=float32
      application-data-type=Vel9, implementation-data-type=float32
      application-data-type=VelAry1D1, implementation-data-type=Ary1D_u11p5_4
      application-data-type=VelAry1D2, implementation-data-type=Ary1D_u11p5_11
      application-data-type=VelAry1D3, implementation-data-type=Ary1D_u11p5_10
      application-data-type=VelAry1D4, implementation-data-type=Ary1D_u7p9_4
      application-data-type=VelAry1D5, implementation-data-type=Ary1D_u12p4_13
      application-data-type=VelAry2D1, implementation-data-type=Ary2D_u7p9_8_4
      application-data-type=VelAry2D2, implementation-data-type=Ary2D_u7p9_9_4
      application-data-type=VelAry2D3, implementation-data-type=Ary2D_u12p4_12_13
      application-data-type=Volt1, implementation-data-type=float32
      application-data-type=Volt{10..17}, implementation-data-type=float32
      application-data-type=Volt18, implementation-data-type=u3p13
      application-data-type=Volt{2..9}, implementation-data-type=float32
      application-data-type=VoltAry1D1, implementation-data-type=Ary1D_u3p13_10
      application-data-type=VoltGain1, implementation-data-type=float32
      application-data-type=VoltTi1, implementation-data-type=uint32
      application-data-type=VoltTi2, implementation-data-type=uint32
package /Nexteer/DataTypes
  70 x application array data type, all with category=ARRAY, sw-calibration-access=READ-ONLY:
    AgAry1D1
      element Element: category=VALUE, type=Ag4, array-size-semantics=FIXED-SIZE, max-number-of-elements=1024
    AgAry1D2
      element Element: category=VALUE, type=Ag5, array-size-semantics=FIXED-SIZE, max-number-of-elements=8
    AgAry1D3
      element Element: category=VALUE, type=Ag4, array-size-semantics=FIXED-SIZE, max-number-of-elements=1025
    AgAry1D4
      element Element: category=VALUE, type=Ag14, array-size-semantics=FIXED-SIZE, max-number-of-elements=8
    AgAry1D5
      element Element: category=VALUE, type=Ag18, array-size-semantics=FIXED-SIZE, max-number-of-elements=16
    AgAry2D1
      element Element: category=ARRAY, type=AgAry1D5, array-size-semantics=FIXED-SIZE, max-number-of-elements=9
    CntAry1D1
      element Element: category=VALUE, type=Cnt23, array-size-semantics=FIXED-SIZE, max-number-of-elements=2
    CntAry1D2
      element Element: category=VALUE, type=Cnt15, array-size-semantics=FIXED-SIZE, max-number-of-elements=8
    CntAry1D3
      element Element: category=VALUE, type=Cnt16, array-size-semantics=FIXED-SIZE, max-number-of-elements=257
    CntAry1D4
      element Element: category=VALUE, type=Cnt26, array-size-semantics=FIXED-SIZE, max-number-of-elements=2
    CntAry1D5
      element Element: category=VALUE, type=Cnt19, array-size-semantics=FIXED-SIZE, max-number-of-elements=22
    CntAry1D6
      element Element: category=VALUE, type=Cnt35, array-size-semantics=FIXED-SIZE, max-number-of-elements=22
    CurrAry1D1
      element Element: category=VALUE, type=Curr8, array-size-semantics=FIXED-SIZE, max-number-of-elements=16
    CurrAry1D2
      element Element: category=VALUE, type=Curr8, array-size-semantics=FIXED-SIZE, max-number-of-elements=6
    CurrAry1D3
      element Element: category=VALUE, type=Curr8, array-size-semantics=FIXED-SIZE, max-number-of-elements=7
    FrqAry1D1
      element Element: category=VALUE, type=Frq3, array-size-semantics=FIXED-SIZE, max-number-of-elements=4
    FrqAry1D2
      element Element: category=VALUE, type=Frq4, array-size-semantics=FIXED-SIZE, max-number-of-elements=4
    FrqAry1D3
      element Element: category=VALUE, type=Frq5, array-size-semantics=FIXED-SIZE, max-number-of-elements=4
    FrqAry1D4
      element Element: category=VALUE, type=Frq6, array-size-semantics=FIXED-SIZE, max-number-of-elements=4
    SpdAry1D1
      element Element: category=VALUE, type=Spd2, array-size-semantics=FIXED-SIZE, max-number-of-elements=12
    SpdAry1D2
      element Element: category=VALUE, type=Spd2, array-size-semantics=FIXED-SIZE, max-number-of-elements=9
    TAry1D1
      element Element: category=VALUE, type=T6, array-size-semantics=FIXED-SIZE, max-number-of-elements=14
    TAry1D2
      element Element: category=VALUE, type=T7, array-size-semantics=FIXED-SIZE, max-number-of-elements=14
    TqAry1D1
      element Element: category=VALUE, type=Tq5, array-size-semantics=FIXED-SIZE, max-number-of-elements=20
    TqAry1D10
      element Element: category=VALUE, type=Tq13, array-size-semantics=FIXED-SIZE, max-number-of-elements=12
    TqAry1D11
      element Element: category=VALUE, type=Tq12, array-size-semantics=FIXED-SIZE, max-number-of-elements=13
    TqAry1D2
      element Element: category=VALUE, type=Tq6, array-size-semantics=FIXED-SIZE, max-number-of-elements=20
    TqAry1D3
      element Element: category=VALUE, type=Tq7, array-size-semantics=FIXED-SIZE, max-number-of-elements=5
    TqAry1D4
      element Element: category=VALUE, type=Tq11, array-size-semantics=FIXED-SIZE, max-number-of-elements=20
    TqAry1D5
      element Element: category=VALUE, type=Tq12, array-size-semantics=FIXED-SIZE, max-number-of-elements=5
    TqAry1D6
      element Element: category=VALUE, type=Tq13, array-size-semantics=FIXED-SIZE, max-number-of-elements=11
    TqAry1D7
      element Element: category=VALUE, type=Tq14, array-size-semantics=FIXED-SIZE, max-number-of-elements=16
    TqAry1D8
      element Element: category=VALUE, type=Tq6, array-size-semantics=FIXED-SIZE, max-number-of-elements=8
    TqAry1D9
      element Element: category=VALUE, type=Tq6, array-size-semantics=FIXED-SIZE, max-number-of-elements=2
    TqAry2D1
      element Element: category=ARRAY, type=TqAry1D1, array-size-semantics=FIXED-SIZE, max-number-of-elements=12
    TqAry2D2
      element Element: category=ARRAY, type=TqAry1D2, array-size-semantics=FIXED-SIZE, max-number-of-elements=12
    TqAry2D3
      element Element: category=ARRAY, type=TqAry1D3, array-size-semantics=FIXED-SIZE, max-number-of-elements=12
    TqAry2D4
      element Element: category=ARRAY, type=TqAry1D4, array-size-semantics=FIXED-SIZE, max-number-of-elements=12
    TqAry2D5
      element Element: category=ARRAY, type=TqAry1D5, array-size-semantics=FIXED-SIZE, max-number-of-elements=12
    TqAry2D6
      element Element: category=ARRAY, type=TqAry1D7, array-size-semantics=FIXED-SIZE, max-number-of-elements=9
    TqAry2D7
      element Element: category=ARRAY, type=TqAry1D8, array-size-semantics=FIXED-SIZE, max-number-of-elements=9
    TqAry2D8
      element Element: category=ARRAY, type=TqAry1D11, array-size-semantics=FIXED-SIZE, max-number-of-elements=12
    UlsAry1D1
      element Element: category=VALUE, type=Uls4, array-size-semantics=FIXED-SIZE, max-number-of-elements=5
    UlsAry1D10
      element Element: category=VALUE, type=Uls19, array-size-semantics=FIXED-SIZE, max-number-of-elements=4
    UlsAry1D11
      element Element: category=VALUE, type=Uls17, array-size-semantics=FIXED-SIZE, max-number-of-elements=14
    UlsAry1D12
      element Element: category=VALUE, type=Uls15, array-size-semantics=FIXED-SIZE, max-number-of-elements=2
    UlsAry1D13
      element Element: category=VALUE, type=Uls20, array-size-semantics=FIXED-SIZE, max-number-of-elements=12
    UlsAry1D14
      element Element: category=VALUE, type=Uls20, array-size-semantics=FIXED-SIZE, max-number-of-elements=14
    UlsAry1D15
      element Element: category=VALUE, type=Uls23, array-size-semantics=FIXED-SIZE, max-number-of-elements=14
    UlsAry1D2
      element Element: category=VALUE, type=Uls4, array-size-semantics=FIXED-SIZE, max-number-of-elements=2
    UlsAry1D3
      element Element: category=VALUE, type=Uls11, array-size-semantics=FIXED-SIZE, max-number-of-elements=16
    UlsAry1D4
      element Element: category=VALUE, type=Uls11, array-size-semantics=FIXED-SIZE, max-number-of-elements=6
    UlsAry1D5
      element Element: category=VALUE, type=Uls15, array-size-semantics=FIXED-SIZE, max-number-of-elements=11
    UlsAry1D6
      element Element: category=VALUE, type=Uls12, array-size-semantics=FIXED-SIZE, max-number-of-elements=8
    UlsAry1D7
      element Element: category=VALUE, type=Uls17, array-size-semantics=FIXED-SIZE, max-number-of-elements=4
    UlsAry1D8
      element Element: category=VALUE, type=Uls18, array-size-semantics=FIXED-SIZE, max-number-of-elements=4
    UlsAry1D9
      element Element: category=VALUE, type=Uls17, array-size-semantics=FIXED-SIZE, max-number-of-elements=8
    UlsAry2D1
      element Element: category=ARRAY, type=UlsAry1D1, array-size-semantics=FIXED-SIZE, max-number-of-elements=12
    UlsAry2D2
      element Element: category=ARRAY, type=UlsAry1D4, array-size-semantics=FIXED-SIZE, max-number-of-elements=7
    UlsAry2D3
      element Element: category=ARRAY, type=UlsAry1D9, array-size-semantics=FIXED-SIZE, max-number-of-elements=9
    UlsAry2D4
      element Element: category=ARRAY, type=UlsAry1D10, array-size-semantics=FIXED-SIZE, max-number-of-elements=9
    VelAry1D1
      element Element: category=VALUE, type=Vel4, array-size-semantics=FIXED-SIZE, max-number-of-elements=4
    VelAry1D2
      element Element: category=VALUE, type=Vel4, array-size-semantics=FIXED-SIZE, max-number-of-elements=11
    VelAry1D3
      element Element: category=VALUE, type=Vel4, array-size-semantics=FIXED-SIZE, max-number-of-elements=10
    VelAry1D4
      element Element: category=VALUE, type=Vel6, array-size-semantics=FIXED-SIZE, max-number-of-elements=4
    VelAry1D5
      element Element: category=VALUE, type=Vel7, array-size-semantics=FIXED-SIZE, max-number-of-elements=13
    VelAry2D1
      element Element: category=ARRAY, type=VelAry1D4, array-size-semantics=FIXED-SIZE, max-number-of-elements=8
    VelAry2D2
      element Element: category=ARRAY, type=VelAry1D4, array-size-semantics=FIXED-SIZE, max-number-of-elements=9
    VelAry2D3
      element Element: category=ARRAY, type=VelAry1D5, array-size-semantics=FIXED-SIZE, max-number-of-elements=12
    VoltAry1D1
      element Element: category=VALUE, type=Volt18, array-size-semantics=FIXED-SIZE, max-number-of-elements=10
  206 x app type, all with sw-calibration-access=READ-ONLY:
    A1: category=VALUE, range phys -10..10, unit=m/s^2
    A2: category=VALUE, range phys -180..180, unit=m/s^2
    A3: category=VALUE, range phys -50..50, unit=kph/s
    A4: category=VALUE, range phys 0.1..10, unit=m/s^2
    A5: category=VALUE, range phys 0.1..10, unit=kph/s
    Ag1: category=VALUE, range phys 0..6.25, unit=MotDeg
    Ag10: category=VALUE, range phys 0..6.2832, unit=MotRad
    Ag11: category=VALUE, range phys 10..40, unit=MotDeg/HwDeg
    Ag12: category=VALUE, range phys -1.62..1.62, unit=MotRad
    Ag13: category=VALUE, range phys 0.001..0.1, unit=MotRad
    Ag14: category=VALUE, range phys -3.1415927..3.1415927, unit=MotRad
    Ag15: category=VALUE, range phys -1440..1440, unit=HwDeg
    Ag16: category=VALUE, range phys 0..20, unit=HwDeg
    Ag17: category=VALUE, range phys 0..1440, unit=HwDeg
    Ag18: category=VALUE, compu {phys=raw*16; unit Units/FixdPt}, range phys 0..1440, unit=HwDeg
    Ag19: category=VALUE, range phys -900..900, unit=HwDeg
    Ag2: category=VALUE, range phys -11796480..11796480, unit=MotDeg
    Ag3: category=VALUE, range phys 0..0.999, unit=MotRevElec
    Ag4: category=VALUE, compu {raw=phys*8192; unit Units/FixdPt}, range phys -0.05555555556..0.05555555556, unit=MotRev
    Ag5: category=VALUE, compu {raw=phys*65536; unit Units/FixdPt}, range phys 0..0.9999847412, unit=MotRev
    Ag6: category=VALUE, compu {raw=phys*8192; unit Units/FixdPt}, range phys 0..6.25, unit=MotDeg
    Ag7: category=VALUE, compu {raw=phys*8192; unit Units/FixdPt}, range phys -262144..262143.9998, unit=MotDeg
    Ag8: category=VALUE, compu {raw=phys*65536; unit Units/FixdPt}, range phys -32768..32767.999984741, unit=MotRev
    Ag9: category=VALUE, compu {raw=phys*65536; unit Units/FixdPt}, range phys 0..0.9999847412, unit=MotRevElec
    Cnt1: category=VALUE, range phys 1..4, unit=Cnt
    Cnt10: category=VALUE, range phys 1..10000, unit=Cnt
    Cnt11: category=VALUE, range phys 0..10000, unit=Cnt
    Cnt12: category=VALUE, range phys 0..3, unit=Cnt
    Cnt13: category=VALUE, range phys 0..3, unit=Cnt
    Cnt14: category=VALUE, range phys 2..12, unit=Cnt
    Cnt15: category=VALUE, range phys 0..4294967295, unit=Cnt
    Cnt16: category=VALUE, range phys 0..65535, unit=Cnt
    Cnt17: category=VALUE, range phys 0..67108863, unit=Cnt
    Cnt18: category=VALUE, range phys 0..31, unit=Cnt
    Cnt19: category=VALUE, range phys 0..255, unit=Cnt
    Cnt2: category=VALUE, range phys -1..1, unit=Cnt
    Cnt20: category=VALUE, range phys -512..511, unit=Cnt
    Cnt21: category=VALUE, range phys 1..3, unit=Cnt
    Cnt22: category=VALUE, range phys 0..7, unit=Cnt
    Cnt23: category=VALUE, range phys 0..100, unit=Cnt
    Cnt24: category=VALUE, range phys 0..42, unit=Cnt
    Cnt25: category=VALUE, range phys 0..2, unit=Cnt
    Cnt26: category=VALUE, range phys 0..200, unit=Cnt
    Cnt27: category=VALUE, range phys 0..8, unit=Cnt
    Cnt28: category=VALUE, range phys 1..5, unit=Cnt
    Cnt29: category=VALUE, range phys 1..20, unit=Cnt
    Cnt3: category=VALUE, range phys 0..1, unit=Cnt
    Cnt30: category=VALUE, range phys 0..20, unit=Cnt
    Cnt31: category=VALUE, range phys 0..4095, unit=Cnt
    Cnt32: category=VALUE, range phys 0..360, unit=Cnt
    Cnt33: category=VALUE, range phys 0..22, unit=Cnt
    Cnt34: category=VALUE, range phys -900..900, unit=Cnt
    Cnt35: category=VALUE, range phys -500..500, unit=Cnt
    Cnt4: category=VALUE, range phys 0..31, unit=Cnt
    Cnt5: category=VALUE, range phys 0..32767, unit=Cnt
    Cnt6: category=VALUE, range phys 0..63, unit=Cnt
    Cnt7: category=VALUE, range phys 20..160, unit=Cnt
    Cnt8: category=VALUE, range phys 0..1800, unit=Cnt
    Cnt9: category=VALUE, range phys 1..1000, unit=Cnt
    Curr1: category=VALUE, range phys -145..145, unit=Amp
    Curr2: category=VALUE, range phys 0..50, unit=Amp
    Curr3: category=VALUE, range phys 10..100, unit=Amp
    Curr4: category=VALUE, range phys -450..450, unit=Amp
    Curr5: category=VALUE, range phys -1000..1000, unit=Amp
    Curr6: category=VALUE, range phys 0..200, unit=Amp
    Curr7: category=VALUE, range phys -200..200, unit=Amp
    Curr8: category=VALUE, compu {raw=phys*128; unit Units/FixdPt}, range phys 0..200, unit=Amp
    Curr9: category=VALUE, range phys 0.01..20, unit=Amp
    CurrSqd1: category=VALUE, range phys 0..40000, unit=Amp^2
    Frq1: category=VALUE, range phys 0.1..10, unit=Hz
    Frq10: category=VALUE, range phys 1..100, unit=Hz
    Frq2: category=VALUE, range phys 1..200, unit=Hz
    Frq3: category=VALUE, compu {raw=phys*64; unit Units/FixdPt}, range phys 0..750, unit=Hz
    Frq4: category=VALUE, compu {raw=phys*64; unit Units/FixdPt}, range phys 0..1000, unit=Hz
    Frq5: category=VALUE, compu {raw=phys*128; unit Units/FixdPt}, range phys 0..500, unit=Hz
    Frq6: category=VALUE, compu {raw=phys*128; unit Units/FixdPt}, range phys 0..400, unit=Hz
    Frq7: category=VALUE, range phys 5..100, unit=Hz
    Frq8: category=VALUE, range phys 5..31.25, unit=Hz
    Frq9: category=VALUE, range phys 0.0039..100, unit=Hz
    Gain1: category=VALUE, range phys 0..200, unit=degC/Volt
    Gain2: category=VALUE, range phys 70..76, unit=Amp/V
    Gain3: category=VALUE, range phys 56..60, unit=Amp/V
    Gain4: category=VALUE, range phys 0..76, unit=Amp/V
    Gain5: category=VALUE, range phys 0..0.006, unit=ohm/degC
    Gain6: category=VALUE, range phys -0.0015..0, unit=V/MotRad/S/degC
    Gain7: category=VALUE, range phys 0..0.0045, unit=ohm/degC
    Gain8: category=VALUE, range phys 0..0.1, unit=MotNm/MotRad/S
    Indu1: category=VALUE, range phys 3e-05..0.00041, unit=H
    Indu2: category=VALUE, range phys 0..0.0023, unit=H
    Logl1: category=BOOLEAN, range phys 0..1
    MotCon1: category=VALUE, range phys 0.025..0.075, unit=V/MotRad/Sec
    R1: category=VALUE, range phys 0..0.2, unit=ohm
    R2: category=VALUE, range phys 0..45, unit=ohm
    R3: category=VALUE, range phys 0..2.25, unit=ohm
    R4: category=VALUE, range phys 0..3.6, unit=ohm
    R5: category=VALUE, range phys 0.005..0.125, unit=ohm
    R6: category=VALUE, range phys 0.005..0.12565, unit=ohm
    R7: category=VALUE, range phys -0.5..0.5, unit=ohm
    R8: category=VALUE, range phys 0..0.1, unit=ohm
    Rate1: category=VALUE, range phys 0.1..500, unit=Uls/S
    Rate10: category=VALUE, range phys 1..1200, unit=VehDeg/S^2
    Rate2: category=VALUE, range phys 0..500, unit=Uls/S
    Rate3: category=VALUE, range phys 0..1000, unit=Uls/S
    Rate4: category=VALUE, range phys 0.1..10, unit=Uls/S
    Rate5: category=VALUE, range phys -120..120, unit=VehDeg/S
    Rate6: category=VALUE, range phys 0.1..400, unit=m/s^2
    Rate7: category=VALUE, range phys 0.1..500, unit=kph/s^2
    Rate8: category=VALUE, range phys 1..50, unit=kph/s
    Rate9: category=VALUE, range phys 0.1..120, unit=VehDeg/S
    Spd1: category=VALUE, range phys 0..511, unit=kph
    Spd2: category=VALUE, compu {raw=phys*128; unit Units/FixdPt}, range phys 0..511, unit=kph
    Spd3: category=VALUE, range phys 0..255, unit=kph
    Spd4: category=VALUE, range phys 0.1..511, unit=kph
    T1: category=VALUE, range phys -50..150, unit=degC
    T2: category=VALUE, range phys -50..200, unit=degC
    T3: category=VALUE, range phys -50..300, unit=degC
    T4: category=VALUE, range phys -100..150, unit=degC
    T5: category=VALUE, range phys -40..150, unit=degC
    T6: category=VALUE, compu {phys=raw*16; unit Units/FixdPt}, range phys -50..150, unit=degC
    T7: category=VALUE, compu {raw=phys*128; unit Units/FixdPt}, range phys -50..150, unit=degC
    T8: category=VALUE, range phys 0..10, unit=degC
    Ti1: category=VALUE, range phys 0..25000, unit=nS
    Ti10: category=VALUE, range phys 0..0.0002, unit=sec
    Ti11: category=VALUE, range phys 9.1e-05..0.000143, unit=sec
    Ti12: category=VALUE, range phys 0..0.05, unit=sec
    Ti2: category=VALUE, range phys 1..1000, unit=nS
    Ti3: category=VALUE, range phys 0..71429, unit=nS
    Ti4: category=VALUE, range phys 55555..71429, unit=nS
    Ti5: category=VALUE, range phys 6666..8572, unit=nS
    Ti6: category=VALUE, range phys 0..30000, unit=nS
    Ti7: category=VALUE, range phys 0..4295, unit=uS
    Ti8: category=VALUE, range phys 0..71429, unit=nS
    Ti9: category=VALUE, range phys 0..4294967295, unit=nS
    Tq1: category=VALUE, range phys -8.8..8.8, unit=MotNm
    Tq10: category=VALUE, range phys 0..8.8, unit=MotNm
    Tq11: category=VALUE, compu {raw=phys*2048; unit Units/FixdPt}, range phys -1..15.99, unit=MotNm
    Tq12: category=VALUE, compu {raw=phys*2048; unit Units/FixdPt}, range phys 0..8.8, unit=MotNm
    Tq13: category=VALUE, compu {phys=raw*4096; unit Units/FixdPt}, range phys 0..8.8, unit=MotNm
    Tq14: category=VALUE, compu {raw=phys*2048; unit Units/FixdPt}, range phys 0..0.5, unit=MotNm
    Tq15: category=VALUE, range phys 0..0.3, unit=MotNm
    Tq16: category=VALUE, range phys 0..64, unit=HwNm
    Tq17: category=VALUE, range phys 0..63, unit=HwNm
    Tq18: category=VALUE, range phys 0..10, unit=HwNm
    Tq19: category=VALUE, range phys 0..1799, unit=HwNm
    Tq2: category=VALUE, range phys -10..10, unit=HwNm
    Tq3: category=VALUE, range phys 0..8.8, unit=HwNm
    Tq4: category=VALUE, compu {raw=phys*2048; unit Units/FixdPt}, range phys 0..8, unit=MotNm
    Tq5: category=VALUE, compu {raw=phys*2048; unit Units/FixdPt}, range phys -10..10, unit=MotNm
    Tq6: category=VALUE, compu {raw=phys*256; unit Units/FixdPt}, range phys 0..10, unit=HwNm
    Tq7: category=VALUE, compu {raw=phys*2048; unit Units/FixdPt}, range phys 0..1.1, unit=MotNm
    Tq8: category=VALUE, range phys -3..3, unit=MotNm
    Tq9: category=VALUE, range phys -8..8, unit=MotNm
    Uls1: category=VALUE, range phys 0.5..1, unit=Uls
    Uls10: category=VALUE, range phys 0..20, unit=Uls
    Uls11: category=VALUE, compu {raw=phys*16384; unit Units/FixdPt}, range phys 0..2, unit=Uls
    Uls12: category=VALUE, range phys -1..1, unit=Uls
    Uls13: category=VALUE, range phys -100..100, unit=Uls
    Uls14: category=VALUE, range phys 1..2, unit=Uls
    Uls15: category=VALUE, compu {phys=raw*32768; unit Units/FixdPt}, range phys 0..1, unit=Uls
    Uls16: category=VALUE, range phys 0.1..10, unit=Uls
    Uls17: category=VALUE, compu {raw=phys*256; unit Units/FixdPt}, range phys 0..1, unit=Uls
    Uls18: category=VALUE, compu {raw=phys*128; unit Units/FixdPt}, range phys 0..1, unit=Uls
    Uls19: category=VALUE, compu {raw=phys*256; unit Units/FixdPt}, range phys 0..2.5, unit=Uls
    Uls2: category=VALUE, range phys 0..1, unit=Uls
    Uls20: category=VALUE, compu {phys=raw*4096; unit Units/FixdPt}, range phys 0..10, unit=Uls
    Uls21: category=VALUE, range phys 0..2, unit=Uls
    Uls22: category=VALUE, range phys 0..10, unit=Uls
    Uls23: category=VALUE, compu {raw=phys*256; unit Units/FixdPt}, range phys 0..1, unit=Uls
    Uls24: category=VALUE, range phys 0..255, unit=Uls
    Uls3: category=VALUE, range phys -1..1, unit=Uls
    Uls4: category=VALUE, compu {raw=phys*16384; unit Units/FixdPt}, range phys 0..1, unit=Uls
    Uls5: category=VALUE, range phys -1000000000..1000000000, unit=Uls
    Uls6: category=VALUE, range phys 0..200, unit=Uls
    Uls7: category=VALUE, range phys -25..25, unit=Uls
    Uls8: category=VALUE, range phys -200..200, unit=Uls
    Uls9: category=VALUE, range phys 0.98..1, unit=Uls
    Vel1: category=VALUE, range phys -1350..1350, unit=MotRad/s
    Vel2: category=VALUE, range phys 0..1350, unit=MotRad/s
    Vel3: category=VALUE, range phys -42..42, unit=HwRad/s
    Vel4: category=VALUE, compu {raw=phys*32; unit Units/FixdPt}, range phys 0..1350, unit=MotRad/s
    Vel5: category=VALUE, range phys 0..0.5, unit=HwDeg/s
    Vel6: category=VALUE, compu {phys=raw*512; unit Units/FixdPt}, range phys 0..42, unit=HwRad/s
    Vel7: category=VALUE, compu {phys=raw*16; unit Units/FixdPt}, range phys 0..1350, unit=MotRad/s
    Vel8: category=VALUE, range phys 0..128, unit=MotRad/s
    Vel9: category=VALUE, range phys 0..127, unit=MotRad/s
    Volt1: category=VALUE, range phys 6..26.5, unit=V
    Volt10: category=VALUE, range phys 2.5..4.8, unit=V
    Volt11: category=VALUE, range phys 0.3..2.5, unit=V
    Volt12: category=VALUE, range phys 2.5..3, unit=V
    Volt13: category=VALUE, range phys 2..2.5, unit=V
    Volt14: category=VALUE, range phys 0..4800, unit=V
    Volt15: category=VALUE, range phys 0..48000, unit=V
    Volt16: category=VALUE, range phys 0..1, unit=V
    Volt17: category=VALUE, range phys -26.5..26.5, unit=V
    Volt18: category=VALUE, compu {raw=phys*8192; unit Units/FixdPt}, range phys 0..5, unit=V
    Volt2: category=VALUE, range phys 6..16, unit=V
    Volt3: category=VALUE, range phys 0..5, unit=V
    Volt4: category=VALUE, range phys 0..26.5, unit=V
    Volt5: category=VALUE, range phys 0..16, unit=V
    Volt6: category=VALUE, range phys 0..40, unit=V
    Volt7: category=VALUE, range phys 0.3..4.8, unit=V
    Volt8: category=VALUE, range phys 2.8..3, unit=V
    Volt9: category=VALUE, range phys 2..2.3, unit=V
    VoltGain1: category=VALUE, range phys -1..1, unit=VoltPerVoltNanoSec
    VoltTi1: category=VALUE, range phys 0..1040000, unit=VnS
    VoltTi2: category=VALUE, range phys 233330..1325008, unit=VnS
  application record data type HwAgOffsRecAppl1: category=STRUCTURE, sw-calibration-access=READ-ONLY
    application record element OffsTrim: category=VALUE, type=Ag19
    application record element OffsTrimPrfmdSts: category=BOOLEAN, type=Logl1
  application record data type MotPrmNomEolRecAppl2: category=STRUCTURE, sw-calibration-access=READ-ONLY
    application record element MotKeNom: category=VALUE, type=MotCon1
    application record element MotRNom: category=VALUE, type=R6
  application record data type MotPrmNomEolRecAppl3: category=STRUCTURE, sw-calibration-access=READ-ONLY
    application record element MotBackEmfConNom: category=VALUE, type=MotCon1
    application record element MotRNom: category=VALUE, type=R6
  554 x impl type:
    AdrMpgReqTyp1: compu {phys=raw for raw 0, phys=raw for raw 1}, implementation-data-type=uint8, type-emitter=RTE
    AnHwTqScaFacRec1: category=STRUCTURE, sw-calibration-access=READ-ONLY, dynamic-array-size-profile=None, type-emitter=RTE
      element SnsrSca: implementation-data-type=float32
      element SnsrScaPrfmdSts: implementation-data-type=boolean
    Ary1D_BlkFltTblRec1_5: category=ARRAY, sw-calibration-access=READ-ONLY, type-emitter=RTE
      element Element: array-size=5, array-size-semantics=FIXED-SIZE, implementation-data-type=BlkFltTblRec1
    Ary1D_boolean_4: category=ARRAY, sw-calibration-access=READ-ONLY, type-emitter=RTE
      element Element: array-size=4, array-size-semantics=FIXED-SIZE, implementation-data-type=boolean
    Ary1D_boolean_NvMProxy1: category=ARRAY, sw-calibration-access=READ-ONLY, type-emitter=Platform_Type
      element Element: array-size=65535, array-size-semantics=VARIABLE-SIZE, implementation-data-type=boolean
    Ary1D_CmdRtnBufRec1_NvMProxy1: category=ARRAY, sw-calibration-access=READ-ONLY, type-emitter=NvMProxy
      element Element: array-size=65535, array-size-semantics=VARIABLE-SIZE, implementation-data-type=CmdRtnBufRec1
    Ary1D_CrcHwStsRec1_4: category=ARRAY, sw-calibration-access=READ-ONLY, type-emitter=RTE
      element Element: array-size=4, array-size-semantics=FIXED-SIZE, implementation-data-type=CrcHwStsRec1
    Ary1D_CrcHwStsRec1_8: category=ARRAY, sw-calibration-access=READ-ONLY, type-emitter=RTE  # OBSOLETE
      element Element: array-size=8, array-size-semantics=FIXED-SIZE, implementation-data-type=CrcHwStsRec1
    Ary1D_CrcHwStsRec2_8: category=ARRAY, sw-calibration-access=READ-ONLY, type-emitter=RTE
      element Element: array-size=8, array-size-semantics=FIXED-SIZE, implementation-data-type=CrcHwStsRec2
    Ary1D_f32_11: category=ARRAY, sw-calibration-access=READ-ONLY, type-emitter=RTE
      element Element: array-size=11, array-size-semantics=FIXED-SIZE, implementation-data-type=float32
    Ary1D_f32_12: category=ARRAY, sw-calibration-access=READ-ONLY, type-emitter=RTE
      element Element: array-size=12, array-size-semantics=FIXED-SIZE, implementation-data-type=float32
    Ary1D_f32_2: category=ARRAY, sw-calibration-access=READ-ONLY, type-emitter=RTE
      element Element: array-size=2, array-size-semantics=FIXED-SIZE, implementation-data-type=float32
    Ary1D_f32_26: category=ARRAY, sw-calibration-access=READ-ONLY, type-emitter=RTE
      element Element: array-size=26, array-size-semantics=FIXED-SIZE, implementation-data-type=float32
    Ary1D_f32_3: category=ARRAY, sw-calibration-access=READ-ONLY, type-emitter=RTE
      element Element: array-size=3, array-size-semantics=FIXED-SIZE, implementation-data-type=float32
    Ary1D_f32_30: category=ARRAY, sw-calibration-access=READ-ONLY, type-emitter=RTE
      element Element: array-size=30, array-size-semantics=FIXED-SIZE, implementation-data-type=float32
    Ary1D_f32_4: category=ARRAY, sw-calibration-access=READ-ONLY, type-emitter=RTE
      element Element: array-size=4, array-size-semantics=FIXED-SIZE, implementation-data-type=float32
    Ary1D_f32_5: category=ARRAY, sw-calibration-access=READ-ONLY, type-emitter=RTE
      element Element: array-size=5, array-size-semantics=FIXED-SIZE, implementation-data-type=float32
    Ary1D_f32_72: category=ARRAY, sw-calibration-access=READ-ONLY, type-emitter=RTE
      element Element: array-size=72, array-size-semantics=FIXED-SIZE, implementation-data-type=float32
    Ary1D_f32_8: category=ARRAY, sw-calibration-access=READ-ONLY, type-emitter=RTE
      element Element: array-size=8, array-size-semantics=FIXED-SIZE, implementation-data-type=float32
    Ary1D_f32_StHlthSigStc1: category=ARRAY, sw-calibration-access=READ-ONLY, type-emitter=StHlthSigStc
      element Element: array-size=65535, array-size-semantics=VARIABLE-SIZE, implementation-data-type=float32
    Ary1D_GmSteerAgCtrlDiSt1_7: category=ARRAY, sw-calibration-access=READ-ONLY, type-emitter=RTE
      element Element: array-size=7, array-size-semantics=FIXED-SIZE, compu-method=GmSteerAgCtrlDiSt1, implementation-data-type=GmSteerAgCtrlDiSt1
    Ary1D_logl_2: category=ARRAY, sw-calibration-access=READ-ONLY, type-emitter=RTE
      element Element: array-size=2, array-size-semantics=FIXED-SIZE, implementation-data-type=boolean
    Ary1D_logl_3: category=ARRAY, sw-calibration-access=READ-ONLY, type-emitter=RTE
      element Element: array-size=3, array-size-semantics=FIXED-SIZE, implementation-data-type=boolean
    Ary1D_logl_4: category=ARRAY, sw-calibration-access=READ-ONLY, type-emitter=RTE
      element Element: array-size=4, array-size-semantics=FIXED-SIZE, implementation-data-type=boolean
    Ary1D_logl_4_01: category=ARRAY, sw-calibration-access=READ-ONLY, type-emitter=RTE
      element Element: array-size=4, array-size-semantics=FIXED-SIZE, implementation-data-type=boolean
    Ary1D_NtcFltInfoRec2_20: category=ARRAY, sw-calibration-access=READ-ONLY, type-emitter=RTE
      element Element: array-size=20, array-size-semantics=FIXED-SIZE, implementation-data-type=NtcFltInfoRec2
    Ary1D_NtcInfoRec4_DiagcMgr: category=ARRAY, type-emitter=DiagcMgr
      element Element: array-size=65535, array-size-semantics=VARIABLE-SIZE, implementation-data-type=NtcInfoRec4
    Ary1D_NtcInfoRec4_DiagcMgrProxyAppl0: category=ARRAY, type-emitter=DiagcMgr
      element Element: array-size=65535, array-size-semantics=VARIABLE-SIZE, implementation-data-type=NtcInfoRec4
    Ary1D_NtcInfoRec4_DiagcMgrProxyAppl1: category=ARRAY, type-emitter=DiagcMgr
      element Element: array-size=65535, array-size-semantics=VARIABLE-SIZE, implementation-data-type=NtcInfoRec4
    Ary1D_NtcInfoRec4_DiagcMgrProxyAppl10: category=ARRAY, type-emitter=DiagcMgr
      element Element: array-size=65535, array-size-semantics=VARIABLE-SIZE, implementation-data-type=NtcInfoRec4
    Ary1D_NtcInfoRec4_DiagcMgrProxyAppl2: category=ARRAY, type-emitter=DiagcMgr
      element Element: array-size=65535, array-size-semantics=VARIABLE-SIZE, implementation-data-type=NtcInfoRec4
    Ary1D_NtcInfoRec4_DiagcMgrProxyAppl3: category=ARRAY, type-emitter=DiagcMgr
      element Element: array-size=65535, array-size-semantics=VARIABLE-SIZE, implementation-data-type=NtcInfoRec4
    Ary1D_NtcInfoRec4_DiagcMgrProxyAppl4: category=ARRAY, type-emitter=DiagcMgr
      element Element: array-size=65535, array-size-semantics=VARIABLE-SIZE, implementation-data-type=NtcInfoRec4
    Ary1D_NtcInfoRec4_DiagcMgrProxyAppl5: category=ARRAY, type-emitter=DiagcMgr
      element Element: array-size=65535, array-size-semantics=VARIABLE-SIZE, implementation-data-type=NtcInfoRec4
    Ary1D_NtcInfoRec4_DiagcMgrProxyAppl6: category=ARRAY, type-emitter=DiagcMgr
      element Element: array-size=65535, array-size-semantics=VARIABLE-SIZE, implementation-data-type=NtcInfoRec4
    Ary1D_NtcInfoRec4_DiagcMgrProxyAppl7: category=ARRAY, type-emitter=DiagcMgr
      element Element: array-size=65535, array-size-semantics=VARIABLE-SIZE, implementation-data-type=NtcInfoRec4
    Ary1D_NtcInfoRec4_DiagcMgrProxyAppl8: category=ARRAY, type-emitter=DiagcMgr
      element Element: array-size=65535, array-size-semantics=VARIABLE-SIZE, implementation-data-type=NtcInfoRec4
    Ary1D_NtcInfoRec4_DiagcMgrProxyAppl9: category=ARRAY, type-emitter=DiagcMgr
      element Element: array-size=65535, array-size-semantics=VARIABLE-SIZE, implementation-data-type=NtcInfoRec4
    Ary1D_OnlineCalPageInfoRec1_2: category=ARRAY, sw-calibration-access=READ-ONLY, type-emitter=TunSelnMngt
      element Element: array-size=2, array-size-semantics=FIXED-SIZE, implementation-data-type=OnlineCalPageInfoRec1
    Ary1D_OnlineCalSegInfoRec1_TunSelnMngt1: category=ARRAY, sw-calibration-access=READ-ONLY, type-emitter=TunSelnMngt
      element Element: array-size=65535, array-size-semantics=VARIABLE-SIZE, implementation-data-type=OnlineCalSegInfoRec1
    Ary1D_ReadFltInfoRec1_20: category=ARRAY, sw-calibration-access=READ-ONLY, type-emitter=RTE
      element Element: array-size=20, array-size-semantics=FIXED-SIZE, implementation-data-type=ReadFltInfoRec1
    Ary1D_s10p5_8: category=ARRAY, sw-calibration-access=READ-ONLY, type-emitter=RTE
      element Element: array-size=8, array-size-semantics=FIXED-SIZE, implementation-data-type=s10p5
    Ary1D_s11p4_11: category=ARRAY, sw-calibration-access=READ-ONLY, type-emitter=RTE
      element Element: array-size=11, array-size-semantics=FIXED-SIZE, implementation-data-type=s11p4
    Ary1D_s11p4_14: category=ARRAY, sw-calibration-access=READ-ONLY, type-emitter=RTE
      element Element: array-size=14, array-size-semantics=FIXED-SIZE, implementation-data-type=s11p4
    Ary1D_s11p4_4: category=ARRAY, sw-calibration-access=READ-ONLY, type-emitter=RTE
      element Element: array-size=4, array-size-semantics=FIXED-SIZE, implementation-data-type=s11p4
    Ary1D_s11p4_5: category=ARRAY, sw-calibration-access=READ-ONLY, type-emitter=RTE
      element Element: array-size=5, array-size-semantics=FIXED-SIZE, implementation-data-type=s11p4
    Ary1D_s12p3_4: category=ARRAY, sw-calibration-access=READ-ONLY, type-emitter=RTE
      element Element: array-size=4, array-size-semantics=FIXED-SIZE, implementation-data-type=s12p3
    Ary1D_s14p1_4: category=ARRAY, sw-calibration-access=READ-ONLY, type-emitter=RTE
      element Element: array-size=4, array-size-semantics=FIXED-SIZE, implementation-data-type=s14p1
    Ary1D_s14p1_8: category=ARRAY, sw-calibration-access=READ-ONLY, type-emitter=RTE
      element Element: array-size=8, array-size-semantics=FIXED-SIZE, implementation-data-type=s14p1
    Ary1D_s15p0_10: category=ARRAY, sw-calibration-access=READ-ONLY, type-emitter=RTE
      element Element: array-size=10, array-size-semantics=FIXED-SIZE, implementation-data-type=s15p0
    Ary1D_s15p0_21: category=ARRAY, sw-calibration-access=READ-ONLY, type-emitter=RTE
      element Element: array-size=21, array-size-semantics=FIXED-SIZE, implementation-data-type=s15p0
    Ary1D_s15p0_4: category=ARRAY, sw-calibration-access=READ-ONLY, type-emitter=RTE
      element Element: array-size=4, array-size-semantics=FIXED-SIZE, implementation-data-type=s15p0
    Ary1D_s15p0_5: category=ARRAY, sw-calibration-access=READ-ONLY, type-emitter=RTE
      element Element: array-size=5, array-size-semantics=FIXED-SIZE, implementation-data-type=s15p0
    Ary1D_s16_22: category=ARRAY, sw-calibration-access=READ-ONLY, type-emitter=RTE
      element Element: array-size=22, array-size-semantics=FIXED-SIZE, implementation-data-type=sint16
    Ary1D_s16_DiagcMgrProxyAppl0: category=ARRAY, type-emitter=DiagcMgr
      element Element: array-size=65535, array-size-semantics=VARIABLE-SIZE, implementation-data-type=sint16
    Ary1D_s16_DiagcMgrProxyAppl1: category=ARRAY, type-emitter=DiagcMgr
      element Element: array-size=65535, array-size-semantics=VARIABLE-SIZE, implementation-data-type=sint16
    Ary1D_s16_DiagcMgrProxyAppl10: category=ARRAY, type-emitter=DiagcMgr
      element Element: array-size=65535, array-size-semantics=VARIABLE-SIZE, implementation-data-type=sint16
    Ary1D_s16_DiagcMgrProxyAppl2: category=ARRAY, type-emitter=DiagcMgr
      element Element: array-size=65535, array-size-semantics=VARIABLE-SIZE, implementation-data-type=sint16
    Ary1D_s16_DiagcMgrProxyAppl3: category=ARRAY, type-emitter=DiagcMgr
      element Element: array-size=65535, array-size-semantics=VARIABLE-SIZE, implementation-data-type=sint16
    Ary1D_s16_DiagcMgrProxyAppl4: category=ARRAY, type-emitter=DiagcMgr
      element Element: array-size=65535, array-size-semantics=VARIABLE-SIZE, implementation-data-type=sint16
    Ary1D_s16_DiagcMgrProxyAppl5: category=ARRAY, type-emitter=DiagcMgr
      element Element: array-size=65535, array-size-semantics=VARIABLE-SIZE, implementation-data-type=sint16
    Ary1D_s16_DiagcMgrProxyAppl6: category=ARRAY, type-emitter=DiagcMgr
      element Element: array-size=65535, array-size-semantics=VARIABLE-SIZE, implementation-data-type=sint16
    Ary1D_s16_DiagcMgrProxyAppl7: category=ARRAY, type-emitter=DiagcMgr
      element Element: array-size=65535, array-size-semantics=VARIABLE-SIZE, implementation-data-type=sint16
    Ary1D_s16_DiagcMgrProxyAppl8: category=ARRAY, type-emitter=DiagcMgr
      element Element: array-size=65535, array-size-semantics=VARIABLE-SIZE, implementation-data-type=sint16
    Ary1D_s16_DiagcMgrProxyAppl9: category=ARRAY, type-emitter=DiagcMgr
      element Element: array-size=65535, array-size-semantics=VARIABLE-SIZE, implementation-data-type=sint16
    Ary1D_s1p14_12: category=ARRAY, sw-calibration-access=READ-ONLY, type-emitter=RTE
      element Element: array-size=12, array-size-semantics=FIXED-SIZE, implementation-data-type=s1p14
    Ary1D_s1p14_128: category=ARRAY, sw-calibration-access=READ-ONLY, type-emitter=RTE
      element Element: array-size=128, array-size-semantics=FIXED-SIZE, implementation-data-type=s1p14
    Ary1D_s1p14_512: category=ARRAY, sw-calibration-access=READ-ONLY, type-emitter=RTE
      element Element: array-size=512, array-size-semantics=FIXED-SIZE, implementation-data-type=s1p14
    Ary1D_s2p13_1024: category=ARRAY, sw-calibration-access=READ-ONLY, type-emitter=RTE
      element Element: array-size=1024, array-size-semantics=FIXED-SIZE, implementation-data-type=s2p13
    Ary1D_s2p13_1025: category=ARRAY, sw-calibration-access=READ-ONLY, type-emitter=RTE
      element Element: array-size=1025, array-size-semantics=FIXED-SIZE, implementation-data-type=s2p13
    Ary1D_s2p13_21: category=ARRAY, sw-calibration-access=READ-ONLY, type-emitter=RTE
      element Element: array-size=21, array-size-semantics=FIXED-SIZE, implementation-data-type=s2p13
    Ary1D_s3p12_4: category=ARRAY, sw-calibration-access=READ-ONLY, type-emitter=RTE
      element Element: array-size=4, array-size-semantics=FIXED-SIZE, implementation-data-type=s3p12
    Ary1D_s4p11_11: category=ARRAY, sw-calibration-access=READ-ONLY, type-emitter=RTE
      element Element: array-size=11, array-size-semantics=FIXED-SIZE, implementation-data-type=s4p11
    Ary1D_s4p11_12: category=ARRAY, sw-calibration-access=READ-ONLY, type-emitter=RTE
      element Element: array-size=12, array-size-semantics=FIXED-SIZE, implementation-data-type=s4p11
    Ary1D_s4p11_13: category=ARRAY, sw-calibration-access=READ-ONLY, type-emitter=RTE
      element Element: array-size=13, array-size-semantics=FIXED-SIZE, implementation-data-type=s4p11
    Ary1D_s4p11_20: category=ARRAY, sw-calibration-access=READ-ONLY, type-emitter=RTE
      element Element: array-size=20, array-size-semantics=FIXED-SIZE, implementation-data-type=s4p11
    Ary1D_s4p11_4: category=ARRAY, sw-calibration-access=READ-ONLY, type-emitter=RTE
      element Element: array-size=4, array-size-semantics=FIXED-SIZE, implementation-data-type=s4p11
    Ary1D_s4p11_5: category=ARRAY, sw-calibration-access=READ-ONLY, type-emitter=RTE
      element Element: array-size=5, array-size-semantics=FIXED-SIZE, implementation-data-type=s4p11
    Ary1D_s4p11_7: category=ARRAY, sw-calibration-access=READ-ONLY, type-emitter=RTE
      element Element: array-size=7, array-size-semantics=FIXED-SIZE, implementation-data-type=s4p11
    Ary1D_s4p11_8: category=ARRAY, sw-calibration-access=READ-ONLY, type-emitter=RTE
      element Element: array-size=8, array-size-semantics=FIXED-SIZE, implementation-data-type=s4p11
    Ary1D_s7p8_11: category=ARRAY, sw-calibration-access=READ-ONLY, type-emitter=RTE
      element Element: array-size=11, array-size-semantics=FIXED-SIZE, implementation-data-type=s7p8
    Ary1D_s7p8_12: category=ARRAY, sw-calibration-access=READ-ONLY, type-emitter=RTE
      element Element: array-size=12, array-size-semantics=FIXED-SIZE, implementation-data-type=s7p8
    Ary1D_s7p8_20: category=ARRAY, sw-calibration-access=READ-ONLY, type-emitter=RTE
      element Element: array-size=20, array-size-semantics=FIXED-SIZE, implementation-data-type=s7p8
    Ary1D_s7p8_4: category=ARRAY, sw-calibration-access=READ-ONLY, type-emitter=RTE
      element Element: array-size=4, array-size-semantics=FIXED-SIZE, implementation-data-type=s7p8
    Ary1D_s7p8_5: category=ARRAY, sw-calibration-access=READ-ONLY, type-emitter=RTE
      element Element: array-size=5, array-size-semantics=FIXED-SIZE, implementation-data-type=s7p8
    Ary1D_s7p8_6: category=ARRAY, sw-calibration-access=READ-ONLY, type-emitter=RTE
      element Element: array-size=6, array-size-semantics=FIXED-SIZE, implementation-data-type=s7p8
    Ary1D_s8p7_12: category=ARRAY, sw-calibration-access=READ-ONLY, type-emitter=RTE
      element Element: array-size=12, array-size-semantics=FIXED-SIZE, implementation-data-type=s8p7
    Ary1D_s8p7_14: category=ARRAY, sw-calibration-access=READ-ONLY, type-emitter=RTE
      element Element: array-size=14, array-size-semantics=FIXED-SIZE, implementation-data-type=s8p7
    Ary1D_s8p7_21: category=ARRAY, sw-calibration-access=READ-ONLY, type-emitter=RTE
      element Element: array-size=21, array-size-semantics=FIXED-SIZE, implementation-data-type=s8p7
    Ary1D_s8p7_3: category=ARRAY, sw-calibration-access=READ-ONLY, type-emitter=RTE
      element Element: array-size=3, array-size-semantics=FIXED-SIZE, implementation-data-type=s8p7
    Ary1D_s8p7_4: category=ARRAY, sw-calibration-access=READ-ONLY, type-emitter=RTE
      element Element: array-size=4, array-size-semantics=FIXED-SIZE, implementation-data-type=s8p7
    Ary1D_sm5p12_128: category=ARRAY, sw-calibration-access=READ-ONLY, type-emitter=RTE
      element Element: array-size=128, array-size-semantics=FIXED-SIZE, implementation-data-type=sm5p12
    Ary1D_sm6p13_144: category=ARRAY, sw-calibration-access=READ-ONLY, type-emitter=RTE
      element Element: array-size=144, array-size-semantics=FIXED-SIZE, implementation-data-type=sm6p13
    Ary1D_SnpshtDataRec1_8: category=ARRAY, sw-calibration-access=READ-ONLY, type-emitter=RTE
      element Element: array-size=8, array-size-semantics=FIXED-SIZE, implementation-data-type=SnpshtDataRec1
    Ary1D_SnpshtDataRec2_8: category=ARRAY, sw-calibration-access=READ-ONLY, type-emitter=RTE
      element Element: array-size=8, array-size-semantics=FIXED-SIZE, implementation-data-type=SnpshtDataRec2
    Ary1D_u08_12: category=ARRAY, sw-calibration-access=READ-ONLY, type-emitter=RTE
      element Element: array-size=12, array-size-semantics=FIXED-SIZE, implementation-data-type=uint8
    Ary1D_u08_17: category=ARRAY, sw-calibration-access=READ-ONLY, type-emitter=RTE
      element Element: array-size=17, array-size-semantics=FIXED-SIZE, implementation-data-type=uint8
    Ary1D_u08_2: category=ARRAY, sw-calibration-access=READ-ONLY, type-emitter=RTE
      element Element: array-size=2, array-size-semantics=FIXED-SIZE, implementation-data-type=uint8
    Ary1D_u08_20: category=ARRAY, sw-calibration-access=READ-ONLY, type-emitter=RTE
      element Element: array-size=20, array-size-semantics=FIXED-SIZE, implementation-data-type=uint8
    Ary1D_u08_22: category=ARRAY, sw-calibration-access=READ-ONLY, type-emitter=RTE
      element Element: array-size=22, array-size-semantics=FIXED-SIZE, implementation-data-type=uint8
    Ary1D_u08_225: category=ARRAY, sw-calibration-access=READ-ONLY, type-emitter=RTE
      element Element: array-size=225, array-size-semantics=FIXED-SIZE, implementation-data-type=uint8
    Ary1D_u08_255: category=ARRAY, sw-calibration-access=READ-ONLY, type-emitter=StHlthSigStc
      element Element: array-size=255, array-size-semantics=FIXED-SIZE, implementation-data-type=uint8
    Ary1D_u08_3: category=ARRAY, sw-calibration-access=READ-ONLY, type-emitter=RTE
      element Element: array-size=3, array-size-semantics=FIXED-SIZE, implementation-data-type=uint8
    Ary1D_u08_48: category=ARRAY, sw-calibration-access=READ-ONLY, type-emitter=RTE
      element Element: array-size=48, array-size-semantics=FIXED-SIZE, implementation-data-type=uint8
    Ary1D_u08_5: category=ARRAY, sw-calibration-access=READ-ONLY, type-emitter=RTE
      element Element: array-size=5, array-size-semantics=FIXED-SIZE, implementation-data-type=uint8
    Ary1D_u08_6: category=ARRAY, sw-calibration-access=READ-ONLY, type-emitter=RTE
      element Element: array-size=6, array-size-semantics=FIXED-SIZE, implementation-data-type=uint8
    Ary1D_u08_8: category=ARRAY, sw-calibration-access=READ-ONLY, type-emitter=RTE
      element Element: array-size=8, array-size-semantics=FIXED-SIZE, implementation-data-type=uint8
    Ary1D_u08_CmnMfgSrvIf: category=ARRAY, type-emitter=CmnMfgSrvIf
      element Element: array-size=65535, array-size-semantics=VARIABLE-SIZE, implementation-data-type=uint8
    Ary1D_u08_DiagcMgr1: category=ARRAY, type-emitter=DiagcMgr
      element Element: array-size=65535, array-size-semantics=VARIABLE-SIZE, implementation-data-type=uint8
    Ary1D_u08_StHlthSigStc1: category=ARRAY, type-emitter=StHlthSigStc
      element Element: array-size=65535, array-size-semantics=VARIABLE-SIZE, implementation-data-type=uint8
    Ary1D_u0p16_10: category=ARRAY, sw-calibration-access=READ-ONLY, type-emitter=RTE
      element Element: array-size=10, array-size-semantics=FIXED-SIZE, implementation-data-type=u0p16
    Ary1D_u0p16_2: category=ARRAY, sw-calibration-access=READ-ONLY, type-emitter=RTE
      element Element: array-size=2, array-size-semantics=FIXED-SIZE, implementation-data-type=u0p16
    Ary1D_u0p16_3: category=ARRAY, sw-calibration-access=READ-ONLY, type-emitter=RTE
      element Element: array-size=3, array-size-semantics=FIXED-SIZE, implementation-data-type=u0p16
    Ary1D_u0p16_8: category=ARRAY, sw-calibration-access=READ-ONLY, type-emitter=RTE
      element Element: array-size=8, array-size-semantics=FIXED-SIZE, implementation-data-type=u0p16
    Ary1D_u10p6_10: category=ARRAY, sw-calibration-access=READ-ONLY, type-emitter=RTE
      element Element: array-size=10, array-size-semantics=FIXED-SIZE, implementation-data-type=u10p6
    Ary1D_u10p6_12: category=ARRAY, sw-calibration-access=READ-ONLY, type-emitter=RTE
      element Element: array-size=12, array-size-semantics=FIXED-SIZE, implementation-data-type=u10p6
    Ary1D_u10p6_13: category=ARRAY, sw-calibration-access=READ-ONLY, type-emitter=RTE
      element Element: array-size=13, array-size-semantics=FIXED-SIZE, implementation-data-type=u10p6
    Ary1D_u10p6_2: category=ARRAY, sw-calibration-access=READ-ONLY, type-emitter=RTE
      element Element: array-size=2, array-size-semantics=FIXED-SIZE, implementation-data-type=u10p6
    Ary1D_u10p6_3: category=ARRAY, sw-calibration-access=READ-ONLY, type-emitter=RTE
      element Element: array-size=3, array-size-semantics=FIXED-SIZE, implementation-data-type=u10p6
    Ary1D_u10p6_4: category=ARRAY, sw-calibration-access=READ-ONLY, type-emitter=RTE
      element Element: array-size=4, array-size-semantics=FIXED-SIZE, implementation-data-type=u10p6
    Ary1D_u10p6_5: category=ARRAY, sw-calibration-access=READ-ONLY, type-emitter=RTE
      element Element: array-size=5, array-size-semantics=FIXED-SIZE, implementation-data-type=u10p6
    Ary1D_u10p6_7: category=ARRAY, sw-calibration-access=READ-ONLY, type-emitter=RTE
      element Element: array-size=7, array-size-semantics=FIXED-SIZE, implementation-data-type=u10p6
    Ary1D_u10p6_8: category=ARRAY, sw-calibration-access=READ-ONLY, type-emitter=RTE
      element Element: array-size=8, array-size-semantics=FIXED-SIZE, implementation-data-type=u10p6
    Ary1D_u10p6_9: category=ARRAY, sw-calibration-access=READ-ONLY, type-emitter=RTE
      element Element: array-size=9, array-size-semantics=FIXED-SIZE, implementation-data-type=u10p6
    Ary1D_u11p5_10: category=ARRAY, sw-calibration-access=READ-ONLY, type-emitter=RTE
      element Element: array-size=10, array-size-semantics=FIXED-SIZE, implementation-data-type=u11p5
    Ary1D_u11p5_11: category=ARRAY, sw-calibration-access=READ-ONLY, type-emitter=RTE
      element Element: array-size=11, array-size-semantics=FIXED-SIZE, implementation-data-type=u11p5
    Ary1D_u11p5_12: category=ARRAY, sw-calibration-access=READ-ONLY, type-emitter=RTE
      element Element: array-size=12, array-size-semantics=FIXED-SIZE, implementation-data-type=u11p5
    Ary1D_u11p5_13: category=ARRAY, sw-calibration-access=READ-ONLY, type-emitter=RTE
      element Element: array-size=13, array-size-semantics=FIXED-SIZE, implementation-data-type=u11p5
    Ary1D_u11p5_4: category=ARRAY, sw-calibration-access=READ-ONLY, type-emitter=RTE
      element Element: array-size=4, array-size-semantics=FIXED-SIZE, implementation-data-type=u11p5
    Ary1D_u11p5_5: category=ARRAY, sw-calibration-access=READ-ONLY, type-emitter=RTE
      element Element: array-size=5, array-size-semantics=FIXED-SIZE, implementation-data-type=u11p5
    Ary1D_u11p5_6: category=ARRAY, sw-calibration-access=READ-ONLY, type-emitter=RTE
      element Element: array-size=6, array-size-semantics=FIXED-SIZE, implementation-data-type=u11p5
    Ary1D_u11p5_7: category=ARRAY, sw-calibration-access=READ-ONLY, type-emitter=RTE
      element Element: array-size=7, array-size-semantics=FIXED-SIZE, implementation-data-type=u11p5
    Ary1D_u11p5_8: category=ARRAY, sw-calibration-access=READ-ONLY, type-emitter=RTE
      element Element: array-size=8, array-size-semantics=FIXED-SIZE, implementation-data-type=u11p5
    Ary1D_u11p5_9: category=ARRAY, sw-calibration-access=READ-ONLY, type-emitter=RTE
      element Element: array-size=9, array-size-semantics=FIXED-SIZE, implementation-data-type=u11p5
    Ary1D_u12p4_10: category=ARRAY, sw-calibration-access=READ-ONLY, type-emitter=RTE
      element Element: array-size=10, array-size-semantics=FIXED-SIZE, implementation-data-type=u12p4
    Ary1D_u12p4_12: category=ARRAY, sw-calibration-access=READ-ONLY, type-emitter=RTE
      element Element: array-size=12, array-size-semantics=FIXED-SIZE, implementation-data-type=u12p4
    Ary1D_u12p4_13: category=ARRAY, sw-calibration-access=READ-ONLY, type-emitter=RTE
      element Element: array-size=13, array-size-semantics=FIXED-SIZE, implementation-data-type=u12p4
    Ary1D_u12p4_16: category=ARRAY, sw-calibration-access=READ-ONLY, type-emitter=RTE
      element Element: array-size=16, array-size-semantics=FIXED-SIZE, implementation-data-type=u12p4
    Ary1D_u12p4_2: category=ARRAY, sw-calibration-access=READ-ONLY, type-emitter=RTE
      element Element: array-size=2, array-size-semantics=FIXED-SIZE, implementation-data-type=u12p4
    Ary1D_u12p4_4: category=ARRAY, sw-calibration-access=READ-ONLY, type-emitter=RTE
      element Element: array-size=4, array-size-semantics=FIXED-SIZE, implementation-data-type=u12p4
    Ary1D_u12p4_7: category=ARRAY, sw-calibration-access=READ-ONLY, type-emitter=RTE
      element Element: array-size=7, array-size-semantics=FIXED-SIZE, implementation-data-type=u12p4
    Ary1D_u12p4_9: category=ARRAY, sw-calibration-access=READ-ONLY, type-emitter=RTE
      element Element: array-size=9, array-size-semantics=FIXED-SIZE, implementation-data-type=u12p4
    Ary1D_u13p3_2: category=ARRAY, sw-calibration-access=READ-ONLY, type-emitter=RTE
      element Element: array-size=2, array-size-semantics=FIXED-SIZE, implementation-data-type=u13p3
    Ary1D_u13p3_4: category=ARRAY, sw-calibration-access=READ-ONLY, type-emitter=RTE
      element Element: array-size=4, array-size-semantics=FIXED-SIZE, implementation-data-type=u13p3
    Ary1D_u13p3_6: category=ARRAY, sw-calibration-access=READ-ONLY, type-emitter=RTE
      element Element: array-size=6, array-size-semantics=FIXED-SIZE, implementation-data-type=u13p3
    Ary1D_u15p1_10: category=ARRAY, sw-calibration-access=READ-ONLY, type-emitter=RTE
      element Element: array-size=10, array-size-semantics=FIXED-SIZE, implementation-data-type=u15p1
    Ary1D_u15p1_12: category=ARRAY, sw-calibration-access=READ-ONLY, type-emitter=RTE
      element Element: array-size=12, array-size-semantics=FIXED-SIZE, implementation-data-type=u15p1
    Ary1D_u15p1_24: category=ARRAY, sw-calibration-access=READ-ONLY, type-emitter=RTE
      element Element: array-size=24, array-size-semantics=FIXED-SIZE, implementation-data-type=u15p1
    Ary1D_u15p1_4: category=ARRAY, sw-calibration-access=READ-ONLY, type-emitter=RTE
      element Element: array-size=4, array-size-semantics=FIXED-SIZE, implementation-data-type=u15p1
    Ary1D_u15p1_9: category=ARRAY, sw-calibration-access=READ-ONLY, type-emitter=RTE
      element Element: array-size=9, array-size-semantics=FIXED-SIZE, implementation-data-type=u15p1
    Ary1D_u16_12: category=ARRAY, sw-calibration-access=READ-ONLY, type-emitter=RTE
      element Element: array-size=12, array-size-semantics=FIXED-SIZE, implementation-data-type=uint16
    Ary1D_u16_13: category=ARRAY, sw-calibration-access=READ-ONLY, type-emitter=RTE
      element Element: array-size=13, array-size-semantics=FIXED-SIZE, implementation-data-type=uint16
    Ary1D_u16_257: category=ARRAY, sw-calibration-access=READ-ONLY, type-emitter=RTE
      element Element: array-size=257, array-size-semantics=FIXED-SIZE, implementation-data-type=uint16
    Ary1D_u16_3: category=ARRAY, sw-calibration-access=READ-ONLY, type-emitter=RTE
      element Element: array-size=3, array-size-semantics=FIXED-SIZE, implementation-data-type=uint16
    Ary1D_u16_5: category=ARRAY, sw-calibration-access=READ-ONLY, type-emitter=RTE
      element Element: array-size=5, array-size-semantics=FIXED-SIZE, implementation-data-type=uint16
    Ary1D_u16_512: category=ARRAY, sw-calibration-access=READ-ONLY, type-emitter=RTE
      element Element: array-size=512, array-size-semantics=FIXED-SIZE, implementation-data-type=uint16
    Ary1D_u16_8: category=ARRAY, sw-calibration-access=READ-ONLY, type-emitter=RTE
      element Element: array-size=8, array-size-semantics=FIXED-SIZE, implementation-data-type=uint16
    Ary1D_u16p0_2: category=ARRAY, sw-calibration-access=READ-ONLY, type-emitter=RTE
      element Element: array-size=2, array-size-semantics=FIXED-SIZE, implementation-data-type=u16p0
    Ary1D_u16p0_20: category=ARRAY, sw-calibration-access=READ-ONLY, type-emitter=RTE
      element Element: array-size=20, array-size-semantics=FIXED-SIZE, implementation-data-type=u16p0
    Ary1D_u16p0_22: category=ARRAY, sw-calibration-access=READ-ONLY, type-emitter=RTE
      element Element: array-size=22, array-size-semantics=FIXED-SIZE, implementation-data-type=u16p0
    Ary1D_u16p0_8: category=ARRAY, sw-calibration-access=READ-ONLY, type-emitter=RTE
      element Element: array-size=8, array-size-semantics=FIXED-SIZE, implementation-data-type=u16p0
    Ary1D_u1p15_10: category=ARRAY, sw-calibration-access=READ-ONLY, type-emitter=RTE
      element Element: array-size=10, array-size-semantics=FIXED-SIZE, implementation-data-type=u1p15
    Ary1D_u1p15_11: category=ARRAY, sw-calibration-access=READ-ONLY, type-emitter=RTE
      element Element: array-size=11, array-size-semantics=FIXED-SIZE, implementation-data-type=u1p15
    Ary1D_u1p15_12: category=ARRAY, sw-calibration-access=READ-ONLY, type-emitter=RTE
      element Element: array-size=12, array-size-semantics=FIXED-SIZE, implementation-data-type=u1p15
    Ary1D_u1p15_2: category=ARRAY, sw-calibration-access=READ-ONLY, type-emitter=RTE
      element Element: array-size=2, array-size-semantics=FIXED-SIZE, implementation-data-type=u1p15
    Ary1D_u1p15_21: category=ARRAY, sw-calibration-access=READ-ONLY, type-emitter=RTE
      element Element: array-size=21, array-size-semantics=FIXED-SIZE, implementation-data-type=u1p15
    Ary1D_u1p15_4: category=ARRAY, sw-calibration-access=READ-ONLY, type-emitter=RTE
      element Element: array-size=4, array-size-semantics=FIXED-SIZE, implementation-data-type=u1p15
    Ary1D_u1p15_5: category=ARRAY, sw-calibration-access=READ-ONLY, type-emitter=RTE
      element Element: array-size=5, array-size-semantics=FIXED-SIZE, implementation-data-type=u1p15
    Ary1D_u1p15_6: category=ARRAY, sw-calibration-access=READ-ONLY, type-emitter=RTE
      element Element: array-size=6, array-size-semantics=FIXED-SIZE, implementation-data-type=u1p15
    Ary1D_u1p15_9: category=ARRAY, sw-calibration-access=READ-ONLY, type-emitter=RTE
      element Element: array-size=9, array-size-semantics=FIXED-SIZE, implementation-data-type=u1p15
    Ary1D_u2p14_10: category=ARRAY, sw-calibration-access=READ-ONLY, type-emitter=RTE
      element Element: array-size=10, array-size-semantics=FIXED-SIZE, implementation-data-type=u2p14
    Ary1D_u2p14_11: category=ARRAY, sw-calibration-access=READ-ONLY, type-emitter=RTE
      element Element: array-size=11, array-size-semantics=FIXED-SIZE, implementation-data-type=u2p14
    Ary1D_u2p14_12: category=ARRAY, sw-calibration-access=READ-ONLY, type-emitter=RTE
      element Element: array-size=12, array-size-semantics=FIXED-SIZE, implementation-data-type=u2p14
    Ary1D_u2p14_16: category=ARRAY, sw-calibration-access=READ-ONLY, type-emitter=RTE
      element Element: array-size=16, array-size-semantics=FIXED-SIZE, implementation-data-type=u2p14
    Ary1D_u2p14_2: category=ARRAY, sw-calibration-access=READ-ONLY, type-emitter=RTE
      element Element: array-size=2, array-size-semantics=FIXED-SIZE, implementation-data-type=u2p14
    Ary1D_u2p14_3: category=ARRAY, sw-calibration-access=READ-ONLY, type-emitter=RTE
      element Element: array-size=3, array-size-semantics=FIXED-SIZE, implementation-data-type=u2p14
    Ary1D_u2p14_4: category=ARRAY, sw-calibration-access=READ-ONLY, type-emitter=RTE
      element Element: array-size=4, array-size-semantics=FIXED-SIZE, implementation-data-type=u2p14
    Ary1D_u2p14_5: category=ARRAY, sw-calibration-access=READ-ONLY, type-emitter=RTE
      element Element: array-size=5, array-size-semantics=FIXED-SIZE, implementation-data-type=u2p14
    Ary1D_u2p14_6: category=ARRAY, sw-calibration-access=READ-ONLY, type-emitter=RTE
      element Element: array-size=6, array-size-semantics=FIXED-SIZE, implementation-data-type=u2p14
    Ary1D_u2p14_7: category=ARRAY, sw-calibration-access=READ-ONLY, type-emitter=RTE
      element Element: array-size=7, array-size-semantics=FIXED-SIZE, implementation-data-type=u2p14
    Ary1D_u2p14_8: category=ARRAY, sw-calibration-access=READ-ONLY, type-emitter=RTE
      element Element: array-size=8, array-size-semantics=FIXED-SIZE, implementation-data-type=u2p14
    Ary1D_u2p14_9: category=ARRAY, sw-calibration-access=READ-ONLY, type-emitter=RTE
      element Element: array-size=9, array-size-semantics=FIXED-SIZE, implementation-data-type=u2p14
    Ary1D_u32_2: category=ARRAY, sw-calibration-access=READ-ONLY, type-emitter=RTE
      element Element: array-size=2, array-size-semantics=FIXED-SIZE, implementation-data-type=uint32
    Ary1D_u32_4: category=ARRAY, sw-calibration-access=READ-ONLY, type-emitter=RTE
      element Element: array-size=4, array-size-semantics=FIXED-SIZE, implementation-data-type=uint32
    Ary1D_u32_5: category=ARRAY, sw-calibration-access=READ-ONLY, type-emitter=RTE
      element Element: array-size=5, array-size-semantics=FIXED-SIZE, implementation-data-type=uint32
    Ary1D_u32_50: category=ARRAY, sw-calibration-access=READ-ONLY, type-emitter=StHlthSigStc
      element Element: array-size=50, array-size-semantics=FIXED-SIZE, implementation-data-type=uint32
    Ary1D_u32_512: category=ARRAY, sw-calibration-access=READ-ONLY, type-emitter=RTE
      element Element: array-size=512, array-size-semantics=FIXED-SIZE, implementation-data-type=uint32
    Ary1D_u32_8: category=ARRAY, sw-calibration-access=READ-ONLY, type-emitter=RTE
      element Element: array-size=8, array-size-semantics=FIXED-SIZE, implementation-data-type=uint32
    Ary1D_u32_StHlthSigStc1: category=ARRAY, type-emitter=StHlthSigStc
      element Element: array-size=65535, array-size-semantics=VARIABLE-SIZE, implementation-data-type=uint32
    Ary1D_u3p13_10: category=ARRAY, sw-calibration-access=READ-ONLY, type-emitter=RTE
      element Element: array-size=10, array-size-semantics=FIXED-SIZE, implementation-data-type=u3p13
    Ary1D_u3p13_13: category=ARRAY, sw-calibration-access=READ-ONLY, type-emitter=RTE
      element Element: array-size=13, array-size-semantics=FIXED-SIZE, implementation-data-type=u3p13
    Ary1D_u3p13_5: category=ARRAY, sw-calibration-access=READ-ONLY, type-emitter=RTE
      element Element: array-size=5, array-size-semantics=FIXED-SIZE, implementation-data-type=u3p13
    Ary1D_u3p13_50: category=ARRAY, sw-calibration-access=READ-ONLY, type-emitter=RTE
      element Element: array-size=50, array-size-semantics=FIXED-SIZE, implementation-data-type=u3p13
    Ary1D_u3p13_8: category=ARRAY, sw-calibration-access=READ-ONLY, type-emitter=RTE
      element Element: array-size=8, array-size-semantics=FIXED-SIZE, implementation-data-type=u3p13
    Ary1D_u4p12_10: category=ARRAY, sw-calibration-access=READ-ONLY, type-emitter=RTE
      element Element: array-size=10, array-size-semantics=FIXED-SIZE, implementation-data-type=u4p12
    Ary1D_u4p12_11: category=ARRAY, sw-calibration-access=READ-ONLY, type-emitter=RTE
      element Element: array-size=11, array-size-semantics=FIXED-SIZE, implementation-data-type=u4p12
    Ary1D_u4p12_12: category=ARRAY, sw-calibration-access=READ-ONLY, type-emitter=RTE
      element Element: array-size=12, array-size-semantics=FIXED-SIZE, implementation-data-type=u4p12
    Ary1D_u4p12_13: category=ARRAY, sw-calibration-access=READ-ONLY, type-emitter=RTE
      element Element: array-size=13, array-size-semantics=FIXED-SIZE, implementation-data-type=u4p12
    Ary1D_u4p12_14: category=ARRAY, sw-calibration-access=READ-ONLY, type-emitter=RTE
      element Element: array-size=14, array-size-semantics=FIXED-SIZE, implementation-data-type=u4p12
    Ary1D_u4p12_2: category=ARRAY, sw-calibration-access=READ-ONLY, type-emitter=RTE
      element Element: array-size=2, array-size-semantics=FIXED-SIZE, implementation-data-type=u4p12
    Ary1D_u4p12_20: category=ARRAY, sw-calibration-access=READ-ONLY, type-emitter=RTE
      element Element: array-size=20, array-size-semantics=FIXED-SIZE, implementation-data-type=u4p12
    Ary1D_u4p12_21: category=ARRAY, sw-calibration-access=READ-ONLY, type-emitter=RTE
      element Element: array-size=21, array-size-semantics=FIXED-SIZE, implementation-data-type=u4p12
    Ary1D_u4p12_24: category=ARRAY, sw-calibration-access=READ-ONLY, type-emitter=RTE
      element Element: array-size=24, array-size-semantics=FIXED-SIZE, implementation-data-type=u4p12
    Ary1D_u4p12_3: category=ARRAY, sw-calibration-access=READ-ONLY, type-emitter=RTE
      element Element: array-size=3, array-size-semantics=FIXED-SIZE, implementation-data-type=u4p12
    Ary1D_u4p12_4: category=ARRAY, sw-calibration-access=READ-ONLY, type-emitter=RTE
      element Element: array-size=4, array-size-semantics=FIXED-SIZE, implementation-data-type=u4p12
    Ary1D_u4p12_5: category=ARRAY, sw-calibration-access=READ-ONLY, type-emitter=RTE
      element Element: array-size=5, array-size-semantics=FIXED-SIZE, implementation-data-type=u4p12
    Ary1D_u4p12_6: category=ARRAY, sw-calibration-access=READ-ONLY, type-emitter=RTE
      element Element: array-size=6, array-size-semantics=FIXED-SIZE, implementation-data-type=u4p12
    Ary1D_u4p12_7: category=ARRAY, sw-calibration-access=READ-ONLY, type-emitter=RTE
      element Element: array-size=7, array-size-semantics=FIXED-SIZE, implementation-data-type=u4p12
    Ary1D_u4p12_8: category=ARRAY, sw-calibration-access=READ-ONLY, type-emitter=RTE
      element Element: array-size=8, array-size-semantics=FIXED-SIZE, implementation-data-type=u4p12
    Ary1D_u4p12_9: category=ARRAY, sw-calibration-access=READ-ONLY, type-emitter=RTE
      element Element: array-size=9, array-size-semantics=FIXED-SIZE, implementation-data-type=u4p12
    Ary1D_u5p11_10: category=ARRAY, sw-calibration-access=READ-ONLY, type-emitter=RTE
      element Element: array-size=10, array-size-semantics=FIXED-SIZE, implementation-data-type=u5p11
    Ary1D_u5p11_11: category=ARRAY, sw-calibration-access=READ-ONLY, type-emitter=RTE
      element Element: array-size=11, array-size-semantics=FIXED-SIZE, implementation-data-type=u5p11
    Ary1D_u5p11_12: category=ARRAY, sw-calibration-access=READ-ONLY, type-emitter=RTE
      element Element: array-size=12, array-size-semantics=FIXED-SIZE, implementation-data-type=u5p11
    Ary1D_u5p11_13: category=ARRAY, sw-calibration-access=READ-ONLY, type-emitter=RTE
      element Element: array-size=13, array-size-semantics=FIXED-SIZE, implementation-data-type=u5p11
    Ary1D_u5p11_14: category=ARRAY, sw-calibration-access=READ-ONLY, type-emitter=RTE
      element Element: array-size=14, array-size-semantics=FIXED-SIZE, implementation-data-type=u5p11
    Ary1D_u5p11_16: category=ARRAY, sw-calibration-access=READ-ONLY, type-emitter=RTE
      element Element: array-size=16, array-size-semantics=FIXED-SIZE, implementation-data-type=u5p11
    Ary1D_u5p11_17: category=ARRAY, sw-calibration-access=READ-ONLY, type-emitter=RTE
      element Element: array-size=17, array-size-semantics=FIXED-SIZE, implementation-data-type=u5p11
    Ary1D_u5p11_21: category=ARRAY, sw-calibration-access=READ-ONLY, type-emitter=RTE
      element Element: array-size=21, array-size-semantics=FIXED-SIZE, implementation-data-type=u5p11
    Ary1D_u5p11_5: category=ARRAY, sw-calibration-access=READ-ONLY, type-emitter=RTE
      element Element: array-size=5, array-size-semantics=FIXED-SIZE, implementation-data-type=u5p11
    Ary1D_u5p11_6: category=ARRAY, sw-calibration-access=READ-ONLY, type-emitter=RTE
      element Element: array-size=6, array-size-semantics=FIXED-SIZE, implementation-data-type=u5p11
    Ary1D_u5p11_8: category=ARRAY, sw-calibration-access=READ-ONLY, type-emitter=RTE
      element Element: array-size=8, array-size-semantics=FIXED-SIZE, implementation-data-type=u5p11
    Ary1D_u5p11_9: category=ARRAY, sw-calibration-access=READ-ONLY, type-emitter=RTE
      element Element: array-size=9, array-size-semantics=FIXED-SIZE, implementation-data-type=u5p11
    Ary1D_u6p10_10: category=ARRAY, sw-calibration-access=READ-ONLY, type-emitter=RTE
      element Element: array-size=10, array-size-semantics=FIXED-SIZE, implementation-data-type=u6p10
    Ary1D_u6p10_12: category=ARRAY, sw-calibration-access=READ-ONLY, type-emitter=RTE
      element Element: array-size=12, array-size-semantics=FIXED-SIZE, implementation-data-type=u6p10
    Ary1D_u6p10_13: category=ARRAY, sw-calibration-access=READ-ONLY, type-emitter=RTE
      element Element: array-size=13, array-size-semantics=FIXED-SIZE, implementation-data-type=u6p10
    Ary1D_u6p10_17: category=ARRAY, sw-calibration-access=READ-ONLY, type-emitter=RTE
      element Element: array-size=17, array-size-semantics=FIXED-SIZE, implementation-data-type=u6p10
    Ary1D_u6p10_2: category=ARRAY, sw-calibration-access=READ-ONLY, type-emitter=RTE
      element Element: array-size=2, array-size-semantics=FIXED-SIZE, implementation-data-type=u6p10
    Ary1D_u6p10_20: category=ARRAY, sw-calibration-access=READ-ONLY, type-emitter=RTE
      element Element: array-size=20, array-size-semantics=FIXED-SIZE, implementation-data-type=u6p10
    Ary1D_u6p10_5: category=ARRAY, sw-calibration-access=READ-ONLY, type-emitter=RTE
      element Element: array-size=5, array-size-semantics=FIXED-SIZE, implementation-data-type=u6p10
    Ary1D_u6p10_6: category=ARRAY, sw-calibration-access=READ-ONLY, type-emitter=RTE
      element Element: array-size=6, array-size-semantics=FIXED-SIZE, implementation-data-type=u6p10
    Ary1D_u6p10_8: category=ARRAY, sw-calibration-access=READ-ONLY, type-emitter=RTE
      element Element: array-size=8, array-size-semantics=FIXED-SIZE, implementation-data-type=u6p10
    Ary1D_u6p10_9: category=ARRAY, sw-calibration-access=READ-ONLY, type-emitter=RTE
      element Element: array-size=9, array-size-semantics=FIXED-SIZE, implementation-data-type=u6p10
    Ary1D_u7p9_12: category=ARRAY, sw-calibration-access=READ-ONLY, type-emitter=RTE
      element Element: array-size=12, array-size-semantics=FIXED-SIZE, implementation-data-type=u7p9
    Ary1D_u7p9_3: category=ARRAY, sw-calibration-access=READ-ONLY, type-emitter=RTE
      element Element: array-size=3, array-size-semantics=FIXED-SIZE, implementation-data-type=u7p9
    Ary1D_u7p9_4: category=ARRAY, sw-calibration-access=READ-ONLY, type-emitter=RTE
      element Element: array-size=4, array-size-semantics=FIXED-SIZE, implementation-data-type=u7p9
    Ary1D_u7p9_6: category=ARRAY, sw-calibration-access=READ-ONLY, type-emitter=RTE
      element Element: array-size=6, array-size-semantics=FIXED-SIZE, implementation-data-type=u7p9
    Ary1D_u8_10: category=ARRAY, sw-calibration-access=READ-ONLY, type-emitter=RTE
      element Element: array-size=10, array-size-semantics=FIXED-SIZE, implementation-data-type=uint8
    Ary1D_u8_16: category=ARRAY, sw-calibration-access=READ-ONLY, type-emitter=RTE
      element Element: array-size=16, array-size-semantics=FIXED-SIZE, implementation-data-type=uint8
    Ary1D_u8_20: category=ARRAY, sw-calibration-access=READ-ONLY, type-emitter=RTE
      element Element: array-size=20, array-size-semantics=FIXED-SIZE, implementation-data-type=uint8
    Ary1D_u8_22: category=ARRAY, sw-calibration-access=READ-ONLY, type-emitter=RTE
      element Element: array-size=22, array-size-semantics=FIXED-SIZE, implementation-data-type=uint8
    Ary1D_u8_48: category=ARRAY, sw-calibration-access=READ-ONLY, type-emitter=RTE
      element Element: array-size=48, array-size-semantics=FIXED-SIZE, implementation-data-type=uint8
    Ary1D_u8_6: category=ARRAY, sw-calibration-access=READ-ONLY, type-emitter=RTE
      element Element: array-size=6, array-size-semantics=FIXED-SIZE, implementation-data-type=uint8
    Ary1D_u8_CmnMfgSrvIf: category=ARRAY, type-emitter=CmnMfgSrvIf
      element Element: array-size=65535, array-size-semantics=FIXED-SIZE, implementation-data-type=uint8
    Ary1D_u8p8_10: category=ARRAY, sw-calibration-access=READ-ONLY, type-emitter=RTE
      element Element: array-size=10, array-size-semantics=FIXED-SIZE, implementation-data-type=u8p8
    Ary1D_u8p8_11: category=ARRAY, sw-calibration-access=READ-ONLY, type-emitter=RTE
      element Element: array-size=11, array-size-semantics=FIXED-SIZE, implementation-data-type=u8p8
    Ary1D_u8p8_12: category=ARRAY, sw-calibration-access=READ-ONLY, type-emitter=RTE
      element Element: array-size=12, array-size-semantics=FIXED-SIZE, implementation-data-type=u8p8
    Ary1D_u8p8_13: category=ARRAY, sw-calibration-access=READ-ONLY, type-emitter=RTE
      element Element: array-size=13, array-size-semantics=FIXED-SIZE, implementation-data-type=u8p8
    Ary1D_u8p8_14: category=ARRAY, sw-calibration-access=READ-ONLY, type-emitter=RTE
      element Element: array-size=14, array-size-semantics=FIXED-SIZE, implementation-data-type=u8p8
    Ary1D_u8p8_2: category=ARRAY, sw-calibration-access=READ-ONLY, type-emitter=RTE
      element Element: array-size=2, array-size-semantics=FIXED-SIZE, implementation-data-type=u8p8
    Ary1D_u8p8_20: category=ARRAY, sw-calibration-access=READ-ONLY, type-emitter=RTE
      element Element: array-size=20, array-size-semantics=FIXED-SIZE, implementation-data-type=u8p8
    Ary1D_u8p8_3: category=ARRAY, sw-calibration-access=READ-ONLY, type-emitter=RTE
      element Element: array-size=3, array-size-semantics=FIXED-SIZE, implementation-data-type=u8p8
    Ary1D_u8p8_4: category=ARRAY, sw-calibration-access=READ-ONLY, type-emitter=RTE
      element Element: array-size=4, array-size-semantics=FIXED-SIZE, implementation-data-type=u8p8
    Ary1D_u8p8_5: category=ARRAY, sw-calibration-access=READ-ONLY, type-emitter=RTE
      element Element: array-size=5, array-size-semantics=FIXED-SIZE, implementation-data-type=u8p8
    Ary1D_u8p8_6: category=ARRAY, sw-calibration-access=READ-ONLY, type-emitter=RTE
      element Element: array-size=6, array-size-semantics=FIXED-SIZE, implementation-data-type=u8p8
    Ary1D_u8p8_7: category=ARRAY, sw-calibration-access=READ-ONLY, type-emitter=RTE
      element Element: array-size=7, array-size-semantics=FIXED-SIZE, implementation-data-type=u8p8
    Ary1D_u8p8_8: category=ARRAY, sw-calibration-access=READ-ONLY, type-emitter=RTE
      element Element: array-size=8, array-size-semantics=FIXED-SIZE, implementation-data-type=u8p8
    Ary1D_u8p8_9: category=ARRAY, sw-calibration-access=READ-ONLY, type-emitter=RTE
      element Element: array-size=9, array-size-semantics=FIXED-SIZE, implementation-data-type=u8p8
    Ary1D_u9p7_10: category=ARRAY, sw-calibration-access=READ-ONLY, type-emitter=RTE
      element Element: array-size=10, array-size-semantics=FIXED-SIZE, implementation-data-type=u9p7
    Ary1D_u9p7_11: category=ARRAY, sw-calibration-access=READ-ONLY, type-emitter=RTE
      element Element: array-size=11, array-size-semantics=FIXED-SIZE, implementation-data-type=u9p7
    Ary1D_u9p7_12: category=ARRAY, sw-calibration-access=READ-ONLY, type-emitter=RTE
      element Element: array-size=12, array-size-semantics=FIXED-SIZE, implementation-data-type=u9p7
    Ary1D_u9p7_16: category=ARRAY, sw-calibration-access=READ-ONLY, type-emitter=RTE
      element Element: array-size=16, array-size-semantics=FIXED-SIZE, implementation-data-type=u9p7
    Ary1D_u9p7_2: category=ARRAY, sw-calibration-access=READ-ONLY, type-emitter=RTE
      element Element: array-size=2, array-size-semantics=FIXED-SIZE, implementation-data-type=u9p7
    Ary1D_u9p7_3: category=ARRAY, sw-calibration-access=READ-ONLY, type-emitter=RTE
      element Element: array-size=3, array-size-semantics=FIXED-SIZE, implementation-data-type=u9p7
    Ary1D_u9p7_4: category=ARRAY, sw-calibration-access=READ-ONLY, type-emitter=RTE
      element Element: array-size=4, array-size-semantics=FIXED-SIZE, implementation-data-type=u9p7
    Ary1D_u9p7_5: category=ARRAY, sw-calibration-access=READ-ONLY, type-emitter=RTE
      element Element: array-size=5, array-size-semantics=FIXED-SIZE, implementation-data-type=u9p7
    Ary1D_u9p7_6: category=ARRAY, sw-calibration-access=READ-ONLY, type-emitter=RTE
      element Element: array-size=6, array-size-semantics=FIXED-SIZE, implementation-data-type=u9p7
    Ary1D_u9p7_7: category=ARRAY, sw-calibration-access=READ-ONLY, type-emitter=RTE
      element Element: array-size=7, array-size-semantics=FIXED-SIZE, implementation-data-type=u9p7
    Ary1D_u9p7_8: category=ARRAY, sw-calibration-access=READ-ONLY, type-emitter=RTE
      element Element: array-size=8, array-size-semantics=FIXED-SIZE, implementation-data-type=u9p7
    Ary1D_u9p7_9: category=ARRAY, sw-calibration-access=READ-ONLY, type-emitter=RTE
      element Element: array-size=9, array-size-semantics=FIXED-SIZE, implementation-data-type=u9p7
    Ary2D_f32_2_4: category=ARRAY, sw-calibration-access=READ-ONLY, type-emitter=RTE
      element Element: array-size=2, array-size-semantics=FIXED-SIZE, implementation-data-type=Ary1D_f32_4
    Ary2D_f32_3_3: category=ARRAY, sw-calibration-access=READ-ONLY, type-emitter=RTE
      element Element: array-size=3, array-size-semantics=FIXED-SIZE, implementation-data-type=Ary1D_f32_3
    Ary2D_f32_4_2: category=ARRAY, sw-calibration-access=READ-ONLY, type-emitter=RTE
      element Element: array-size=4, array-size-semantics=FIXED-SIZE, implementation-data-type=Ary1D_f32_2
    Ary2D_f32_4_5: category=ARRAY, sw-calibration-access=READ-ONLY, type-emitter=RTE
      element Element: array-size=4, array-size-semantics=FIXED-SIZE, implementation-data-type=Ary1D_f32_5
    Ary2D_f32_4_8: category=ARRAY, sw-calibration-access=READ-ONLY, type-emitter=RTE
      element Element: array-size=4, array-size-semantics=FIXED-SIZE, implementation-data-type=Ary1D_f32_8
    Ary2D_f32_5_3: category=ARRAY, sw-calibration-access=READ-ONLY, type-emitter=RTE
      element Element: array-size=5, array-size-semantics=FIXED-SIZE, implementation-data-type=Ary1D_f32_3
    Ary2D_f32_5_4: category=ARRAY, sw-calibration-access=READ-ONLY, type-emitter=RTE
      element Element: array-size=5, array-size-semantics=FIXED-SIZE, implementation-data-type=Ary1D_f32_4
    Ary2D_f32_5_5: category=ARRAY, sw-calibration-access=READ-ONLY, type-emitter=RTE
      element Element: array-size=5, array-size-semantics=FIXED-SIZE, implementation-data-type=Ary1D_f32_5
    Ary2D_f32_8_4: category=ARRAY, sw-calibration-access=READ-ONLY, type-emitter=RTE
      element Element: array-size=8, array-size-semantics=FIXED-SIZE, implementation-data-type=Ary1D_f32_4
    Ary2D_s1p14_10_12: category=ARRAY, sw-calibration-access=READ-ONLY, type-emitter=RTE
      element Element: array-size=10, array-size-semantics=FIXED-SIZE, implementation-data-type=Ary1D_s1p14_12
    Ary2D_s4p11_10_13: category=ARRAY, sw-calibration-access=READ-ONLY, type-emitter=RTE
      element Element: array-size=10, array-size-semantics=FIXED-SIZE, implementation-data-type=Ary1D_s4p11_13
    Ary2D_s4p11_11_8: category=ARRAY, sw-calibration-access=READ-ONLY, type-emitter=RTE
      element Element: array-size=11, array-size-semantics=FIXED-SIZE, implementation-data-type=Ary1D_s4p11_8
    Ary2D_s4p11_12_11: category=ARRAY, sw-calibration-access=READ-ONLY, type-emitter=RTE
      element Element: array-size=12, array-size-semantics=FIXED-SIZE, implementation-data-type=Ary1D_s4p11_11
    Ary2D_s4p11_12_20: category=ARRAY, sw-calibration-access=READ-ONLY, type-emitter=RTE
      element Element: array-size=12, array-size-semantics=FIXED-SIZE, implementation-data-type=Ary1D_s4p11_20
    Ary2D_s4p11_8_11: category=ARRAY, sw-calibration-access=READ-ONLY, type-emitter=RTE
      element Element: array-size=8, array-size-semantics=FIXED-SIZE, implementation-data-type=Ary1D_s4p11_11
    Ary2D_s7p8_11_12: category=ARRAY, sw-calibration-access=READ-ONLY, type-emitter=RTE
      element Element: array-size=11, array-size-semantics=FIXED-SIZE, implementation-data-type=Ary1D_s7p8_12
    Ary2D_s7p8_12_11: category=ARRAY, sw-calibration-access=READ-ONLY, type-emitter=RTE
      element Element: array-size=12, array-size-semantics=FIXED-SIZE, implementation-data-type=Ary1D_s7p8_11
    Ary2D_s7p8_3_5: category=ARRAY, sw-calibration-access=READ-ONLY, type-emitter=RTE
      element Element: array-size=3, array-size-semantics=FIXED-SIZE, implementation-data-type=Ary1D_s7p8_5
    Ary2D_s7p8_3_6: category=ARRAY, sw-calibration-access=READ-ONLY, type-emitter=RTE
      element Element: array-size=3, array-size-semantics=FIXED-SIZE, implementation-data-type=Ary1D_s7p8_6
    Ary2D_s7p8_4_5: category=ARRAY, sw-calibration-access=READ-ONLY, type-emitter=RTE
      element Element: array-size=4, array-size-semantics=FIXED-SIZE, implementation-data-type=Ary1D_s7p8_5
    Ary2D_s7p8_9_5: category=ARRAY, sw-calibration-access=READ-ONLY, type-emitter=RTE
      element Element: array-size=9, array-size-semantics=FIXED-SIZE, implementation-data-type=Ary1D_s7p8_5
    Ary2D_s7p8_9_6: category=ARRAY, sw-calibration-access=READ-ONLY, type-emitter=RTE
      element Element: array-size=9, array-size-semantics=FIXED-SIZE, implementation-data-type=Ary1D_s7p8_6
    Ary2D_u08_2_2: category=ARRAY, sw-calibration-access=READ-ONLY, type-emitter=RTE
      element Element: array-size=2, array-size-semantics=FIXED-SIZE, implementation-data-type=Ary1D_u08_2
    Ary2D_u0p16_20_8: category=ARRAY, sw-calibration-access=READ-ONLY, type-emitter=RTE
      element Element: array-size=20, array-size-semantics=FIXED-SIZE, implementation-data-type=Ary1D_u0p16_8
    Ary2D_u0p16_4_2: category=ARRAY, sw-calibration-access=READ-ONLY, type-emitter=RTE
      element Element: array-size=4, array-size-semantics=FIXED-SIZE, implementation-data-type=Ary1D_u0p16_2
    Ary2D_u10p6_3_7: category=ARRAY, sw-calibration-access=READ-ONLY, type-emitter=RTE
      element Element: array-size=3, array-size-semantics=FIXED-SIZE, implementation-data-type=Ary1D_u10p6_7
    Ary2D_u10p6_8_12: category=ARRAY, sw-calibration-access=READ-ONLY, type-emitter=RTE
      element Element: array-size=8, array-size-semantics=FIXED-SIZE, implementation-data-type=Ary1D_u10p6_12
    Ary2D_u10p6_8_9: category=ARRAY, sw-calibration-access=READ-ONLY, type-emitter=RTE
      element Element: array-size=8, array-size-semantics=FIXED-SIZE, implementation-data-type=Ary1D_u10p6_9
    Ary2D_u11p5_6_5: category=ARRAY, sw-calibration-access=READ-ONLY, type-emitter=RTE
      element Element: array-size=6, array-size-semantics=FIXED-SIZE, implementation-data-type=Ary1D_u11p5_5
    Ary2D_u12p4_12_13: category=ARRAY, sw-calibration-access=READ-ONLY, type-emitter=RTE
      element Element: array-size=12, array-size-semantics=FIXED-SIZE, implementation-data-type=Ary1D_u12p4_13
    Ary2D_u12p4_4_2: category=ARRAY, sw-calibration-access=READ-ONLY, type-emitter=RTE
      element Element: array-size=4, array-size-semantics=FIXED-SIZE, implementation-data-type=Ary1D_u12p4_2
    Ary2D_u12p4_5_4: category=ARRAY, sw-calibration-access=READ-ONLY, type-emitter=RTE
      element Element: array-size=5, array-size-semantics=FIXED-SIZE, implementation-data-type=Ary1D_u12p4_4
    Ary2D_u12p4_8_12: category=ARRAY, sw-calibration-access=READ-ONLY, type-emitter=RTE
      element Element: array-size=8, array-size-semantics=FIXED-SIZE, implementation-data-type=Ary1D_u12p4_12
    Ary2D_u12p4_9_16: category=ARRAY, sw-calibration-access=READ-ONLY, type-emitter=RTE
      element Element: array-size=9, array-size-semantics=FIXED-SIZE, implementation-data-type=Ary1D_u12p4_16
    Ary2D_u15p1_10_24: category=ARRAY, sw-calibration-access=READ-ONLY, type-emitter=RTE
      element Element: array-size=10, array-size-semantics=FIXED-SIZE, implementation-data-type=Ary1D_u15p1_24
    Ary2D_u15p1_12_9: category=ARRAY, sw-calibration-access=READ-ONLY, type-emitter=RTE
      element Element: array-size=12, array-size-semantics=FIXED-SIZE, implementation-data-type=Ary1D_u15p1_9
    Ary2D_u16_3_8: category=ARRAY, sw-calibration-access=READ-ONLY, type-emitter=RTE
      element Element: array-size=3, array-size-semantics=FIXED-SIZE, implementation-data-type=Ary1D_u16p0_8
    Ary2D_u16_8_3: category=ARRAY, sw-calibration-access=READ-ONLY, type-emitter=RTE
      element Element: array-size=8, array-size-semantics=FIXED-SIZE, implementation-data-type=Ary1D_u16_3
    Ary2D_u16p0_2_8: category=ARRAY, sw-calibration-access=READ-ONLY, type-emitter=RTE
      element Element: array-size=2, array-size-semantics=FIXED-SIZE, implementation-data-type=Ary1D_u16p0_8
    Ary2D_u1p15_12_12: category=ARRAY, sw-calibration-access=READ-ONLY, type-emitter=RTE
      element Element: array-size=12, array-size-semantics=FIXED-SIZE, implementation-data-type=Ary1D_u1p15_12
    Ary2D_u1p15_12_5: category=ARRAY, sw-calibration-access=READ-ONLY, type-emitter=RTE
      element Element: array-size=12, array-size-semantics=FIXED-SIZE, implementation-data-type=Ary1D_u1p15_5
    Ary2D_u1p15_12_9: category=ARRAY, sw-calibration-access=READ-ONLY, type-emitter=RTE
      element Element: array-size=12, array-size-semantics=FIXED-SIZE, implementation-data-type=Ary1D_u1p15_9
    Ary2D_u1p15_5_4: category=ARRAY, sw-calibration-access=READ-ONLY, type-emitter=RTE
      element Element: array-size=5, array-size-semantics=FIXED-SIZE, implementation-data-type=Ary1D_u1p15_4
    Ary2D_u1p15_8_4: category=ARRAY, sw-calibration-access=READ-ONLY, type-emitter=RTE
      element Element: array-size=8, array-size-semantics=FIXED-SIZE, implementation-data-type=Ary1D_u1p15_4
    Ary2D_u2p14_12_12: category=ARRAY, sw-calibration-access=READ-ONLY, type-emitter=RTE
      element Element: array-size=12, array-size-semantics=FIXED-SIZE, implementation-data-type=Ary1D_u2p14_12
    Ary2D_u2p14_12_4: category=ARRAY, sw-calibration-access=READ-ONLY, type-emitter=RTE
      element Element: array-size=12, array-size-semantics=FIXED-SIZE, implementation-data-type=Ary1D_u2p14_4
    Ary2D_u2p14_12_5: category=ARRAY, sw-calibration-access=READ-ONLY, type-emitter=RTE
      element Element: array-size=12, array-size-semantics=FIXED-SIZE, implementation-data-type=Ary1D_u2p14_5
    Ary2D_u2p14_5_10: category=ARRAY, sw-calibration-access=READ-ONLY, type-emitter=RTE
      element Element: array-size=5, array-size-semantics=FIXED-SIZE, implementation-data-type=Ary1D_u2p14_10
    Ary2D_u2p14_5_8: category=ARRAY, sw-calibration-access=READ-ONLY, type-emitter=RTE
      element Element: array-size=5, array-size-semantics=FIXED-SIZE, implementation-data-type=Ary1D_u2p14_8
    Ary2D_u2p14_6_5: category=ARRAY, sw-calibration-access=READ-ONLY, type-emitter=RTE
      element Element: array-size=6, array-size-semantics=FIXED-SIZE, implementation-data-type=Ary1D_u2p14_5
    Ary2D_u2p14_6_7: category=ARRAY, sw-calibration-access=READ-ONLY, type-emitter=RTE
      element Element: array-size=6, array-size-semantics=FIXED-SIZE, implementation-data-type=Ary1D_u2p14_7
    Ary2D_u2p14_7_6: category=ARRAY, sw-calibration-access=READ-ONLY, type-emitter=RTE
      element Element: array-size=7, array-size-semantics=FIXED-SIZE, implementation-data-type=Ary1D_u2p14_6
    Ary2D_u2p14_7_8: category=ARRAY, sw-calibration-access=READ-ONLY, type-emitter=RTE
      element Element: array-size=7, array-size-semantics=FIXED-SIZE, implementation-data-type=Ary1D_u2p14_8
    Ary2D_u3p13_12_13: category=ARRAY, sw-calibration-access=READ-ONLY, type-emitter=RTE
      element Element: array-size=12, array-size-semantics=FIXED-SIZE, implementation-data-type=Ary1D_u3p13_13
    Ary2D_u3p13_20_8: category=ARRAY, sw-calibration-access=READ-ONLY, type-emitter=RTE
      element Element: array-size=20, array-size-semantics=FIXED-SIZE, implementation-data-type=Ary1D_u3p13_8
    Ary2D_u4p12_10_24: category=ARRAY, sw-calibration-access=READ-ONLY, type-emitter=RTE
      element Element: array-size=10, array-size-semantics=FIXED-SIZE, implementation-data-type=Ary1D_u4p12_24
    Ary2D_u4p12_12_12: category=ARRAY, sw-calibration-access=READ-ONLY, type-emitter=RTE
      element Element: array-size=12, array-size-semantics=FIXED-SIZE, implementation-data-type=Ary1D_u4p12_12
    Ary2D_u4p12_12_20: category=ARRAY, sw-calibration-access=READ-ONLY, type-emitter=RTE
      element Element: array-size=12, array-size-semantics=FIXED-SIZE, implementation-data-type=Ary1D_u4p12_20
    Ary2D_u4p12_12_5: category=ARRAY, sw-calibration-access=READ-ONLY, type-emitter=RTE
      element Element: array-size=12, array-size-semantics=FIXED-SIZE, implementation-data-type=Ary1D_u4p12_5
    Ary2D_u4p12_12_8: category=ARRAY, sw-calibration-access=READ-ONLY, type-emitter=RTE
      element Element: array-size=12, array-size-semantics=FIXED-SIZE, implementation-data-type=Ary1D_u4p12_8
    Ary2D_u4p12_12_9: category=ARRAY, sw-calibration-access=READ-ONLY, type-emitter=RTE
      element Element: array-size=12, array-size-semantics=FIXED-SIZE, implementation-data-type=Ary1D_u4p12_9
    Ary2D_u4p12_13_13: category=ARRAY, sw-calibration-access=READ-ONLY, type-emitter=RTE
      element Element: array-size=13, array-size-semantics=FIXED-SIZE, implementation-data-type=Ary1D_u4p12_13
    Ary2D_u4p12_13_3: category=ARRAY, sw-calibration-access=READ-ONLY, type-emitter=RTE
      element Element: array-size=13, array-size-semantics=FIXED-SIZE, implementation-data-type=Ary1D_u4p12_3
    Ary2D_u4p12_3_13: category=ARRAY, sw-calibration-access=READ-ONLY, type-emitter=RTE
      element Element: array-size=3, array-size-semantics=FIXED-SIZE, implementation-data-type=Ary1D_u4p12_13
    Ary2D_u4p12_6_7: category=ARRAY, sw-calibration-access=READ-ONLY, type-emitter=RTE
      element Element: array-size=6, array-size-semantics=FIXED-SIZE, implementation-data-type=Ary1D_u4p12_7
    Ary2D_u5p11_12_13: category=ARRAY, sw-calibration-access=READ-ONLY, type-emitter=RTE
      element Element: array-size=12, array-size-semantics=FIXED-SIZE, implementation-data-type=Ary1D_u5p11_13
    Ary2D_u5p11_12_5: category=ARRAY, sw-calibration-access=READ-ONLY, type-emitter=RTE
      element Element: array-size=12, array-size-semantics=FIXED-SIZE, implementation-data-type=Ary1D_u5p11_5
    Ary2D_u5p11_9_16: category=ARRAY, sw-calibration-access=READ-ONLY, type-emitter=RTE
      element Element: array-size=9, array-size-semantics=FIXED-SIZE, implementation-data-type=Ary1D_u5p11_16
    Ary2D_u5p11_9_9: category=ARRAY, sw-calibration-access=READ-ONLY, type-emitter=RTE
      element Element: array-size=9, array-size-semantics=FIXED-SIZE, implementation-data-type=Ary1D_u5p11_9
    Ary2D_u6p10_12_12: category=ARRAY, sw-calibration-access=READ-ONLY, type-emitter=RTE
      element Element: array-size=12, array-size-semantics=FIXED-SIZE, implementation-data-type=Ary1D_u6p10_12
    Ary2D_u6p10_12_20: category=ARRAY, sw-calibration-access=READ-ONLY, type-emitter=RTE
      element Element: array-size=12, array-size-semantics=FIXED-SIZE, implementation-data-type=Ary1D_u6p10_20
    Ary2D_u6p10_12_9: category=ARRAY, sw-calibration-access=READ-ONLY, type-emitter=RTE
      element Element: array-size=12, array-size-semantics=FIXED-SIZE, implementation-data-type=Ary1D_u6p10_9
    Ary2D_u6p10_13_13: category=ARRAY, sw-calibration-access=READ-ONLY, type-emitter=RTE
      element Element: array-size=13, array-size-semantics=FIXED-SIZE, implementation-data-type=Ary1D_u6p10_13
    Ary2D_u6p10_5_9: category=ARRAY, sw-calibration-access=READ-ONLY, type-emitter=RTE
      element Element: array-size=5, array-size-semantics=FIXED-SIZE, implementation-data-type=Ary1D_u6p10_9
    Ary2D_u6p10_8_9: category=ARRAY, sw-calibration-access=READ-ONLY, type-emitter=RTE
      element Element: array-size=8, array-size-semantics=FIXED-SIZE, implementation-data-type=Ary1D_u6p10_9
    Ary2D_u7p9_8_4: category=ARRAY, sw-calibration-access=READ-ONLY, type-emitter=RTE
      element Element: array-size=8, array-size-semantics=FIXED-SIZE, implementation-data-type=Ary1D_u7p9_4
    Ary2D_u7p9_9_4: category=ARRAY, sw-calibration-access=READ-ONLY, type-emitter=RTE
      element Element: array-size=9, array-size-semantics=FIXED-SIZE, implementation-data-type=Ary1D_u7p9_4
    Ary2D_u8p8_12_20: category=ARRAY, sw-calibration-access=READ-ONLY, type-emitter=RTE
      element Element: array-size=12, array-size-semantics=FIXED-SIZE, implementation-data-type=Ary1D_u8p8_20
    Ary2D_u8p8_3_5: category=ARRAY, sw-calibration-access=READ-ONLY, type-emitter=RTE
      element Element: array-size=3, array-size-semantics=FIXED-SIZE, implementation-data-type=Ary1D_u8p8_5
    Ary2D_u8p8_3_6: category=ARRAY, sw-calibration-access=READ-ONLY, type-emitter=RTE
      element Element: array-size=3, array-size-semantics=FIXED-SIZE, implementation-data-type=Ary1D_u8p8_6
    Ary2D_u8p8_5_10: category=ARRAY, sw-calibration-access=READ-ONLY, type-emitter=RTE
      element Element: array-size=5, array-size-semantics=FIXED-SIZE, implementation-data-type=Ary1D_u8p8_10
    Ary2D_u8p8_5_8: category=ARRAY, sw-calibration-access=READ-ONLY, type-emitter=RTE
      element Element: array-size=5, array-size-semantics=FIXED-SIZE, implementation-data-type=Ary1D_u8p8_8
    Ary2D_u8p8_6_5: category=ARRAY, sw-calibration-access=READ-ONLY, type-emitter=RTE
      element Element: array-size=6, array-size-semantics=FIXED-SIZE, implementation-data-type=Ary1D_u8p8_5
    Ary2D_u8p8_9_4: category=ARRAY, sw-calibration-access=READ-ONLY, type-emitter=RTE
      element Element: array-size=9, array-size-semantics=FIXED-SIZE, implementation-data-type=Ary1D_u8p8_4
    Ary2D_u8p8_9_5: category=ARRAY, sw-calibration-access=READ-ONLY, type-emitter=RTE
      element Element: array-size=9, array-size-semantics=FIXED-SIZE, implementation-data-type=Ary1D_u8p8_5
    Ary2D_u8p8_9_6: category=ARRAY, sw-calibration-access=READ-ONLY, type-emitter=RTE
      element Element: array-size=9, array-size-semantics=FIXED-SIZE, implementation-data-type=Ary1D_u8p8_6
    Ary2D_u8p8_9_8: category=ARRAY, sw-calibration-access=READ-ONLY, type-emitter=RTE
      element Element: array-size=9, array-size-semantics=FIXED-SIZE, implementation-data-type=Ary1D_u8p8_8
    Ary2D_u9p7_2_5: category=ARRAY, sw-calibration-access=READ-ONLY, type-emitter=RTE
      element Element: array-size=2, array-size-semantics=FIXED-SIZE, implementation-data-type=Ary1D_u9p7_5
    Ary2D_u9p7_2_8: category=ARRAY, sw-calibration-access=READ-ONLY, type-emitter=RTE
      element Element: array-size=2, array-size-semantics=FIXED-SIZE, implementation-data-type=Ary1D_u9p7_8
    BattRtnCurrAmprQlfr1: compu {6=BATTRTNCURRAMPRQLFR_FCTRPRTERR, 9=BATTRTNCURRAMPRQLFR_FCTACTVSECUR, 11=BATTRTNCURRAMPRQLFR_FCTNOTACTV, 14=BATTRTNCURRAMPRQLFR_FCTIFNOTAVL, 15=BATTRTNCURRAMPRQLFR_INVLD}, implementation-data-type=uint8, type-emitter=RTE
    BattSwdVltgCorrlnSts1: compu {0=BSVCS_NOFLT, 1=BSVCS_BATTVLTGSWD2FLT, 2=BSVCS_BATTVLTGSWD1FLT, 3=BSVCS_BATTVLTGFLT, 4=BSVCS_NOCORRLN}, implementation-data-type=uint8, type-emitter=RTE
    BattVltgSt1: compu {0=BATTVLTGST_NORMOPER, 1=BATTVLTGST_HIVLTGWARN, 2=BATTVLTGST_HIVLTGCRIT, 3=BATTVLTGST_HIVLTGOFF, 4=BATTVLTGST_LOVLTGWARN, 5=BATTVLTGST_LOVLTGCRIT, 6=BATTVLTGST_LOVLTGOFF}, implementation-data-type=uint8, type-emitter=RTE
    BlkFltTblRec1: category=STRUCTURE, sw-calibration-access=READ-ONLY, dynamic-array-size-profile=None, type-emitter=RTE
      element Sts: implementation-data-type=NtcSts1
      element Prm: implementation-data-type=uint8
    BmwBasPtlNetCtrl1: compu {0=NoCommunication, 1=ParkingNotOk, 2=ParkingOk, 3=StandingFunctions, 5=Living, 7=CheckDiagnosticAnalysis, 8=DriverPreparingforOperation, 10=Driving, 12=DriverPreparingToExitOperation, 15=Invalid}, implementation-data-type=uint8, type-emitter=RTE
    BmwCogVehSpdQlfr1: compu {1=BMWCOGVEHSPDQLFR_SIGVALVLDANDPLAUS, 8=BMWCOGVEHSPDQLFR_INIT, 10=BMWCOGVEHSPDQLFR_SIGVALTMPVLD, 11=BMWCOGVEHSPDQLFR_SIGQLYMONTMPRSTRCTD, 14=BMWCOGVEHSPDQLFR_SIGVALTMPINVLD, 15=BMWCOGVEHSPDQLFR_INVLD}, implementation-data-type=uint8, type-emitter=RTE
    BmwDesIninIdxRec1: category=STRUCTURE, sw-calibration-access=READ-ONLY, dynamic-array-size-profile=None, type-emitter=RTE
      element BmwDesIninIdx: implementation-data-type=uint8
      element BmwDesIninIdxWrSts: implementation-data-type=boolean
    BmwDesIninOptSetAIdxRec1: category=STRUCTURE, sw-calibration-access=READ-ONLY, dynamic-array-size-profile=None, type-emitter=RTE
      element BmwDesIninOptSetAIdx: implementation-data-type=uint8
      element BmwDesIninOptSetAIdxWrSts: implementation-data-type=boolean
    BmwDiagcSessionId1: compu {1=BMWDIAGCSESSIONID_DFT, 2=BMWDIAGCSESSIONID_CTRLRPROGM, 3=BMWDIAGCSESSIONID_EXTDDIAGC, 65=BMWDIAGCSESSIONID_VRNTPROGM, 68=BMWDIAGCSESSIONID_REMSWUPD, 79=BMWDIAGCSESSIONID_DEVP, 95=BMWDIAGCSESSIONID_SRVCENTRMOD, 126=BMWDIAGCSESSIONID_NXTRMFG}, implementation-data-type=uint8, type-emitter=RTE
    BmwElecEngDrvSts1: compu {0=BMWELECENGDRVSTS_NOELECENGACTV, 1=BMWELECENGDRVSTS_ELECENGACTV, 3=BMWELECENGDRVSTS_INVLD}, implementation-data-type=uint8, type-emitter=RTE
    BmwEngDrvSts1: compu {0=BMWENGDRVSTS_ENGSTAND, 1=BMWENGDRVSTS_ENGSTART, 2=BMWENGDRVSTS_ENGRUNNG, 3=BMWENGDRVSTS_ENGOUTL, 13=BMWENGDRVSTS_FCTIFUNAVL, 15=BMWENGDRVSTS_INVLD}, implementation-data-type=uint8, type-emitter=RTE
    BmwEngStopCallSts1: compu {0=BMWENGSTOPCALLSTS_NOENGSTOPCALL, 1=BMWENGSTOPCALLSTS_ENGSTOPCALL, 3=BMWENGSTOPCALLSTS_INVLD}, implementation-data-type=uint8, type-emitter=RTE
    BmwEpsFctSts1:
      compu {49=BMWEPSFCTSTS_FCTINFALLBACK, 51=BMWEPSFCTSTS_FCTINFALLBACKEMGYFCNENVTLINFLSACTV, 96=BMWEPSFCTSTS_NOTAVIERR, 128=BMWEPSFCTSTS_ININ, 160=BMWEPSFCTSTS_FCTAVIACTV12VEPS, 162=BMWEPSFCTSTS_FCTAVIACTVEMGYFCNENVTLINFLSACTV, 164=BMWEPSFCTSTS_FCTAVIACTV12VEAS, 168=BMWEPSFCTSTS_FCTAVIACTV24VEAS, 176=BMWEPSFCTSTS_FCTTMPINFALLBACK, 178=BMWEPSFCTSTS_FCTTMPINFALLBACKEMGYFCNENVTLINFLSACT, 224=BMWEPSFCTSTS_NOTAVISWDOFF, 255=BMWEPSFCTSTS_INVLD}
      implementation-data-type=uint8
      type-emitter=RTE
    BmwFltLampFlsgFrq1: compu {0=BMWFLTLAMPFLSGFRQ_NOFLSG, 1=BMWFLTLAMPFLSGFRQ_SLOWFLSG, 2=BMWFLTLAMPFLSGFRQ_FASTFLSG, 3=BMWFLTLAMPFLSGFRQ_INVLD}, implementation-data-type=uint8, type-emitter=RTE
    BmwFltLampReqSts1: compu {0=BMWFLTLAMPREQSTS_FLTLAMPRSTREQD, 1=BMWFLTLAMPREQSTS_FLTLAMPSETREQD, 3=BMWFLTLAMPREQSTS_INVLD}, implementation-data-type=uint8, type-emitter=RTE
    BmwFltLampReqTyp1: compu {627=BMWFLTLAMPREQTYP_GENFLTLAMPREQD, 997=BMWFLTLAMPREQTYP_THERMLIMFLTLAMPREQD, 65534=BMWFLTLAMPREQTYP_NOFLTLAMPREQD, 65535=BMWFLTLAMPREQTYP_INVLD}, implementation-data-type=uint16, type-emitter=RTE
    BmwFltLampReqTyp2: compu {0=BMWFLTLAMPREQTYP_NOLAMP, 1=BMWFLTLAMPREQTYP_EPTI_INSPNRLVLAMP, 2=BMWFLTLAMPREQTYP_NORMWARNLAMP, 3=BMWFLTLAMPREQTYP_THERMWARNLAMP}, implementation-data-type=uint16, type-emitter=RTE
    BmwHaptcFbDirNr1: compu {0=BMWHAPTCFBDIRNR_NODIR, 1=BMWHAPTCFBDIRNR_DIRLE, 2=BMWHAPTCFBDIRNR_DIRRI, 3=BMWHAPTCFBDIRNR_INVLDSIG}, implementation-data-type=uint8, type-emitter=RTE
    BmwHaptcFbIntenNr1: compu {0..12=BMWHAPTCFBINTENNR_INTEN0..BMWHAPTCFBINTENNR_INTEN12, 13=BMWHAPTCFBINTENNR_RESD1, 14=BMWHAPTCFBINTENNR_RESD2, 15=BMWHAPTCFBINTENNR_INVLDSIG}, implementation-data-type=uint8, type-emitter=RTE
    BmwHaptcFbPatNr1: compu {0=BMWHAPTCFBPATNR_NOHAPTCWARN, 1..10=BMWHAPTCFBPATNR_PAT1..BMWHAPTCFBPATNR_PAT10, 13=BMWHAPTCFBPATNR_FCTIFNOTAVL, 14=BMWHAPTCFBPATNR_FCTRPRTERR, 15=BMWHAPTCFBPATNR_INVLDSIG}, implementation-data-type=uint8, type-emitter=RTE
    BmwMaxCurrLimrSts1: compu {1=BMWMAXCURRLIMRSTS_VLD, 2=BMWMAXCURRLIMRSTS_FCTIFNOTAVL, 3=BMWMAXCURRLIMRSTS_FCTRPRTERR, 4=BMWMAXCURRLIMRSTS_INVLD}, implementation-data-type=uint8, type-emitter=RTE
    BmwMotAgSelnSt1: compu {2=BMWMOTAGSELNST_OFFSCMPD, 4=BMWMOTAGSELNST_SUBVAL, 8=BMWMOTAGSELNST_INI, 10=BMWMOTAGSELNST_TMPCMPD, 12=BMWMOTAGSELNST_OFFSCORRN, 14=BMWMOTAGSELNST_SIGINVLD, 15=BMWMOTAGSELNST_INVLD}, implementation-data-type=uint8, type-emitter=RTE
    BmwNearStillVehSpdSts1: compu {12=BMWNEARSTILLVEHSPDSTS_VEHREST, 13=BMWNEARSTILLVEHSPDSTS_VEHNOTREST, 15=BMWNEARSTILLVEHSPDSTS_INVLD}, implementation-data-type=uint8, type-emitter=RTE
    BmwOvrlCmdQlfr1: compu {2=BMWOVRLCMDQLFR_IMPLSP, 7=BMWOVRLCMDQLFR_SPNOTAVL, 14=BMWOVRLCMDQLFR_STBDONOTCNVSP, 15=BMWOVRLCMDQLFR_INVLDSIG}, implementation-data-type=uint8, type-emitter=RTE
    BmwPinionAgOffsSts1: compu {1=BMWPINIONAGOFFSSTS_VLD, 2=BMWPINIONAGOFFSSTS_FCTIFNOTAVL, 3=BMWPINIONAGOFFSSTS_FCTRPRTERR, 4=BMWPINIONAGOFFSSTS_INVLD}, implementation-data-type=uint8, type-emitter=RTE
    BmwPinionAgQlfr1: compu {1=BMWPINIONAGQLFR_SIGVALVLDANDPLAUS, 2=BMWPINIONAGQLFR_SIGVALVLD, 4=BMWPINIONAGQLFR_SUBVALSETINUSRSIG, 8=BMWPINIONAGQLFR_INIT, 9=BMWPINIONAGQLFR_SIGVALVLDANDTMPOFAVRGQLY, 10=BMWPINIONAGQLFR_SIGVALVLDANDTMPOFLOQLY, 12=BMWPINIONAGQLFR_ADJMTVALSETINUSRSIG, 14=BMWPINIONAGQLFR_SIGVALINVLDBUTSTTMP, 15=BMWPINIONAGQLFR_INVLDSIG}, implementation-data-type=uint8, type-emitter=RTE
    BmwPwrSplySts1: compu {0=BMWPWRSPLYSTS_NOVLTGDRP, 1=BMWPWRSPLYSTS_VLTGDRPSPLYPAH1, 2=BMWPWRSPLYSTS_VLTGDRPSPLYPAH2, 3=BMWPWRSPLYSTS_PWRSPLY48VOLT, 255=BMWPWRSPLYSTS_INVLD}, implementation-data-type=uint8, type-emitter=RTE
    BmwQuadOffsSts1:
      compu {0=BMWQUADOFFSSTS_ALGSLEEP, 1=BMWQUADOFFSSTS_OFFSKWN, 2=BMWQUADOFFSSTS_OFFSBYIDX, 3=BMWQUADOFFSSTS_OFFSBYMDLCOMP, 4=BMWQUADOFFSSTS_OFFSPOSNGBYSTRTSTOP, 5=BMWQUADOFFSSTS_OFFSPOSNGBYSUMCTRLAG, 6=BMWQUADOFFSSTS_OFFSINTEST, 7=BMWQUADOFFSSTS_CORROFFS, 8=BMWQUADOFFSSTS_ININ, 9=BMWQUADOFFSSTS_RSTOFFSKWN, 11=BMWQUADOFFSSTS_OFFSBYMDL, 15=BMWQUADOFFSSTS_INVLD}
      implementation-data-type=uint8
      type-emitter=RTE
    BmwRackToVehCentrOffsSts1: compu {0=BMWRACKTOVEHCENTROFFSSTS_RACKTOVEHCENTRINVLD, 1=BMWRACKTOVEHCENTROFFSSTS_RACKTOVEHCENTRLRND, 2=BMWRACKTOVEHCENTROFFSSTS_RACKTOVEHCENTRUNLRND}, implementation-data-type=uint8, type-emitter=RTE
    BmwRtIdx1: compu {1=BMWRTIDX_ULTRAHARD, 2=BMWRTIDX_SPTBAL, 3=BMWRTIDX_BAL, 4=BMWRTIDX_SOFT, 13=BMWRTIDX_FCTLIFNOTAVL, 14=BMWRTIDX_FCTRPTERR, 15=BMWRTIDX_INVLD}, implementation-data-type=uint8, type-emitter=RTE
    BmwSecurVehSpdSts1: compu {1=BMWSECURVEHSPDSTS_SIGVALVLD, 4=BMWSECURVEHSPDSTS_VEHSTANDG, 12=BMWSECURVEHSPDSTS_VEHRUNNG, 14=BMWSECURVEHSPDSTS_NOINFO, 15=BMWSECURVEHSPDSTS_INVLD}, implementation-data-type=uint8, type-emitter=RTE
    BmwSeldPosnUnit1: compu {0=BMWSELDPOSNUNIT_PINIONIF, 1=BMWSELDPOSNUNIT_TOOTHEDRACKSTROKEIF, 3=BMWSELDPOSNUNIT_INVLDSIG}, implementation-data-type=uint8, type-emitter=RTE
    BmwSetVehCentrOffsSts1: compu {0=BMWVEHCENTROFFSSTS_OFFSPRFMD, 1=BMWVEHCENTROFFSSTS_OFFSFAILD, 2=BMWVEHCENTROFFSSTS_OFFSFAILDVALOUTOFRNG}, implementation-data-type=uint8, type-emitter=RTE
    BmwStrtStopMsgCmd1: compu {0=BMWSTRTSTOPMSGCMD_STOPCALL, 1=BMWSTRTSTOPMSGCMD_STOPCMD, 2=BMWSTRTSTOPMSGCMD_STRTCALL, 3=BMWSTRTSTOPMSGCMD_STRTCMD}, implementation-data-type=uint8, type-emitter=RTE
    BmwTqSnsrIdx1: compu {0=BMWTQSNSRIDX_INIT, 1=BMWTQSNSRIDX_NOIDXEDGE, 2=BMWTQSNSRIDX_IDXEDGE, 3=BMWTQSNSRIDX_INVLDSIG}, implementation-data-type=uint8, type-emitter=RTE
    BmwTrfcJamAssiDampgStReq1: compu {1=BMWTRFCJAMASSIDAMPGSTREQ_DONOTCNVSPADDLDAMPG, 2=BMWTRFCJAMASSIDAMPGSTREQ_CNVSPADDLDAMPG, 15=BMWTRFCJAMASSIDAMPGSTREQ_INVLDSIG}, implementation-data-type=uint8, type-emitter=RTE
    BmwTrfcJamAssiSt1: compu {1=BMWTRFCJAMASSIST_INACTV, 2=BMWTRFCJAMASSIST_ACTV, 15=BMWTRFCJAMASSIST_INVLD}, implementation-data-type=uint8, type-emitter=RTE
    BmwVehCdn1: compu {1=BMWVEHCDN_PRKGNBNOK, 2=BMWVEHCDN_PRKGBNOK, 3=BMWVEHCDN_FCTCUSTNOTINFZG, 5=BMWVEHCDN_LVNG, 7=BMWVEHCDN_CHKDIAGCANLS, 8=BMWVEHCDN_DRVRPREPGFOROPER, 10=BMWVEHCDN_DRVG, 12=BMWVEHCDN_DRVRPREPGFOREXITOPER, 15=BMWVEHCDN_INVLD}, implementation-data-type=uint8, type-emitter=RTE
    BmwVehCdnQlfr1: compu {2=SignalValueIsValid, 3=SignalValueIsValidButRestricted, 14=ValueNotAvaliable, 15=UnfulfilledSignal}, implementation-data-type=uint8, type-emitter=RTE
    BmwVehCentrOffs1: category=STRUCTURE, sw-calibration-access=READ-ONLY, dynamic-array-size-profile=None, type-emitter=RTE
      4 x element, all with category=TYPE_REFERENCE:
        BmwRackCentrToVehCentrOffs: implementation-data-type=float32
        VehCentrOffs: implementation-data-type=float32
        LongTermVehCentrCmpl: implementation-data-type=boolean
        BmwQuadRotorOffs: implementation-data-type=sint8
    BmwVehCentrOffsRec1: category=STRUCTURE, sw-calibration-access=READ-ONLY, dynamic-array-size-profile=None, type-emitter=RTE
      10 x element, all with category=TYPE_REFERENCE:
        BmwRackCentrToVehCentrOffs: implementation-data-type=float32
        VehCentrOffs: implementation-data-type=float32
        BmwPinionAgOffs: implementation-data-type=float32
        BmwQuadRotorOffs: implementation-data-type=sint8
        TurnCntrCorrlnSts: implementation-data-type=uint8
        Ntc8CSts: implementation-data-type=uint8
        Ntc8ESts: implementation-data-type=uint8
        BmwMotAgSelnSt: implementation-data-type=uint8
        LongTermVehCentrCmpl: implementation-data-type=boolean
        RackCentrToVehCentrOffsVld: implementation-data-type=boolean
    BmwVehEgySts1: compu {0=EnergyStateGood, 1=EnergyStateOk, 2=EnergyStateShortage, 3=EnergyStateSevereShortage, 15=EnergyStateInvalid}, implementation-data-type=uint8, type-emitter=RTE
    BmwVehInterlockErrMemSts1: compu {0=MemoryReleaseError, 1=MemoryLockError, 3=Invalid}, implementation-data-type=uint8, type-emitter=RTE
    BmwVehSpdSts1: compu {1=BMWVEHSPDSTS_VLD, 4=BMWVEHSPDSTS_SUBVALSETINUSFLSIGVEHSTANDG, 12=BMWVEHSPDSTS_SUBVALSETINUSFLSIGVEHRUNNG, 14=BMWVEHSPDSTS_SUBVALSETINUSRSIGNOINFO, 15=BMWVEHSPDSTS_INVLD}, implementation-data-type=uint8, type-emitter=RTE
    BmwVltgDrpSts1: compu {0=BMWVLTGDRPSTS_NOVLTGDRP, 1=BMWVLTGDRPSTS_STRTVLTGDRPTOMAXVLTGTHD1, 2=BMWVLTGDRPSTS_STRTVLTGDRPTOMAXVLTGTHD2, 13=BMWVLTGDRPSTS_FCTIFUNAVL, 15=BMWVLTGDRPSTS_INVLD}, implementation-data-type=uint8, type-emitter=RTE
    CalCopySts1: compu {0=CALCOPYSTS_NOTRDY, 1=CALCOPYSTS_COPYPNDING, 2=CALCOPYSTS_COPYCMPL, 3=CALCOPYSTS_PROCERR}, implementation-data-type=uint8, type-emitter=RTE
    CmdRtnBufRec1: category=STRUCTURE, sw-calibration-access=READ-ONLY, dynamic-array-size-profile=None, type-emitter=NvMProxy
      element StdRtn: implementation-data-type=uint8
      element ReqPen: implementation-data-type=uint8
      element ReqRes: implementation-data-type=uint8
    CrcHwResvCfg1: compu {0=CRCHWRESVCFG_32BITCRC32BITWIDTH, 1=CRCHWRESVCFG_32BITCRC16BITWIDTH, 2=CRCHWRESVCFG_32BITCRC8BITWIDTH, 3=CRCHWRESVCFG_16BITCRC16BITWIDTH, 4=CRCHWRESVCFG_16BITCRC8BITWIDTH, 5=CRCHWRESVCFG_8BITCRC, 6=CRCHWRESVCFG_8BITCRCH2F}, implementation-data-type=uint8, type-emitter=RTE
    CrcHwResvMod1: compu {0=CRCHWRESVMOD_RELS, 1=CRCHWRESVMOD_RESV}, implementation-data-type=uint8, type-emitter=RTE
    CrcHwSts1: compu {0=CRCHWSTS_NOTAVL, 1=CRCHWSTS_AVL, 2=CRCHWSTS_BUSY, 3=CRCHWSTS_NOTENAD, 4=CRCHWSTS_RESV, 255=CRCHWSTS_IDXINVLD}, implementation-data-type=uint8, type-emitter=RTE
    CrcHwStsRec1: category=STRUCTURE, sw-calibration-access=READ-ONLY, dynamic-array-size-profile=None, type-emitter=RTE  # OBSOLETE
      element TaskId: implementation-data-type=uint16
      element CrcHwSts: implementation-data-type=CrcHwSts1
    CrcHwStsRec2: category=STRUCTURE, sw-calibration-access=READ-ONLY, dynamic-array-size-profile=None, type-emitter=RTE
      element TaskId: implementation-data-type=uint32
      element CrcHwSts: implementation-data-type=CrcHwSts1
    CurrMeasEolGainCal3PhaRec1: category=STRUCTURE, sw-calibration-access=READ-ONLY, dynamic-array-size-profile=None, type-emitter=RTE
      element CurrMeasMotCurrEolGainA: implementation-data-type=float32
      element CurrMeasMotCurrEolGainB: implementation-data-type=float32
      element CurrMeasMotCurrEolGainC: implementation-data-type=float32
      symbol props CurrMeasEolGainCal3PhaRec1
    CurrMeasEolGainCalRec1: category=STRUCTURE, sw-calibration-access=READ-ONLY, dynamic-array-size-profile=None, type-emitter=RTE
      6 x element, all with category=TYPE_REFERENCE, implementation-data-type=float32:
        CurrMeasMotCurrEolGainA
        CurrMeasMotCurrEolGainB
        CurrMeasMotCurrEolGainC
        CurrMeasMotCurrEolGainD
        CurrMeasMotCurrEolGainE
        CurrMeasMotCurrEolGainF
      symbol props CurrMeasEolGainCalRec1
    CurrMeasEolOffsCal3PhaRec1: category=STRUCTURE, sw-calibration-access=READ-ONLY, dynamic-array-size-profile=None, type-emitter=RTE
      7 x element, all with category=TYPE_REFERENCE, implementation-data-type=float32:
        CurrMeasEolOffsHiBrdgVltg
        CurrMeasMotCurrEolOffsDifA
        CurrMeasMotCurrEolOffsDifB
        CurrMeasMotCurrEolOffsDifC
        CurrMeasMotCurrOffsLoAvrgA
        CurrMeasMotCurrOffsLoAvrgB
        CurrMeasMotCurrOffsLoAvrgC
      symbol props CurrMeasEolOffsCal3PhaRec1
    CurrMeasEolOffsCalRec1: category=STRUCTURE, sw-calibration-access=READ-ONLY, dynamic-array-size-profile=None, type-emitter=RTE
      13 x element, all with category=TYPE_REFERENCE, implementation-data-type=float32:
        CurrMeasEolOffsHiBrdgVltg
        CurrMeasMotCurrEolOffsDifA
        CurrMeasMotCurrEolOffsDifB
        CurrMeasMotCurrEolOffsDifC
        CurrMeasMotCurrEolOffsDifD
        CurrMeasMotCurrEolOffsDifE
        CurrMeasMotCurrEolOffsDifF
        CurrMeasMotCurrOffsLoAvrgA
        CurrMeasMotCurrOffsLoAvrgB
        CurrMeasMotCurrOffsLoAvrgC
        CurrMeasMotCurrOffsLoAvrgD
        CurrMeasMotCurrOffsLoAvrgE
        CurrMeasMotCurrOffsLoAvrgF
      symbol props CurrMeasEolOffsCalRec1
    CurrMeasEolOffsGainCalRec1: category=STRUCTURE, sw-calibration-access=READ-ONLY, dynamic-array-size-profile=None, type-emitter=RTE
      6 x element, all with category=TYPE_REFERENCE, implementation-data-type=float32:
        CurrMeasMotCurrOffsZeroAvrgA
        CurrMeasMotCurrOffsZeroAvrgB
        CurrMeasMotCurrOffsZeroAvrgC
        CurrMeasMotCurrEolGainA
        CurrMeasMotCurrEolGainB
        CurrMeasMotCurrEolGainC
      symbol props CurrMeasEolOffsGainCalRec1
    DiagcDataRec2: category=STRUCTURE, sw-calibration-access=READ-ONLY, dynamic-array-size-profile=None, type-emitter=RTE
      element DiagcSts: implementation-data-type=uint8
      element ActvRampRate: implementation-data-type=float32
      element ActvMotTqCmdSca: implementation-data-type=float32
    DrvgDynIfSt1: compu {32=DRVGDYNIFST_IFAVLRDYFOROPERWOADDLDAMPG, 33=DRVGDYNIFST_IFACTVADDLDAMPGNOTAVL, 34=DRVGDYNIFST_IFAVLRDYFOROPERADDLDAMPG, 35=DRVGDYNIFST_IFACTVADDLDAMPGAVL, 96=DRVGDYNIFST_SRVNOTAVLERR, 128=DRVGDYNIFST_IFINID, 224=DRVGDYNIFST_SRVNOTAVLSTBPMA, 225=DRVGDYNIFST_SRVNOTAVLSTBEPSSTS, 255=DRVGDYNIFST_INVLDSIG}, implementation-data-type=uint8, type-emitter=RTE
    DutyCycExcddDataRec1: category=STRUCTURE, sw-calibration-access=READ-ONLY, dynamic-array-size-profile=None, type-emitter=RTE
      element ExcddCnt: implementation-data-type=uint8
      element IgnCnt: implementation-data-type=uint8
      symbol props DutyCycExcddDataRec1
    DutyCycThermProtnFilStValRec1: category=STRUCTURE, sw-calibration-access=READ-ONLY, dynamic-array-size-profile=None, type-emitter=RTE
      4 x element, all with category=TYPE_REFERENCE, implementation-data-type=uint8:
        Fil{3..6}StVal
      symbol props DutyCycThermProtnFilStValRec1
    EgyModSt1: compu {0=EGYMODST_NORM, 1=EGYMODST_PRDN, 2=EGYMODST_TRANSPT, 3=EGYMODST_FLS}, implementation-data-type=uint8, type-emitter=RTE
    EOLGainOffs1: category=STRUCTURE, sw-calibration-access=READ-ONLY, dynamic-array-size-profile=None, type-emitter=RTE
      19 x element, all with category=TYPE_REFERENCE, implementation-data-type=float32:
        CurrMeasEolOffsHiBrdgVltg
        CurrMeasMotCurrEolGainA
        CurrMeasMotCurrEolGainB
        CurrMeasMotCurrEolGainC
        CurrMeasMotCurrEolGainD
        CurrMeasMotCurrEolGainE
        CurrMeasMotCurrEolGainF
        CurrMeasMotCurrEolOffsDifA
        CurrMeasMotCurrEolOffsDifB
        CurrMeasMotCurrEolOffsDifC
        CurrMeasMotCurrEolOffsDifD
        CurrMeasMotCurrEolOffsDifE
        CurrMeasMotCurrEolOffsDifF
        CurrMeasMotCurrOffsLoAvrgA
        CurrMeasMotCurrOffsLoAvrgB
        CurrMeasMotCurrOffsLoAvrgC
        CurrMeasMotCurrOffsLoAvrgD
        CurrMeasMotCurrOffsLoAvrgE
        CurrMeasMotCurrOffsLoAvrgF
      symbol props EOLGainOffs1
    EotNvmDataRec1: category=STRUCTURE, sw-calibration-access=READ-ONLY, dynamic-array-size-profile=None, type-emitter=RTE
      4 x element, all with category=TYPE_REFERENCE:
        CwEot: implementation-data-type=float32
        CcwEot: implementation-data-type=float32
        CwEotDetd: implementation-data-type=boolean
        CcwEotDetd: implementation-data-type=boolean
    EotSt1: compu {0=EOTST_DISAD, 1=EOTST_NORM, 2=EOTST_ENTR, 3=EOTST_EXIT}, implementation-data-type=uint8, type-emitter=RTE
    EpsCurrLimSts1: compu {0=EPSCURRLIMSTST_NOCURRLIMR, 1=EPSCURRLIMSTST_CMFTCURRLIMR, 10=EPSCURRLIMSTST_MAXCURRLIMN, 13=EPSCURRLIMSTST_RESDNOTAVL, 14=EPSCURRLIMSTST_RESDERR, 15=EPSCURRLIMSTST_SIGUNFLD}, implementation-data-type=uint8, type-emitter=RTE
    FilHpRec1: category=STRUCTURE, sw-calibration-access=READ-ONLY, dynamic-array-size-profile=None, type-emitter=NxtrFil
      element FilLpRec: implementation-data-type=FilLpRec1
      element CorrnFac: implementation-data-type=float32
    FilLpRec1: category=STRUCTURE, sw-calibration-access=READ-ONLY, dynamic-array-size-profile=None, type-emitter=NxtrFil
      element FilSt: implementation-data-type=float32
      element FilGain: implementation-data-type=float32
      symbol props FilLpRec1
    FilNotchGainRec1: category=STRUCTURE, sw-calibration-access=READ-ONLY, dynamic-array-size-profile=None
      5 x element, all with category=TYPE_REFERENCE, implementation-data-type=float32:
        FilGainB{0..2}
        FilGainA1
        FilGainA2
    FilNotchStRec1: category=STRUCTURE, sw-calibration-access=READ-ONLY, dynamic-array-size-profile=None, type-emitter=RTE
      element FilSt1: implementation-data-type=float32
      element FilSt2: implementation-data-type=float32
    FordEpsLifeCycMod1: compu {0=Norm, 1=Factry, 2=Transpt}, implementation-data-type=uint8, type-emitter=RTE
    GetSegMod1: compu {0=GETSEGMOD_ADRINFO, 1=GETSEGMOD_STDINFO, 2=GETSEGMOD_ADRMPG}, implementation-data-type=uint8, type-emitter=RTE
    GmAutnmsDrvgIfFltRespDi1: compu {0=GMAUTNMSDRVGIFFLTRESPDI_TMPINHBD, 1=GMAUTNMSDRVGIFFLTRESPDI_NORM, 2=GMAUTNMSDRVGIFFLTRESPDI_FAILD}, implementation-data-type=uint8, type-emitter=RTE
    GmAutnmsSteerCmdSts1: compu {0=GMAUTNMSSTEERCMDSTS_UKWN, 1=GMAUTNMSSTEERCMDSTS_TMPINHBD, 2=GMAUTNMSSTEERCMDSTS_RDY, 3=GMAUTNMSSTEERCMDSTS_ACTV, 4=GMAUTNMSSTEERCMDSTS_TMPLIMD, 5=GMAUTNMSSTEERCMDSTS_EMGYSTEERPROF, 6=GMAUTNMSSTEERCMDSTS_FAILD}, implementation-data-type=uint8, type-emitter=RTE
    GmBackUpSysPwrModAuthentd1: compu {0=GMBACKUPSYSPWRMODAUTHENTD_OFF, 1=GMBACKUPSYSPWRMODAUTHENTD_ACSY, 2=GMBACKUPSYSPWRMODAUTHENTD_RUN, 3=GMBACKUPSYSPWRMODAUTHENTD_PRPN, 4=GMBACKUPSYSPWRMODAUTHENTD_STRTREQ}, implementation-data-type=uint8, type-emitter=RTE
    GmDrvrIntvDetnSt1: compu {0=GMDRVRINTVDETNST_ININ, 1=GMDRVRINTVDETNST_TRUE, 2=GMDRVRINTVDETNST_FALSE, 3=GMDRVRINTVDETNST_DISAD}, implementation-data-type=uint8, type-emitter=RTE
    GmDualEcuOperSts1: compu {0=GMDUALECUOPERSTS_ININ, 1=GMDUALECUOPERSTS_FAILOPER, 2=GMDUALECUOPERSTS_SNGCTRLR, 3=GMDUALECUOPERSTS_FAILD}, implementation-data-type=uint8, type-emitter=RTE
    GmEscSysStsAuthentdSt1: compu {0=GMESCSYSSTSAUTHENTDST_NORMOPER, 1=GMESCSYSSTSAUTHENTDST_FAILD, 2=GMESCSYSSTSAUTHENTDST_INIT, 3=GMESCSYSSTSAUTHENTDST_ENHDOPER, 4=GMESCSYSSTSAUTHENTDST_DRVRDI}, implementation-data-type=uint8, type-emitter=RTE
    GmFctDiArbnSts1: compu {0=GMFCTDIARBNSTS_WAIT, 1=GMFCTDIARBNSTS_INPROC, 2=GMFCTDIARBNSTS_PASSD, 3=GMFCTDIARBNSTS_SWBASDMTGTNFAIL, 4=GMFCTDIARBNSTS_TIMEOUTFAIL}, implementation-data-type=uint8, type-emitter=RTE
    GmOvrlFeatActvSt1: compu {0=GMOVRLFEATACTVST_NONE, 1=GMOVRLFEATACTVST_ESC, 2=GMOVRLFEATACTVST_APA, 3=GMOVRLFEATACTVST_LKA, 4=GMOVRLFEATACTVST_LCC, 5=GMOVRLFEATACTVST_TRFCJAMASSI, 6=GMOVRLFEATACTVST_HOLF}, implementation-data-type=uint8, type-emitter=RTE
    GmOvrlStMgrApaSt1: compu {0=GMOVRLSTMGRAPAST_TMPINHB, 1=GMOVRLSTMGRAPAST_AVLCTRL, 2=GMOVRLSTMGRAPAST_ACTV, 3=GMOVRLSTMGRAPAST_PRMNTFAILD, 4=GMOVRLSTMGRAPAST_MFGDI}, implementation-data-type=uint8, type-emitter=RTE
    GmOvrlStMgrHandsOnLaneFolwgSt1: compu {0=GMOVRLSTMGRHANDSONLANEFOLWGST_TMPINHB, 1=GMOVRLSTMGRHANDSONLANEFOLWGST_AVLCTRL, 2=GMOVRLSTMGRHANDSONLANEFOLWGST_ACTV, 3=GMOVRLSTMGRHANDSONLANEFOLWGST_PRMNTFAILD, 4=GMOVRLSTMGRHANDSONLANEFOLWGST_MFGDI}, implementation-data-type=uint8, type-emitter=RTE
    GmOvrlStMgrHaptcSt1: compu {0=GMOVRLSTMGRHAPTCST_INACTVNOTPLS, 1=GMOVRLSTMGRHAPTCST_ACTVPLS, 2=GMOVRLSTMGRHAPTCST_WAITAFTPLS, 3=GMOVRLSTMGRHAPTCST_INACTVRDYPLS, 4=GMOVRLSTMGRHAPTCST_DI}, implementation-data-type=uint8, type-emitter=RTE
    GmOvrlStMgrTrfcJamAssiSt1: compu {0=GMOVRLSTMGRTRFCJAMASSIST_TMPINHB, 1=GMOVRLSTMGRTRFCJAMASSIST_AVLCTRL, 2=GMOVRLSTMGRTRFCJAMASSIST_ACTV, 3=GMOVRLSTMGRTRFCJAMASSIST_PRMNTFAILD, 4=GMOVRLSTMGRTRFCJAMASSIST_MFGDI}, implementation-data-type=uint8, type-emitter=RTE
    GmRxMonrdSig1: compu {0=GMRXMONRDSIG_DISAD, 1=GMRXMONRDSIG_UNINID, 2=GMRXMONRDSIG_UNAVL, 3=GMRXMONRDSIG_AVL}, implementation-data-type=uint8, type-emitter=RTE
    GmSecuAcsFlg1:
      compu {0=GMSECUACSFLG_DIAGCCTRLMGRSECULVLLOCKD, 1=GMSECUACSFLG_DIAGCCTRLMGRSECULVL1, 2=GMSECUACSFLG_DIAGCCTRLMGRSECULVL2, 3=GMSECUACSFLG_DIAGCCTRLMGRSECULVL3, 5=GMSECUACSFLG_DIAGCCTRLMGRSECULVL5, 6=GMSECUACSFLG_DIAGCCTRLMGRSECULVL6, 7=GMSECUACSFLG_DIAGCCTRLMGRSECULVL7, 9=GMSECUACSFLG_DIAGCCTRLMGRSECULVL9, 10=GMSECUACSFLG_DIAGCCTRLMGRSECULVL10, 11=GMSECUACSFLG_DIAGCCTRLMGRSECULVL11}
      implementation-data-type=uint8
      type-emitter=RTE
    GmSteerAgCtrlDiSt1: compu-method=GmSteerAgCtrlDiSt1, implementation-data-type=uint8, type-emitter=RTE
    GmSteerCmdLimrSt1: compu {0=GMSTEERCMDLIMRST_UKWN, 1=GMSTEERCMDLIMRST_NORM, 2=GMSTEERCMDLIMRST_SFTYLIMEXCDD, 3=GMSTEERCMDLIMRST_THERM, 4=GMSTEERCMDLIMRST_VLTG, 5=GMSTEERCMDLIMRST_LSH, 6=GMSTEERCMDLIMRST_FRICLIMD, 7=GMSTEERCMDLIMRST_ECUFLTLIMD}, implementation-data-type=uint8, type-emitter=RTE
    GmSteerCmdMsgSrc1: compu {0=GMSTEERCMDMSGSRC_PRIMCTRLR, 1=GMSTEERCMDMSGSRC_RDNTCTRLR, 2=GMSTEERCMDMSGSRC_DUALECUFAILD}, implementation-data-type=uint8, type-emitter=RTE
    GmSteerCmdMsgSts1: compu {0=GMSTEERCMDMSGSTS_NORMCOM, 1=GMSTEERCMDMSGSTS_PRIMCOMFAILD, 2=GMSTEERCMDMSGSTS_RDNTCOMFAILD, 3=GMSTEERCMDMSGSTS_DUALECUCOMFAILD}, implementation-data-type=uint8, type-emitter=RTE
    GmSteerMod1: compu {0=GMSTEERMOD_BASEPS, 1=GMSTEERMOD_SEMIATNMS, 2=GMSTEERMOD_FULLYATNMS}, implementation-data-type=uint8, type-emitter=RTE
    GmSteerPrfmncModReq1: compu {0=GMSTEERPRFMNCMODREQ_NOACTN, 1=GMSTEERPRFMNCMODREQ_NORM, 2=GMSTEERPRFMNCMODREQ_SPT, 3=GMSTEERPRFMNCMODREQ_CMFT, 4=GMSTEERPRFMNCMODREQ_LANE, 5=GMSTEERPRFMNCMODREQ_TOW, 6=GMSTEERPRFMNCMODREQ_CITY, 7=GMSTEERPRFMNCMODREQ_PRFMNCMOD7}, implementation-data-type=uint8, type-emitter=RTE
    GmSteerReqArbdFeatAuthentdSt1: compu {0=GMSTEERREQARBDFEATAUTHENTD_CAS, 1=GMSTEERREQARBDFEATAUTHENTD_TRFCJAMASSI, 2=GMSTEERREQARBDFEATAUTHENTD_LCC, 3=GMSTEERREQARBDFEATAUTHENTD_HOLF, 4=GMSTEERREQARBDFEATAUTHENTD_SAA, 5=GMSTEERREQARBDFEATAUTHENTD_LKA, 6=GMSTEERREQARBDFEATAUTHENTD_LCOD, 7=GMSTEERREQARBDFEATAUTHENTD_LCP}, implementation-data-type=uint8, type-emitter=RTE
    GmSteerReqStsAuthentdSt1: compu {0=GMSTEERREQSTSAUTHENTDST_UKWN, 1=GMSTEERREQSTSAUTHENTDST_ACTV, 2=GMSTEERREQSTSAUTHENTDST_INACTV}, implementation-data-type=uint8, type-emitter=RTE
    GmSysDataCollctnEnaSt1: compu {0=GMSYSDATACOLLCTNENAST_NOTENAD, 1=GMSYSDATACOLLCTNENAST_SERLCOMENAD, 2=GMSYSDATACOLLCTNENAST_ADASENAD, 3=GMSYSDATACOLLCTNENAST_VEHHLTHSTMGRENAD, 4=GMSYSDATACOLLCTNENAST_NTCENAD}, implementation-data-type=uint8, type-emitter=RTE
    GmSysPwrMod1: compu {0=GMSYSPWRMOD_OFF, 1=GMSYSPWRMOD_ACSY, 2=GMSYSPWRMOD_RUN, 3=GMSYSPWRMOD_CRK, 4=GMSYSPWRMOD_PRPN}, implementation-data-type=uint8, type-emitter=RTE
    GmSysPwrModAuthentd1: compu {0=GMSYSPWRMODAUTHENTD_OFF, 1=GMSYSPWRMODAUTHENTD_ACSY, 2=GMSYSPWRMODAUTHENTD_RUN, 3=GMSYSPWRMODAUTHENTD_STRTREQ, 4=GMSYSPWRMODAUTHENTD_PRPN}, implementation-data-type=uint8, type-emitter=RTE
    GmTqArbnEscSt1: compu {0=GMTQARBNESCST_INACTV, 1=GMTQARBNESCST_ACTV, 2=GMTQARBNESCST_TMPLIMD, 3=GMTQARBNESCST_PRMNTFAILD, 4=GMTQARBNESCST_MFGDI}, implementation-data-type=uint8, type-emitter=RTE
    GmTqArbnLkaSt1: compu {0=GMTQARBNLKAST_INACTV, 1=GMTQARBNLKAST_ACTV, 2=GMTQARBNLKAST_TMPLIMD, 3=GMTQARBNLKAST_PRMNTFAILD, 4=GMTQARBNLKAST_MFGDI}, implementation-data-type=uint8, type-emitter=RTE
    GmTqArbnTrfcJamAssiSt1: compu {0=GMTQARBNTRFCJAMASSIST_INACTV, 1=GMTQARBNTRFCJAMASSIST_ACTV, 2=GMTQARBNTRFCJAMASSIST_TMPLIMD, 3=GMTQARBNTRFCJAMASSIST_PRMNTFAILD, 4=GMTQARBNTRFCJAMASSIST_MFGDI}, implementation-data-type=uint8, type-emitter=RTE
    GmTrsmShiftLvrPosnAuthentd1:
      compu {0=GMTRSMSHIFTLVRPOSNAUTHENTD_BTWNRNG, 1=GMTRSMSHIFTLVRPOSNAUTHENTD_PARKRNG, 2=GMTRSMSHIFTLVRPOSNAUTHENTD_RVSRNG, 3=GMTRSMSHIFTLVRPOSNAUTHENTD_NEUTRNG, 4=GMTRSMSHIFTLVRPOSNAUTHENTD_FWDRNGA, 5=GMTRSMSHIFTLVRPOSNAUTHENTD_FWDRNGB, 6=GMTRSMSHIFTLVRPOSNAUTHENTD_FWDRNGC, 7=GMTRSMSHIFTLVRPOSNAUTHENTD_FWDRNGD, 8=GMTRSMSHIFTLVRPOSNAUTHENTD_FWDRNGE, 9=GMTRSMSHIFTLVRPOSNAUTHENTD_FWDRNGF, 10=GMTRSMSHIFTLVRPOSNAUTHENTD_FWDRNGG, 11=GMTRSMSHIFTLVRPOSNAUTHENTD_FWDRNGH, 12=GMTRSMSHIFTLVRPOSNAUTHENTD_FWDRNGI, 13=GMTRSMSHIFTLVRPOSNAUTHENTD_FWDRNGJ, 14=GMTRSMSHIFTLVRPOSNAUTHENTD_LVRPOSNUNKWN}
      implementation-data-type=uint8
      type-emitter=RTE
    GmVehHlthMgrSt1: compu {0=GMVEHHLTHMGRST_ININ, 1..5=GMVEHHLTHMGRST_DEGRADEDMOD1..GMVEHHLTHMGRST_DEGRADEDMOD5, 6=GMVEHHLTHMGRST_NORMOPER}, implementation-data-type=uint8, type-emitter=RTE
    GmVehModMgrSt1: compu {0=GMVEHMODMGRST_UKWN, 1=GMVEHMODMGRST_MAN, 2=GMVEHMODMGRST_AUTNMSSUPVD, 3=GMVEHMODMGRST_SUPVROVRD, 4=GMVEHMODMGRST_AUTNMSUNSUPVD, 5=GMVEHMODMGRST_FAILD}, implementation-data-type=uint8, type-emitter=RTE
    HaptcFbSt1: compu {1=HAPTCFBST_FCTAVLNOTACTV, 6=HAPTCFBST_ERR, 9=HAPTCFBST_FCTAVLACTV, 14=HAPTCFBST_FCTNOTAVL, 15=HAPTCFBST_INVLDSIG}, implementation-data-type=uint8, type-emitter=RTE
    HwAgOffsRec1: category=STRUCTURE, sw-calibration-access=READ-ONLY, dynamic-array-size-profile=None, type-emitter=RTE
      element OffsTrim: implementation-data-type=float32
      element OffsTrimPrfmdSts: implementation-data-type=boolean
    HwAgSnsrTrimRec1: category=STRUCTURE, sw-calibration-access=READ-ONLY, dynamic-array-size-profile=None, type-emitter=RTE
      element TrimVal: implementation-data-type=float32
      element TrimPrfmd: implementation-data-type=boolean
    HwAgSnsrTyp1: compu {0=HWAGSNSRTYP_NOSNSR, 1=HWAGSNSRTYP_A1335}, implementation-data-type=uint8, type-emitter=RTE
    HwAgTrajCmdSt1: compu {0=HWAGTRAJCMDST_WAIT, 1=HWAGTRAJCMDST_HWAGA, 2=HWAGTRAJCMDST_CONVEL, 3=HWAGTRAJCMDST_HWAGDECEL, 4=HWAGTRAJCMDST_HLD}, implementation-data-type=uint16, type-emitter=RTE
    HwTqOffsRec1: category=STRUCTURE, sw-calibration-access=READ-ONLY, dynamic-array-size-profile=None, type-emitter=RTE
      element OffsTrim: implementation-data-type=float32
      element OffsTrimPrfmdSts: implementation-data-type=boolean
    ImcArbnRxSts1: compu {0=IMCARBNRXSTS_NODATA, 1=IMCARBNRXSTS_VLD, phys=raw for raw 2}, implementation-data-type=uint8, type-emitter=RTE
    IvtrFetFltPha1: compu {0=IVTRFETFLTPHA_NOPHASNGFETFLT, 1=IVTRFETFLTPHA_PHAASNGFETFLT, 2=IVTRFETFLTPHA_PHABSNGFETFLT, 4=IVTRFETFLTPHA_PHACSNGFETFLT}, implementation-data-type=uint8, type-emitter=RTE
    IvtrFetFltTyp1: compu {0=IVTRFETFLTTYP_NOFETFLT, 1=IVTRFETFLTTYP_LOWRFETFLT, 2=IVTRFETFLTTYP_UPPRFETFLT, 4=IVTRFETFLTTYP_MPLFETFLT}, implementation-data-type=uint8, type-emitter=RTE
    LoaSt1: compu {0=LOAST_NORM, 1=LOAST_LIMD, 2=LOAST_SWBASDMTGTN, 3=LOAST_FADEOUT, 4=LOAST_CTRLDSHTDWNREQD, 5=LOAST_IMDTSHTDWNREQD}, implementation-data-type=uint8, type-emitter=RTE
    LrndRackCentrNvmRec1: category=STRUCTURE, sw-calibration-access=READ-ONLY, dynamic-array-size-profile=None, type-emitter=RTE
      5 x element, all with category=TYPE_REFERENCE:
        TotRackTrvl: implementation-data-type=float32
        RackCentrMotDeg: implementation-data-type=float32
        RackCentrMotRev: implementation-data-type=sint16
        LongTermRackCentrCmpl: implementation-data-type=boolean
        MotAgVld: implementation-data-type=boolean
    MaxHwAgCwAndCcwRec2: category=STRUCTURE, sw-calibration-access=READ-ONLY, dynamic-array-size-profile=None, type-emitter=RTE
      element HwAgCcwMax: implementation-data-type=float32
      element HwAgCwMax: implementation-data-type=float32
      element HwAgOverTrvlCnt: implementation-data-type=uint8
    MfgEnaSt1: compu {0=MFGENAST_PRDNMOD, 1=MFGENAST_MFGMOD, 2=MFGENAST_TESTMOD}, implementation-data-type=uint8, type-emitter=RTE
    MotAgEolPrmRec1: category=STRUCTURE, sw-calibration-access=READ-ONLY, dynamic-array-size-profile=None, type-emitter=RTE
      12 x element, all with category=TYPE_REFERENCE:
        SinOffs: implementation-data-type=u3p13
        CosOffs: implementation-data-type=u3p13
        SinAmpRecpr: implementation-data-type=u3p13
        CosAmpRecpr: implementation-data-type=u3p13
        SinDelta: implementation-data-type=s2p13
        SinHrmncTbl: implementation-data-type=Ary1D_sm6p13_144
        CosHrmncTbl: implementation-data-type=Ary1D_sm6p13_144
        SinGainCorrd: implementation-data-type=u1p15
        CosGainCorrd: implementation-data-type=u1p15
        SinOffsCorrd: implementation-data-type=s2p13
        CosOffsCorrd: implementation-data-type=s2p13
        CosDeltaRecpr: implementation-data-type=u3p13
    MotAgMeasEolPrmRec1: category=STRUCTURE, sw-calibration-access=READ-ONLY, dynamic-array-size-profile=None, type-emitter=RTE
      5 x element, all with category=TYPE_REFERENCE, implementation-data-type=float32:
        SinOffs
        CosOffs
        SinAmpRecpr
        CosAmpRecpr
        SinDelta
    MotAgRtPrmRec1: category=STRUCTURE, sw-calibration-access=READ-ONLY, dynamic-array-size-profile=None, type-emitter=RTE
      14 x element, all with category=TYPE_REFERENCE, implementation-data-type=float32:
        SinRtOffs
        SinRtAmpRecpr
        CosRtOffs
        CosRtAmpRecpr
        SinGainCorrd
        CosGainCorrd
        SinOffsCorrd
        CosOffsCorrd
        CosSinNomRatio
        SinCosNomRatio
        RtToNomRatioLoLim
        RtToNomRatioHiLim
        PrevSinRtOffs
        PrevCosRtOffs
    MotAgSnsrCfgSt1: compu {0=MOTAGSNSRCFGST_RSTERR, 1=MOTAGSNSRCFGST_RSTTURNCNTR, 2=MOTAGSNSRCFGST_CMDTRANSPT}, implementation-data-type=uint8, type-emitter=RTE
    MotAgSnsrIninSt1: compu {0=MOTAGSNSRININST_MOTAGININDATAREQ, 1=MOTAGSNSRININST_MOTAGININDATAREAD, 2=MOTAGSNSRININST_MOTAGMODREQ, 3=MOTAGSNSRININST_MOTAGCFGCRCCHK, 4=MOTAGSNSRININST_MOTAGCFGSEQFAIL, 5=MOTAGSNSRININST_MOTAGRTDATAREQ}, implementation-data-type=uint8, type-emitter=RTE
    MotAgStVariRec1: category=STRUCTURE, sw-calibration-access=READ-ONLY, dynamic-array-size-profile=None, type-emitter=RTE
      4 x element, all with category=TYPE_REFERENCE, implementation-data-type=float32:
        MotAgSinMax
        MotAgSinMin
        MotAgCosMax
        MotAgCosMin
    MotCurrEolCalSt2: compu {0=MCECS_OFFSCMDSTRT, 1=MCECS_OFFSCMDHI, 2=MCECS_OFFSCMDLO, 3=MCECS_OFFSCMDZERO, 4=MCECS_OFFSCMDEND, 5=MCECS_GAINCMDAD, 6=MCECS_GAINCMDBE, 7=MCECS_GAINCMDCF, 8=MCECS_CMDSAFEST}, implementation-data-type=uint8, type-emitter=RTE
    MotPrmNomEolRec2: category=STRUCTURE, sw-calibration-access=READ-ONLY, dynamic-array-size-profile=None, type-emitter=RTE
      element MotKeNom: implementation-data-type=float32
      element MotRNom: implementation-data-type=float32
      symbol props MotPrmNomEolRec2
    MotPrmNomEolRec3: category=STRUCTURE, sw-calibration-access=READ-ONLY, dynamic-array-size-profile=None, type-emitter=RTE
      element MotBackEmfConNom: implementation-data-type=float32
      element MotRNom: implementation-data-type=float32
      symbol props MotPrmNomEolRec3
    MotQuad1: compu {1..4=MOTQUAD_QUAD1..MOTQUAD_QUAD4}, implementation-data-type=uint8, type-emitter=RTE
    MotRplCoggPrmRec2: category=STRUCTURE, sw-calibration-access=READ-ONLY, dynamic-array-size-profile=None, type-emitter=RTE
      9 x element, all with category=TYPE_REFERENCE:
        CoggOrder1: implementation-data-type=uint16
        CoggOrder1X: implementation-data-type=s1p14
        CoggOrder1Y: implementation-data-type=s1p14
        CoggOrder2: implementation-data-type=uint16
        CoggOrder2X: implementation-data-type=s1p14
        CoggOrder2Y: implementation-data-type=s1p14
        CoggOrder3: implementation-data-type=uint16
        CoggOrder3X: implementation-data-type=s1p14
        CoggOrder3Y: implementation-data-type=s1p14
    NtcFltInfoRec2: category=STRUCTURE, sw-calibration-access=READ-ONLY, dynamic-array-size-profile=None, type-emitter=RTE
      element NtcNr: implementation-data-type=NtcNrWithResd1
      element AgiCntr: implementation-data-type=uint8
      element Sts: implementation-data-type=uint8
    NtcInfoRec4: category=STRUCTURE, sw-calibration-access=READ-ONLY, dynamic-array-size-profile=None, type-emitter=DiagcMgr
      element NtcStInfo: implementation-data-type=uint8
      element Sts: implementation-data-type=uint8
      element AgiCntr: implementation-data-type=uint8
    NtcNr1: compu {1..511=NTCNR_0X001..NTCNR_0X1FF}, implementation-data-type=uint16, type-emitter=RTE
    NtcNrWithResd1: compu {0=NTCNR_RESD, 1..511=NTCNR_0X001..NTCNR_0X1FF}, implementation-data-type=uint16, type-emitter=RTE
    NtcSts1: compu {0=NTCSTS_PASSD, 1=NTCSTS_FAILD, 2=NTCSTS_PREPASSD, 3=NTCSTS_PREFAILD}, implementation-data-type=uint8, type-emitter=RTE
    OnlineCalPageInfoRec1: category=STRUCTURE, sw-calibration-access=READ-ONLY, dynamic-array-size-profile=None, type-emitter=TunSelnMngt
      element PageAcs: implementation-data-type=uint8
    OnlineCalSegInfoRec1: category=STRUCTURE, sw-calibration-access=READ-ONLY, dynamic-array-size-profile=None, type-emitter=TunSelnMngt
      element Page: implementation-data-type=Ary1D_OnlineCalPageInfoRec1_2
    OnlineCalStsRec1: category=STRUCTURE, dynamic-array-size-profile=None, type-emitter=RTE
      5 x element, all with category=TYPE_REFERENCE:
        Seg: implementation-data-type=Ary1D_OnlineCalSegInfoRec1_TunSelnMngt1
        CopySts: implementation-data-type=CalCopySts1
        ActvGroup: implementation-data-type=uint8
        ActvInin: implementation-data-type=uint8
        ActvRt: implementation-data-type=uint8
    OnlineCalStsRec2: category=STRUCTURE, dynamic-array-size-profile=None, type-emitter=RTE
      6 x element, all with category=TYPE_REFERENCE:
        Seg: implementation-data-type=Ary1D_OnlineCalSegInfoRec1_TunSelnMngt1
        CopySts: implementation-data-type=CalCopySts1
        ActvGroup: implementation-data-type=uint8
        ActvInin: implementation-data-type=uint8
        ActvIninOptSetA: implementation-data-type=uint8
        ActvRt: implementation-data-type=uint8
    PassFailCntrDiagcRec1: category=STRUCTURE, sw-calibration-access=READ-ONLY, dynamic-array-size-profile=None, type-emitter=RTE
      5 x element, all with category=TYPE_REFERENCE:
        Cntr: implementation-data-type=float32
        Thd: implementation-data-type=float32
        NegStep: implementation-data-type=float32
        PosStep: implementation-data-type=float32
        Sts: implementation-data-type=SigQlfr1
    PhaDiscnctPwmVect1: compu {0=PHADISCNCTPWMVECT_NOCMD, 1=PHADISCNCTPWMVECT_PHAACMD, 2=PHADISCNCTPWMVECT_PHABCMD, 4=PHADISCNCTPWMVECT_PHACCMD}, implementation-data-type=uint8, type-emitter=RTE
    PwrDiscnctSts1: compu {0=PWRDISCNCTSTS_WAITFORSTRTA, 1=PWRDISCNCTSTS_VRFYDISCNCTOPEN, 2=PWRDISCNCTSTS_WAITFORSTRTB, 3=PWRDISCNCTSTS_VRFYCLS, 4=PWRDISCNCTSTS_SEQFAIL, 5=PWRDISCNCTSTS_RTDIAGC}, implementation-data-type=uint8, type-emitter=RTE
    ReadFltInfoRec1: category=STRUCTURE, sw-calibration-access=READ-ONLY, dynamic-array-size-profile=None, type-emitter=RTE
      4 x element, all with category=TYPE_REFERENCE:
        NtcNr: implementation-data-type=NtcNrWithResd1
        AgiCntr: implementation-data-type=uint8
        Sts: implementation-data-type=uint8
        NtcStInfo: implementation-data-type=uint8
    RtIdxChgSts1: compu {phys=raw for raw 0, phys=raw for raw 1, phys=raw for raw 2, phys=raw for raw 3, phys=raw for raw 4, phys=raw for raw 5}, implementation-data-type=uint8, type-emitter=RTE
    s10p5: implementation-data-type=sint16, type-emitter=RTE
    s11p4: implementation-data-type=sint16, type-emitter=RTE
    s12p3: implementation-data-type=sint16, type-emitter=RTE
    s14p1: implementation-data-type=sint16, type-emitter=RTE
    s15p0: implementation-data-type=sint16, type-emitter=RTE
    s15p16: implementation-data-type=sint32, type-emitter=RTE
    s18p13: implementation-data-type=sint32, type-emitter=RTE
    s1p14: implementation-data-type=sint16, type-emitter=RTE
    s2p13: implementation-data-type=sint16, type-emitter=RTE
    s3p12: implementation-data-type=sint16, type-emitter=RTE
    s4p11: implementation-data-type=sint16, type-emitter=RTE
    s5p10: implementation-data-type=sint16, type-emitter=RTE
    s6p9: implementation-data-type=sint16, type-emitter=RTE
    s7p8: implementation-data-type=sint16, type-emitter=RTE
    s8p7: implementation-data-type=sint16, type-emitter=RTE
    SelnCaseSt1: compu {0=SELNCASEST_FCENTR, 1=SELNCASEST_VEHDYN, 2=SELNCASEST_WHLSPD, 3=SELNCASEST_STORDLSTPOSN, 4=SELNCASEST_CORRDPINIONAG}, implementation-data-type=uint8, type-emitter=RTE
    SigQlfr1: compu {0=SIGQLFR_NORES, 1=SIGQLFR_PASSD, 2=SIGQLFR_FAILD}, implementation-data-type=uint8, type-emitter=RTE
    sm5p12: implementation-data-type=sint8, type-emitter=RTE
    sm6p13: implementation-data-type=sint8, type-emitter=RTE
    SnpshtDataRec1: category=STRUCTURE, sw-calibration-access=READ-ONLY, dynamic-array-size-profile=None, type-emitter=RTE
      10 x element, all with category=TYPE_REFERENCE:
        MicroDiagcData: implementation-data-type=uint32
        HwTq: implementation-data-type=s5p10
        MotTq: implementation-data-type=s5p10
        IgnCntr: implementation-data-type=uint32
        BrdgVltg: implementation-data-type=u6p10
        EcuT: implementation-data-type=s8p7
        NtcNr: implementation-data-type=uint16
        NtcStInfo: implementation-data-type=uint8
        SysSt: implementation-data-type=SysSt1
        VehSpd: implementation-data-type=u9p7
    SnpshtDataRec2: category=STRUCTURE, sw-calibration-access=READ-ONLY, dynamic-array-size-profile=None, type-emitter=RTE
      12 x element, all with category=TYPE_REFERENCE:
        SpclSnpshtData{0..2}: implementation-data-type=uint32
        MicroDiagcData: implementation-data-type=uint32
        IgnCntr: implementation-data-type=uint32
        HwTq: implementation-data-type=s5p10
        MotTq: implementation-data-type=s5p10
        BrdgVltg: implementation-data-type=u6p10
        EcuT: implementation-data-type=s8p7
        NtcNr: implementation-data-type=NtcNrWithResd1
        NtcStInfo: implementation-data-type=uint8
        SysSt: implementation-data-type=SysSt1
    SnsrLrndOffsRec1: category=STRUCTURE, sw-calibration-access=READ-ONLY, dynamic-array-size-profile=None, type-emitter=RTE
      15 x element, all with category=TYPE_REFERENCE:
        HwAgLrndTi: implementation-data-type=float32
        YawRateElpdTi: implementation-data-type=float32
        HwTqLrngCovariMtrx: implementation-data-type=Ary2D_f32_3_3
        HwTqLrngEstimnVect: implementation-data-type=Ary1D_f32_3
        YawRateOffs: implementation-data-type=s6p9
        HwAgOffs: implementation-data-type=s5p10
        HwTqOffs: implementation-data-type=s3p12
        HwAgLrngYawOffsRef: implementation-data-type=s6p9
        HwAgLrngHwAgFilSt: implementation-data-type=s11p4
        HwAgLrngSysTqFilSt: implementation-data-type=s10p5
        HwTqLrngHwAgRef: implementation-data-type=s11p4
        HwTqLrngSampleCntNeg: implementation-data-type=uint16
        HwTqLrngSampleCntPos: implementation-data-type=uint16
        HwTqLrngSts: implementation-data-type=uint8
        YawRateOffsVld: implementation-data-type=boolean
    SteerMod1: compu {0=STEERMOD_BASEPS, 1=STEERMOD_SEMIATNMS, 2=STEERMOD_FULLYATNMS}, implementation-data-type=uint8, type-emitter=RTE
    StHlthMonSig3:
      compu {0=STHLTHMONSIG_ECUTFILTD, 1=STHLTHMONSIG_ASSIDUETOVLTG, 2=STHLTHMONSIG_DIGTQSNSRA, 3=STHLTHMONSIG_DIGTQSNSRB, 4=STHLTHMONSIG_DIGTQIDPTSIG, 5=STHLTHMONSIG_DUTYCYC, 6=STHLTHMONSIG_EOTIMPCT, 7=STHLTHMONSIG_MOTPOS, 8=STHLTHMONSIG_MOTPOSABDIFF, 9=STHLTHMONSIG_MOTPOSACDIFF, 10=STHLTHMONSIG_MOTPOSBCDIFF, 11=STHLTHMONSIG_CURRMOTSUMABC, 12=STHLTHMONSIG_CURRMOTSUMDEF, 13=STHLTHMONSIG_MOTPOSPHASEA, 14=STHLTHMONSIG_MOTPOSPHASEB, 15=STHLTHMONSIG_MOTPOSPHASEC, 16=STHLTHMONSIG_MOTPOSPHASED, 17=STHLTHMONSIG_MOTPOSPHASEE, 18=STHLTHMONSIG_MOTPOSPHASEF, 19=STHLTHMONSIG_BITCORRN, 20=STHLTHMONSIG_FRICESTIMN, 21=STHLTHMONSIG_WHLIMBREJCTN}
      implementation-data-type=uint8
      type-emitter=RTE
    StHlthMonSig4:
      compu {0=STHLTHMONSIG_ECUTFILTD, 1=STHLTHMONSIG_ASSIDUETOVLTG, 2=STHLTHMONSIG_DIGTQSNSRA, 3=STHLTHMONSIG_DIGTQSNSRB, 4=STHLTHMONSIG_DIGTQIDPTSIG, 5=STHLTHMONSIG_DUTYCYC, 6=STHLTHMONSIG_EOTIMPCT, 7=STHLTHMONSIG_MOTPOS, 8=STHLTHMONSIG_MOTPOSABDIFF, 9=STHLTHMONSIG_MOTPOSACDIFF, 10=STHLTHMONSIG_MOTPOSBCDIFF, 11=STHLTHMONSIG_CURRMOTSUMABC, 12=STHLTHMONSIG_CURRMOTSUMDEF, 13=STHLTHMONSIG_MOTPOSPHASEA, 14=STHLTHMONSIG_MOTPOSPHASEB, 15=STHLTHMONSIG_MOTPOSPHASEC, 16=STHLTHMONSIG_MOTPOSPHASED, 17=STHLTHMONSIG_MOTPOSPHASEE, 18=STHLTHMONSIG_MOTPOSPHASEF, 19=STHLTHMONSIG_BITCORRN, 20=STHLTHMONSIG_FRICESTIMN, 21=STHLTHMONSIG_WHLIMBREJCTN, 22=STHLTHMONSIG_DIGTQSNSRC, 23=STHLTHMONSIG_DIGTQSNSRD}
      implementation-data-type=uint8
      type-emitter=RTE
    StordLstPrmRec1: category=STRUCTURE, sw-calibration-access=READ-ONLY, dynamic-array-size-profile=None, type-emitter=RTE
      element PinionAg: implementation-data-type=float32
      element PinionAgVld: implementation-data-type=boolean
    StordLstPrmRec2: category=STRUCTURE, sw-calibration-access=READ-ONLY, dynamic-array-size-profile=None, type-emitter=RTE
      element HwAgRel: implementation-data-type=float32
      element Rev: implementation-data-type=sint16
    StrtUpSt1: compu {1=STRTUPST_PWRDISCNCTATESTCMPL, 2=STRTUPST_PWRDISCNCTBTESTCMPL, 3=STRTUPST_TMPLMONININTESTCMPL, 4=STRTUPST_MOTDRVRININCMPL, 5=STRTUPST_CURRMEASWRMININTESTCMPL, 6=STRTUPST_WARMININCMPL, 7=STRTUPST_RUN, 8=STRTUPST_DISABLE}, implementation-data-type=uint8, type-emitter=RTE
    StsDrvrActvy1: compu {0=STSDRVRACTVY_NODRVRACTVY, 1=STSDRVRACTVY_DRVRACTVY}, implementation-data-type=uint8, type-emitter=RTE
    StsSteerAssi1: compu {0=STSSTEERASSI_OFF, 1=STSSTEERASSI_ON}, implementation-data-type=uint8, type-emitter=RTE
    SysFricDataRec1: category=STRUCTURE, sw-calibration-access=READ-ONLY, dynamic-array-size-profile=None, type-emitter=RTE
      6 x element, all with category=TYPE_REFERENCE:
        FricOffs: implementation-data-type=float32
        BasLineFric: implementation-data-type=Ary1D_f32_4
        VehLrndFric: implementation-data-type=Ary1D_f32_4
        Hys: implementation-data-type=Ary2D_f32_8_4
        RngCntr: implementation-data-type=Ary2D_u16_8_3
        SysFricLrngOperMod: implementation-data-type=SysFricLrngOperMod1
    SysFricLrngOperMod1: compu {0=SYSFRICLRNGOPERMOD_CALIBRATION, 1=SYSFRICLRNGOPERMOD_NORMAL, 2=SYSFRICLRNGOPERMOD_CLEAR, 3=SYSFRICLRNGOPERMOD_IDLE, 4=SYSFRICLRNGOPERMOD_BASELINE}, implementation-data-type=uint8, type-emitter=RTE
    SysFricNonLrngDataRec1: category=STRUCTURE, sw-calibration-access=READ-ONLY, dynamic-array-size-profile=None, type-emitter=RTE
      element EolFric: implementation-data-type=float32
      element EnaFricLrng: implementation-data-type=boolean
      element EnaFricOffsOutp: implementation-data-type=boolean
    SysSt1: compu {0=SYSST_DI, 1=SYSST_OFF, 2=SYSST_ENA, 3=SYSST_WRMININ}, implementation-data-type=uint8, type-emitter=RTE
    TFilStValRec1: category=STRUCTURE, sw-calibration-access=READ-ONLY, dynamic-array-size-profile=None, type-emitter=RTE
      8 x element, all with category=TYPE_REFERENCE, implementation-data-type=float32:
        FilSiLpStVal
        FilMagLpStVal
        FilCuLpStVal
        FilAssisMechLpStVal
        FilSiLLStVal
        FilMagLLStVal
        FilCuLLStVal
        FilAssisMechLLStVal
    TorsBarStEstimdRec1: category=STRUCTURE, sw-calibration-access=READ-ONLY, dynamic-array-size-profile=None, type-emitter=RTE
      5 x element, all with category=TYPE_REFERENCE, implementation-data-type=float32:
        MotVelEstimd
        TorsBarTqEstimd
        TorsBarRotatmEstimd
        DrvrTqEstimd
        RackTqEstimd
      symbol props TorsBarStEstimdRec1
    TrigReg1: compu {85=TRIGREG_MST, 170=TRIGREG_CHKR, 255=TRIGREG_MSTANDCHKR}, implementation-data-type=uint8, type-emitter=EcmOutpAndDiagc
    u0p16: implementation-data-type=uint16, type-emitter=RTE
    u10p6: implementation-data-type=uint16, type-emitter=RTE
    u11p5: implementation-data-type=uint16, type-emitter=RTE
    u12p4: implementation-data-type=uint16, type-emitter=RTE
    u13p3: implementation-data-type=uint16, type-emitter=RTE
    u15p1: implementation-data-type=uint16, type-emitter=RTE
    u16p0: implementation-data-type=uint16, type-emitter=RTE
    u16p16: implementation-data-type=uint32, type-emitter=RTE
    u1p15: implementation-data-type=uint16, type-emitter=RTE
    u2p14: implementation-data-type=uint16, type-emitter=RTE
    u3p13: implementation-data-type=uint16, type-emitter=RTE
    u4p12: implementation-data-type=uint16, type-emitter=RTE
    u5p11: implementation-data-type=uint16, type-emitter=RTE
    u6p10: implementation-data-type=uint16, type-emitter=RTE
    u7p9: implementation-data-type=uint16, type-emitter=RTE
    u8p8: implementation-data-type=uint16, type-emitter=RTE
    u9p7: implementation-data-type=uint16, type-emitter=RTE
    WhlImbRejctnCmpPeakRec1: category=STRUCTURE, sw-calibration-access=READ-ONLY, dynamic-array-size-profile=None, type-emitter=RTE
      6 x element, all with category=TYPE_REFERENCE:
        LePeakPrev: implementation-data-type=float32
        RiPeakPrev: implementation-data-type=float32
        MaxCompPerc: implementation-data-type=float32
        ActvCmpBand{1..3}: implementation-data-type=uint32
package /Nexteer/DataTypes/CompuMethods
  compu method GmSteerAgCtrlDiSt1: 0=GMSTEERAGCTRLDIST_EMPTY, 1=GMSTEERAGCTRLDIST_ADVDRVRASSCSYSDI, 2=GMSTEERAGCTRLDIST_TQTHDEXCDD, 3=GMSTEERAGCTRLDIST_VEHSUPVROVRD, 4=GMSTEERAGCTRLDIST_MISSADVDRVRASSCSYSCMD, 5=GMSTEERAGCTRLDIST_INVLDADVDRVRASSCSYSCMD, 6=GMSTEERAGCTRLDIST_VEHMODMGRFAILD, 7=GMSTEERAGCTRLDIST_ECUHWFAILR
  compu method MotCurrEolCalSt1: 1=MCECS_OFFSCMDHI, 2=MCECS_OFFSCMDLO, 3=MCECS_OFFSCMDZERO, 4=MCECS_OFFSCMDEND, 5=MCECS_GAINCMDAD, 6=MCECS_GAINCMDBE, 7=MCECS_GAINCMDCF, 8=MCECS_CMDSAFEST
package /Nexteer/NvMProxy_swc/DataTypes/DataConstrs
  range UInt8_Constr: raw 0..255
package /Nexteer/Units
  39 x unit, all with factor-si-to-unit=1, offset-si-to-unit=0:
    Ampr: display-name=Amp
    AmprPerVolt: display-name=Amp/V
    AmprSqd: display-name=Amp^2
    Cnt: display-name=Cnt
    DegCgrd: display-name=degC
    DegCgrdPerVolt: display-name=degC/Volt
    FixdPt
    Henry: display-name=H
    HwDeg: display-name=HwDeg
    HwDegPerSec: display-name=HwDeg/s
    HwNwtMtr: display-name=HwNm
    HwRadPerSec: display-name=HwRad/s
    Hz: display-name=Hz
    Kph: display-name=kph
    KphPerSec: display-name=kph/s
    KphPerSecSqd: display-name=kph/s^2
    MicroSec: display-name=uS
    MotDeg: display-name=MotDeg
    MotDegPerHwDeg: display-name=MotDeg/HwDeg
    MotNwtMtr: display-name=MotNm
    MotNwtMtrPerMotRadPerSec: display-name=MotNm/MotRad/S
    MotRad: display-name=MotRad
    MotRadPerSec: display-name=MotRad/s
    MotRev: display-name=MotRev
    MotRevElec: display-name=MotRevElec
    MtrPerSecSqd: display-name=m/s^2
    NanoSec: display-name=nS
    Ohm: display-name=ohm
    OhmPerDegCgrd: display-name=ohm/degC
    Sec: display-name=sec
    Uls: display-name=Uls
    UlsPerSec: display-name=Uls/S
    VehDegPerSec: display-name=VehDeg/S
    VehDegPerSecSqd: display-name=VehDeg/S^2
    Volt: display-name=V
    VoltNanoSec: display-name=VnS
    VoltPerMotRadPerSec: display-name=V/MotRad/Sec
    VoltPerMotRadPerSecPerDegCgrd: display-name=V/MotRad/S/degC
    VoltPerVoltNanoSec
package /Predefined_DEV/ImplementationDataTypes
  impl type NvM_RequestResultType: compu {0=NVM_REQ_OK, 1=NVM_REQ_NOT_OK, 2=NVM_REQ_PENDING, 3=NVM_REQ_INTEGRITY_FAILED, 4=NVM_REQ_BLOCK_SKIPPED, 5=NVM_REQ_NV_INVALIDATED, 6=NVM_REQ_CANCELED, 7=NVM_REQ_REDUNDANCY_FAILED, 8=NVM_REQ_RESTORED_FROM_ROM}, implementation-data-type=uint8
  impl type NvM_ServiceIdType: compu {6=NVM_READ_BLOCK, 7=NVM_WRITE_BLOCK, 8=NVM_RESTORE_BLOCK_DEFAULTS, 9=NVM_ERASE_BLOCK, 11=NVM_INVALIDATE_NV_BLOCK, 12=NVM_READ_ALL}, implementation-data-type=uint8
package /Systems/DiagnosticSwBaseTypes
  base type SINT32_BE: category=FIXED_LENGTH, base-type-size=32, base-type-encoding=2C, mem-alignment=1, byte-order=big-endian
  base type SINT8_BE: category=FIXED_LENGTH, base-type-size=8, base-type-encoding=2C, mem-alignment=1, byte-order=big-endian
  base type UINT8_BE: category=FIXED_LENGTH, base-type-size=8, base-type-encoding=NONE, mem-alignment=1, byte-order=big-endian
