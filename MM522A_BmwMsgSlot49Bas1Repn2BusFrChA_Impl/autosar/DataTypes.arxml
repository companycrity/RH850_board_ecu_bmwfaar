AUTOSAR XML (schema 4-0-3)
standard types defined: float32, uint32, uint8, float32_DataConstr, uint8_DataConstr
package /BMW/SystemDescription/Units
  unit ampere: display-name=A, factor-si-to-unit=1, offset-si-to-unit=0
package /DataTypes
  10 x impl type:
    ALIV_DT_EST1: category=VALUE, base-type=uint8, compu {identical}
    AVL_I_ACT_EST1:
      category=VALUE
      base-type=uint8
      compu {phys=raw for raw 0..252, 253=Funktionsschnittstelle_ist_nicht_verfuegbar (I_SPEC_ARS_Funktionsschnittstelle_ist_nicht_verfuegbar) (Sendefunktion in Betrieb, Werte nicht verfügbar), 254=Funktion_meldet_Fehler (I_SPEC_ARS_Funktion_meldet_Fehler) (Nutzsignal kann nicht berechnet werden), 255=Signal_unbefuellt (I_SPEC_ARS_Signal_unbefuellt) (Sendefunktion nicht in Betrieb); unit A}
    CRC_DT_EST1: category=VALUE, base-type=uint8, compu {identical} "Standartabsicherung Apllikations-CRC."
    DT_EST_dummy_12_151: category=VALUE, base-type=uint8, compu {identical}
    DT_EST_dummy_16_471: category=VALUE, base-type=uint32, compu {identical}
    DT_EST_dummy_64_951: category=VALUE, base-type=uint32, compu {identical}
    DT_EST_dummy_96_1271: category=VALUE, base-type=uint32, compu {identical}
    QU_AVL_I_ACT_EST1:
      category=VALUE
      base-type=uint8
      compu {1=Wert_gueltig_abgesichert (QU_SUM_AVL_I_DRDY_SFY_Wert_gueltig_abgesichert) (Stromwert gueltig und abgesichert), 3=Wert_gueltig_eingeschraenkt (QU_SUM_AVL_I_DRDY_SFY_Wert_gueltig_eingeschraenkt) (Stromwert nicht abgesichert), 6=Wert_nicht_verfuegbar_Fehler (QU_SUM_AVL_I_DRDY_SFY_Wert_nicht_verfuegbar_Fehler) (Sendefunktion in Betrieb, Werte nicht verfügbar), 14=Wert_nicht_verfuegbar (QU_SUM_AVL_I_DRDY_SFY_Wert_nicht_verfuegbar) (Sendefunktion in Betrieb, meldet Fehler), 15=Signal_unbefuellt (QU_SUM_AVL_I_DRDY_SFY_Signal_unbefuellt) (Sendefunktion nicht in Betrieb)}
    sigGroup_DT_EST1: category=STRUCTURE
      9 x element, all with category=TYPE_REFERENCE:
        ST_CULI_EST: range raw 0..15, implementation-data-type=ST_CULI_EST1
        DT_EST_dummy_64_95: range phys 0..4294967295, implementation-data-type=DT_EST_dummy_64_951
        QU_AVL_I_ACT_EST: range raw 0..15, implementation-data-type=QU_AVL_I_ACT_EST1
        DT_EST_dummy_12_15: range phys 0..15, implementation-data-type=DT_EST_dummy_12_151
        AVL_I_ACT_EST: range phys 0..252, implementation-data-type=AVL_I_ACT_EST1
        ALIV_DT_EST: range phys 0..14, implementation-data-type=ALIV_DT_EST1
        CRC_DT_EST: range phys 0..255 "Standartabsicherung Apllikations-CRC.", implementation-data-type=CRC_DT_EST1
        DT_EST_dummy_96_127: range phys 0..4294967295, implementation-data-type=DT_EST_dummy_96_1271
        DT_EST_dummy_16_47: range phys 0..4294967295, implementation-data-type=DT_EST_dummy_16_471
    ST_CULI_EST1:
      category=VALUE
      base-type=uint8
      compu {0=Keine_Strombegrenzung (ST_CULI_EST_Keine_Strombegrenzung) (Keine Strombegrenzung aktiv.), 1=Komfort_Strombegrenzung (ST_CULI_EST_Komfort_Strombegrenzung) (Strombegrenzung über ELMa aktiv.), 10=Maximale_Strombegrenzung (ST_CULI_EST_Maximale_Strombegrenzung) (Sicherheits-Strombegrenzung aktiv), 13=Reserviert_nicht_verfuegbar (ST_CULI_EST_Reserviert_nicht_verfuegbar) (Hinweis: Reserviert für funktionale Kennung Signal-Tag.), 14=Reserviert_Fehler (ST_CULI_EST_Reserviert_Fehler) (Hinweis: Reserviert für funktionale Kennung Signal-Tag.), 15=Signal_unbefuellt (ST_CULI_EST_Signal_unbefuellt) (Sendefunktion nicht in Betrieb)}
package /Nexteer/DataTypes
  impl type BattRtnCurrAmprQlfr1: compu {6=BATTRTNCURRAMPRQLFR_FCTRPRTERR, 9=BATTRTNCURRAMPRQLFR_FCTACTVSECUR, 11=BATTRTNCURRAMPRQLFR_FCTNOTACTV, 14=BATTRTNCURRAMPRQLFR_FCTIFNOTAVL, 15=BATTRTNCURRAMPRQLFR_INVLD}, implementation-data-type=uint8, type-emitter=RTE
  impl type EpsCurrLimSts1: compu {0=EPSCURRLIMSTST_NOCURRLIMR, 1=EPSCURRLIMSTST_CMFTCURRLIMR, 10=EPSCURRLIMSTST_MAXCURRLIMN, 13=EPSCURRLIMSTST_RESDNOTAVL, 14=EPSCURRLIMSTST_RESDERR, 15=EPSCURRLIMSTST_SIGUNFLD}, implementation-data-type=uint8, type-emitter=RTE
