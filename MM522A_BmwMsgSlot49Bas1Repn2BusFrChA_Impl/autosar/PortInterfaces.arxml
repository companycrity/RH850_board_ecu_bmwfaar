AUTOSAR XML (schema 4-0-3)
package /Nexteer/PortInterfaces
  sender receiver interface BattRtnCurrAmprQlfr1_PortIf1: invalidation-policy{data-element=BattRtnCurrAmprQlfr1_PortIf1/Val, handle-invalid=DONT-INVALIDATE}
    data Val: sw-calibration-access=READ-ONLY, type=BattRtnCurrAmprQlfr1
  sender receiver interface EpsCurrLimSts1_PortIf1: invalidation-policy{data-element=EpsCurrLimSts1_PortIf1/Val, handle-invalid=DONT-INVALIDATE}
    data Val: sw-calibration-access=READ-ONLY, type=EpsCurrLimSts1
  sender receiver interface float32_PortIf1: invalidation-policy{data-element=float32_PortIf1/Val, handle-invalid=DONT-INVALIDATE}
    data Val: sw-calibration-access=READ-ONLY, type=float32
package /PortInterfaces
  sender receiver interface sigGroup_DT_EST: invalidation-policy{data-element=sigGroup_DT_EST, handle-invalid=DONT-INVALIDATE}
    data sigGroup_DT_EST: type=sigGroup_DT_EST1
