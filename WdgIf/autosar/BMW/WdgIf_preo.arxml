AUTOSAR XML (schema 4-0-3)
package /MICROSAR
  module config WdgIf_Pre: definition=WdgIf
  module config WdgIf_Rec: definition=WdgIf, implementation-config-variant=VARIANT-PRE-COMPILE
