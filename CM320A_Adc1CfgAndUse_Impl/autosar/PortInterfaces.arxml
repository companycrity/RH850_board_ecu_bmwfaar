AUTOSAR XML (schema 4-0-3)
package /Nexteer/PortInterfaces
  client server interface Adc1CfgAndUseAdc1EnaCnvn_PortIf1
    operation Oper
  sender receiver interface uint8_PortIf1: invalidation-policy{data-element=Val, handle-invalid=DONT-INVALIDATE}
    data Val: sw-calibration-access=READ-ONLY, type=uint8
