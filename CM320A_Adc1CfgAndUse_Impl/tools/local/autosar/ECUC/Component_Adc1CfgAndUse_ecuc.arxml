AUTOSAR XML (schema 4-0-3)
package /ActiveEcuC
  module config Adcf1CfgAndUse: implementation-config-variant=VARIANT-PRE-COMPILE
    Adcf1CfgAndUseGeneral:
      ADCF1VCR{00..20} = 0
      ADCF1SGVCSP2 = 0
      ADCF1SGVCSP3 = 0
      ADCF1SGVCEP2 = 0
      ADCF1SGVCEP3 = 0
  module config Adc1CfgAndUse: implementation-config-variant=VARIANT-PRE-COMPILE
    Adc1CfgAndUseGeneral:
      ADCD1VCR{00..20} = 0
      ADCD1SGVCSP2 = 0
      ADCD1SGVCSP3 = 0
      ADCD1SGVCEP2 = 0
      ADCD1SGVCEP3 = 0
