AUTOSAR XML (schema 4-0-3)
package /Nexteer/Calibrations
  parameter interface uint32_CalPortIf1
    parameter data prototype Val: sw-calibration-access=READ-WRITE, type=uint32
package /Nexteer/PortInterfaces
  client server interface SetFctGpio_PortIf1
    operation Oper: possible-error=SetFctGpio_PortIf1/E_NOT_OK
    error E_NOT_OK: error-code=1
  client server interface SetFctPeriph_PortIf1
    operation Oper: possible-error=SetFctPeriph_PortIf1/E_NOT_OK
    error E_NOT_OK: error-code=1
  client server interface SetGpio_PortIf1
    operation Oper: possible-error=SetGpio_PortIf1/E_NOT_OK
      arg PinSt_Arg: type=boolean, direction=IN, server-argument-impl-policy=USE-ARGUMENT-TYPE
    error E_NOT_OK: error-code=1
  sender receiver interface boolean_PortIf1: invalidation-policy{data-element=Logl, handle-invalid=DONT-INVALIDATE}
    data Logl: sw-calibration-access=READ-ONLY, type=boolean
  sender receiver interface MotCurrEolCalSt_PortIf1: invalidation-policy{data-element=MotCurrEolCalSt_PortIf1/Val, handle-invalid=DONT-INVALIDATE}
    data Val: sw-calibration-access=READ-ONLY, type=MotCurrEolCalSt2
  sender receiver interface SysSt1_PortIf1: invalidation-policy{data-element=SysSt1_PortIf1/Val, handle-invalid=DONT-INVALIDATE}
    data Val: sw-calibration-access=READ-ONLY, type=SysSt1
