AUTOSAR XML (schema 4-0-3)
standard types defined: boolean, float32, uint16, uint32, uint8, boolean_CompuMethod, boolean_DataConstr, float32_DataConstr, uint16_DataConstr, uint32_DataConstr, uint8_DataConstr
package /Nexteer/DataTypes
  11 x impl type, all with type-emitter=RTE:
    Ary1D_u11p5_10: category=ARRAY, sw-calibration-access=READ-ONLY
      element Element: array-size=10, array-size-semantics=FIXED-SIZE, implementation-data-type=u11p5
    Ary1D_u11p5_12: category=ARRAY, sw-calibration-access=READ-ONLY
      element Element: array-size=12, array-size-semantics=FIXED-SIZE, implementation-data-type=u11p5
    Ary1D_u4p12_10: category=ARRAY, sw-calibration-access=READ-ONLY
      element Element: array-size=10, array-size-semantics=FIXED-SIZE, implementation-data-type=u4p12
    Ary1D_u4p12_12: category=ARRAY, sw-calibration-access=READ-ONLY
      element Element: array-size=12, array-size-semantics=FIXED-SIZE, implementation-data-type=u4p12
    Ary1D_u9p7_12: category=ARRAY, sw-calibration-access=READ-ONLY
      element Element: array-size=12, array-size-semantics=FIXED-SIZE, implementation-data-type=u9p7
    Ary2D_u4p12_12_12: category=ARRAY, sw-calibration-access=READ-ONLY
      element Element: array-size=12, array-size-semantics=FIXED-SIZE, implementation-data-type=Ary1D_u4p12_12
    BmwTrfcJamAssiDampgStReq1: compu {1=BMWTRFCJAMASSIDAMPGSTREQ_DONOTCNVSPADDLDAMPG, 2=BMWTRFCJAMASSIDAMPGSTREQ_CNVSPADDLDAMPG, 15=BMWTRFCJAMASSIDAMPGSTREQ_INVLDSIG}, implementation-data-type=uint8
    BmwTrfcJamAssiSt1: compu {1=BMWTRFCJAMASSIST_INACTV, 2=BMWTRFCJAMASSIST_ACTV, 15=BMWTRFCJAMASSIST_INVLD}, implementation-data-type=uint8
    u11p5: implementation-data-type=uint16
    u4p12: implementation-data-type=uint16
    u9p7: implementation-data-type=uint16
