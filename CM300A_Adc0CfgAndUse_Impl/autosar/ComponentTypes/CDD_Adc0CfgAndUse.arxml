AUTOSAR XML (schema 4-0-3)
package /ComponentTypes
  complex device driver sw component type CDD_Adc0CfgAndUse
    behavior CDD_Adc0CfgAndUse_InternalBehavior
      ar-typed-per-instance-memorys:
        data Adc0DiagcEndPtr: sw-calibration-access=READ-ONLY, type=uint8
        data Adc0DiagcStrtPtr: sw-calibration-access=READ-ONLY, type=uint8
      timing event CDD_Adc0CfgAndUse_InitEvent: start-on-event=Adc0CfgAndUseInit1, period=0
      runnable Adc0CfgAndUseInit1
  swc implementation CDD_Adc0CfgAndUse_Implementation: behavior=CDD_Adc0CfgAndUse_InternalBehavior
    code-descriptors:
      code Default: artifact-descriptors=autosar-engineering-object={short-label=Default, category=SWSRC}
