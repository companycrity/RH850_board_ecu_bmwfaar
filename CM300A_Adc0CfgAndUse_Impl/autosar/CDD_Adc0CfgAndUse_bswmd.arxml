AUTOSAR XML (schema 4-0-3)
package /Nexteer
  module definition Adc0CfgAndUse [0..1]: variants pre-compile  # Configuration of the ADC0.
    container Adc0CfgAndUseGeneral  # This container contains the configuration (parameters) of the Adc0CfgAndUse.
      integer ADCD0VCR{00..20}: 0..262143, set at pre-compile, origin=Nexteer  # .
      integer ADCD0SGVCSP2: 0..63, set at pre-compile, origin=Nexteer  # .
      integer ADCD0SGVCSP3: 0..63, set at pre-compile, origin=Nexteer  # .
      integer ADCD0SGVCEP2: 0..63, set at pre-compile, origin=Nexteer  # .
      integer ADCD0SGVCEP3: 0..63, set at pre-compile, origin=Nexteer  # .
