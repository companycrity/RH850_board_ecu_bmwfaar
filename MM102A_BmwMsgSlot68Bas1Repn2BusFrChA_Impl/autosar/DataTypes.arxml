AUTOSAR XML (schema 4-0-3)
standard types defined: boolean, float32, uint16, uint8, boolean_CompuMethod, boolean_DataConstr, float32_DataConstr, uint16_DataConstr, uint8_DataConstr
package /BMW/Boardnet/CodingDatatypes/CompuMethodsForBoardnet
  compu method I_SPEC_ARS: phys=raw for raw 0..252, 253=Funktionsschnittstelle_ist_nicht_verfuegbar (I_SPEC_ARS_Funktionsschnittstelle_ist_nicht_verfuegbar) (Sendefunktion in Betrieb, Werte nicht verfügbar), 254=Funktion_meldet_Fehler (I_SPEC_ARS_Funktion_meldet_Fehler) (Nutzsignal kann nicht berechnet werden), 255=Signal_unbefuellt (I_SPEC_ARS_Signal_unbefuellt) (Sendefunktion nicht in Betrieb); unit A
package /BMW/SystemDescription/Units
  unit ampere: display-name=A, factor-si-to-unit=1, offset-si-to-unit=0
package /DataTypes
  13 x impl type:
    ALIV_ENERG_DGR_DRDY1: category=VALUE, base-type=uint8, compu {identical}
    BmwMaxCurrLimrSts1: category=VALUE, base-type=uint8, sw-calibration-access=READ-ONLY, compu {1=BMWMAXCURRLIMRSTS_VLD, 2=BMWMAXCURRLIMRSTS_FCTIFNOTAVL, 3=BMWMAXCURRLIMRSTS_FCTRPRTERR, 4=BMWMAXCURRLIMRSTS_INVLD}, type-emitter=RTE
    BmwRqrdCurrLimEpsSfty1: category=VALUE, base-type=uint8, sw-calibration-access=READ-ONLY, compu {0=BMWRQRDCURRLIMEPSSFTY_NOCURRLIM, 1=BMWRQRDCURRLIMEPSSFTY_CMFTCURRLIM, 10=BMWRQRDCURRLIMEPSSFTY_MAXCURRLIM, 13=BMWRQRDCURRLIMEPSSFTY_RESDNOTAVL, 14=BMWRQRDCURRLIMEPSSFTY_RESDERR, 15=BMWRQRDCURRLIMEPSSFTY_INVLDSIG}, type-emitter=RTE
    CRC_ENERG_DGR_DRDY1: category=VALUE, base-type=uint8, compu {identical} "Standartabsicherung Apllikations-CRC."
    ENERG_AVAI_ARS1:
      category=VALUE
      base-type=uint8
      compu {phys=raw for raw 0..100, 253=Funktionsschnittstelle_ist_nicht_verfuegbar (ENERG_AVAI_ARS_Funktionsschnittstelle_ist_nicht_verfuegbar) (Sendefunktion in Betrieb, Werte nicht verfügbar), 254=Funktion_meldet_Fehler (ENERG_AVAI_ARS_Funktion_meldet_Fehler) (Nutzsignal kann nicht berechnet werden), 255=Signal_unbefuellt (ENERG_AVAI_ARS_Signal_unbefuellt) (Sendefunktion nicht in Betrieb)}
    ENERG_DGR_DRDY_dummy_12_151: category=VALUE, base-type=uint8, compu {identical}
    MAX_I_LD_SPEC_ARS1: category=VALUE, base-type=uint8, compu-method=I_SPEC_ARS
    MAX_I_RECUP_SPEC_ARS1:
      category=VALUE
      base-type=uint8
      compu {phys=raw-252 for raw 252..504, 253=Funktionsschnittstelle_ist_nicht_verfuegbar (MIN_I_SPEC_ARS_Funktionsschnittstelle_ist_nicht_verfuegbar) (Sendefunktion in Betrieb, Werte nicht verfügbar), 254=Funktion_meldet_Fehler (MIN_I_SPEC_ARS_Funktion_meldet_Fehler) (Nutzsignal kann nicht berechnet werden), 255=Signal_unbefuellt (MIN_I_SPEC_ARS_Signal_unbefuellt) (Sendefunktion nicht in Betrieb); unit A}
    MAX_I_SPEC_BAX_STE1: category=VALUE, base-type=uint8, compu-method=I_SPEC_ARS
    MAX_I_SPEC_EPS1: category=VALUE, base-type=uint8, compu-method=I_SPEC_ARS
    QU_DGR_AISP_ENERG1:
      category=VALUE
      base-type=uint8
      compu {0=Degradationsstufe0 (QU_DGR_AISP_ENERG_Degradationsstufe0) (BNE original name: Degradationsstufe 0), 1=Degradationsstufe1 (QU_DGR_AISP_ENERG_Degradationsstufe1) (BNE original name: Degradationsstufe 1), 2=Degradationsstufe2 (QU_DGR_AISP_ENERG_Degradationsstufe2) (BNE original name: Degradationsstufe 2), 3=Degradationsstufe3 (QU_DGR_AISP_ENERG_Degradationsstufe3) (BNE original name: Degradationsstufe 3), 4=Degradationsstufe4 (QU_DGR_AISP_ENERG_Degradationsstufe4) (BNE original name: Degradationsstufe 4), 15=SignalUngueltig (QU_DGR_AISP_ENERG_SignalUngueltig) (BNE original name: Signal ungültig)}
    RQ_CULI_EST_SFY1:
      category=VALUE
      base-type=uint8
      compu {0=Keine_Strombegrenzung (RQ_CULI_EST_SFY_Keine_Strombegrenzung) (Keine Strombegrenzung angefordert.), 1=Komfort_Strombegrenzung (RQ_CULI_EST_SFY_Komfort_Strombegrenzung) (Strombegrenzung über ELMa angefordert.), 10=Maximale_Strombegrenzung (RQ_CULI_EST_SFY_Maximale_Strombegrenzung) (Sicherheits-Strombegrenzung angefordert.), 13=Reserviert_nicht_verfuegbar (RQ_CULI_EST_SFY_Reserviert_nicht_verfuegbar) (Hinweis: Reserviert für funktionale Kennung Signal-Tag.), 14=Reserviert_Fehler (RQ_CULI_EST_SFY_Reserviert_Fehler) (Hinweis: Reserviert für funktionale Kennung Signal-Tag.), 15=Signal_unbefuellt (RQ_CULI_EST_SFY_Signal_unbefuellt) (Sendefunktion nicht in Betrieb)}
    sigGroup_ENERG_DGR_DRDY1: category=STRUCTURE
      10 x element, all with category=TYPE_REFERENCE:
        MAX_I_LD_SPEC_ARS: range phys 0..252, implementation-data-type=MAX_I_LD_SPEC_ARS1
        MAX_I_RECUP_SPEC_ARS: range phys 0..252, implementation-data-type=MAX_I_RECUP_SPEC_ARS1
        RQ_CULI_EST_SFY: range raw 0..15, implementation-data-type=RQ_CULI_EST_SFY1
        ALIV_ENERG_DGR_DRDY: range phys 0..14, implementation-data-type=ALIV_ENERG_DGR_DRDY1
        ENERG_AVAI_ARS: range phys 0..100, implementation-data-type=ENERG_AVAI_ARS1
        QU_DGR_AISP_ENERG: range raw 0..15, implementation-data-type=QU_DGR_AISP_ENERG1
        CRC_ENERG_DGR_DRDY: range phys 0..255 "Standartabsicherung Apllikations-CRC.", implementation-data-type=CRC_ENERG_DGR_DRDY1
        MAX_I_SPEC_BAX_STE: range phys 0..252, implementation-data-type=MAX_I_SPEC_BAX_STE1
        ENERG_DGR_DRDY_dummy_12_15: range phys 0..15, implementation-data-type=ENERG_DGR_DRDY_dummy_12_151
        MAX_I_SPEC_EPS: range phys 0..252, implementation-data-type=MAX_I_SPEC_EPS1
package /Nexteer/DataTypes
  impl type NtcNr1: compu {1..511=NTCNR_0X001..NTCNR_0X1FF}, implementation-data-type=uint16, type-emitter=RTE
  impl type NtcSts1: compu {0=NTCSTS_PASSD, 1=NTCSTS_FAILD, 2=NTCSTS_PREPASSD, 3=NTCSTS_PREFAILD}, implementation-data-type=uint8, type-emitter=RTE
