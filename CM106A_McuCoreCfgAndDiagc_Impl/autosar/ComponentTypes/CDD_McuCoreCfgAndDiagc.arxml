AUTOSAR XML (schema 4-0-3)
package /ComponentTypes
  complex device driver sw component type CDD_McuCoreCfgAndDiagc
    behavior CDD_McuCoreCfgAndDiagc_InternalBehavior
      ar-typed-per-instance-memorys:
        data CoreCompTestRegRead: sw-calibration-access=READ-ONLY, type=uint32
      timing event McuCoreCfgAndDiagcInit3_InitEvent: start-on-event=McuCoreCfgAndDiagcInit3, period=0
      runnable McuCoreCfgAndDiagcInit3
  swc implementation CDD_McuCoreCfgAndDiagc_Implementation: behavior=CDD_McuCoreCfgAndDiagc_InternalBehavior
    code-descriptors:
      code Default: artifact-descriptors=autosar-engineering-object={short-label=Default, category=SWSRC}
